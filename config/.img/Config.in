## make/busybox/Config.in
```kconfig
# FREETZ_BUSYBOX___Vxyz_   symbols of menuconfig of busybox version x.yz.*
# FREETZ_BUSYBOX___        symbols of menuconfig of all busybox versions
# FREETZ_BUSYBOX__         symbols to select by user outside of busybox, eg additional patches
# FREETZ_BUSYBOX_          symbols (bool only) to select by other packages, selecing symbools of current active version

choice
	prompt "BusyBox version"
	default FREETZ_BUSYBOX__VERSION_V138
	default FREETZ_BUSYBOX__VERSION_V127

	config FREETZ_BUSYBOX__VERSION_V127
		bool "1.27.2"
		depends on FREETZ_KERNEL_VERSION_2_MAX

	config FREETZ_BUSYBOX__VERSION_V138
		bool "1.38.0"
		depends on FREETZ_KERNEL_VERSION_3_MIN

endchoice # "BusyBox version" #

config FREETZ_BUSYBOX__VERSION_STRING
	string
	default "1.27.2" if FREETZ_BUSYBOX__VERSION_V127
	default "1.38.0" if FREETZ_BUSYBOX__VERSION_V138

config FREETZ_BUSYBOX__RECOMMENDED
	bool "recommended - DEVELOPER" if FREETZ_SHOW_DEVELOPER
	default y
	help
		Deselecting this option in itself doesn't change anything, it allows
		you to deselect some options that are listed in mandatory, but are not
		essential. Deselect this only if space is tight and you want to save
		a few bytes.

		Note that some features from the AVM firmware or from Freetz may not work.

		Programs you might want to remove include vi, top, stty, wget or mount
		support for cases you know you won't need. You may also consider
		downloading a busybox with more features into the running box from a
		USB, NFS oder HTTP source. Obviously the firmware on your box must
		contain the necessary features to access that busybox.

config FREETZ_BUSYBOX__MANDATORY
	bool # mandatory
	select FREETZ_BUSYBOX__MANDATORY_05_2X if FREETZ_AVM_VERSION_05_2X_MIN
	select FREETZ_BUSYBOX__MANDATORY_06_5X if FREETZ_AVM_VERSION_06_5X_MIN
	select FREETZ_BUSYBOX__MANDATORY_07_0X if FREETZ_AVM_VERSION_07_0X_MIN
	select FREETZ_BUSYBOX__MANDATORY_07_2X if FREETZ_AVM_VERSION_07_2X_MIN
	select FREETZ_BUSYBOX__MANDATORY_07_5X if FREETZ_AVM_VERSION_07_5X_MIN
	select FREETZ_BUSYBOX__MANDATORY_08_0X if FREETZ_AVM_VERSION_08_0X_MIN
	select FREETZ_BUSYBOX_ADDGROUP
	select FREETZ_BUSYBOX_ADDUSER
	select FREETZ_BUSYBOX_ASH_ALIAS
	select FREETZ_BUSYBOX_ASH_BASH_COMPAT
	select FREETZ_BUSYBOX_ASH_CMDCMD
	select FREETZ_BUSYBOX_ASH_ECHO
	select FREETZ_BUSYBOX_ASH_EXPAND_PRMT
	select FREETZ_BUSYBOX_ASH_GETOPTS
	select FREETZ_BUSYBOX_ASH_INTERNAL_GLOB
	select FREETZ_BUSYBOX_ASH_JOB_CONTROL
	select FREETZ_BUSYBOX_ASH_OPTIMIZE_FOR_SIZE
	select FREETZ_BUSYBOX_ASH_PRINTF
	select FREETZ_BUSYBOX_ASH_RANDOM_SUPPORT
	select FREETZ_BUSYBOX_ASH_TEST
	select FREETZ_BUSYBOX_ASH
	select FREETZ_BUSYBOX_AWK
	select FREETZ_BUSYBOX_BASENAME
	select FREETZ_BUSYBOX_BB_SYSCTL
	select FREETZ_BUSYBOX_BEEP if FREETZ_BUSYBOX__RECOMMENDED
	select FREETZ_BUSYBOX_BUSYBOX
	select FREETZ_BUSYBOX_CAT
	select FREETZ_BUSYBOX_CHMOD
	select FREETZ_BUSYBOX_CHOWN
	select FREETZ_BUSYBOX_CMP
	select FREETZ_BUSYBOX_CP
	select FREETZ_BUSYBOX_CRYPTPW
	select FREETZ_BUSYBOX_CUT
	select FREETZ_BUSYBOX_DATE
	select FREETZ_BUSYBOX_DD
	select FREETZ_BUSYBOX_DELGROUP
	select FREETZ_BUSYBOX_DELUSER
	select FREETZ_BUSYBOX_DF
	select FREETZ_BUSYBOX_DIRNAME
	# was selected together with hostname, thus available in all AVM firmwares, but unused
	select FREETZ_BUSYBOX_DNSDOMAINNAME
	select FREETZ_BUSYBOX_DMESG if !FREETZ_AVM_HAS_DMESG_FILE
	select FREETZ_BUSYBOX_DU
	select FREETZ_BUSYBOX_ECHO
	select FREETZ_BUSYBOX_ENV
	select FREETZ_BUSYBOX_ETHER_WAKE
	select FREETZ_BUSYBOX_EXPR
	select FREETZ_BUSYBOX_EXPR_MATH_SUPPORT_64
	select FREETZ_BUSYBOX_FALSE
	select FREETZ_BUSYBOX_FEATURE_ADDUSER_TO_GROUP
	select FREETZ_BUSYBOX_FEATURE_ALLOW_EXEC
	select FREETZ_BUSYBOX_FEATURE_CHECK_TAINTED_MODULE if !FREETZ_PACKAGE_MODULE_INIT_TOOLS_modprobe && !FREETZ_AVM_HAS_KMOD && !FREETZ_PACKAGE_MODULE_INIT_TOOLS_lsmod
	select FREETZ_BUSYBOX_FEATURE_CMDLINE_MODULE_OPTIONS if !FREETZ_PACKAGE_MODULE_INIT_TOOLS_modprobe && !FREETZ_AVM_HAS_KMOD
	select FREETZ_BUSYBOX_FEATURE_DATE_COMPAT
	select FREETZ_BUSYBOX_FEATURE_DATE_ISOFMT
	select FREETZ_BUSYBOX_FEATURE_DD_SIGNAL_HANDLING
	select FREETZ_BUSYBOX_FEATURE_DEL_USER_FROM_GROUP
	select FREETZ_BUSYBOX_FEATURE_DEVPTS
	select FREETZ_BUSYBOX_FEATURE_DMESG_PRETTY if !FREETZ_AVM_HAS_DMESG_FILE
	select FREETZ_BUSYBOX_FEATURE_DU_DEFAULT_BLOCKSIZE_1K
	select FREETZ_BUSYBOX_FEATURE_EDITING_FANCY_PROMPT
	select FREETZ_BUSYBOX_FEATURE_EDITING
	select FREETZ_BUSYBOX_FEATURE_FANCY_ECHO
	select FREETZ_BUSYBOX_FEATURE_FANCY_HEAD
	select FREETZ_BUSYBOX_FEATURE_FANCY_PING
	select FREETZ_BUSYBOX_FEATURE_FANCY_SLEEP
	select FREETZ_BUSYBOX_FEATURE_FANCY_TAIL
	select FREETZ_BUSYBOX_FEATURE_FIND_DEPTH
	select FREETZ_BUSYBOX_FEATURE_FIND_EXEC
	select FREETZ_BUSYBOX_FEATURE_FIND_GROUP
	select FREETZ_BUSYBOX_FEATURE_FIND_INUM
	select FREETZ_BUSYBOX_FEATURE_FIND_MAXDEPTH
	select FREETZ_BUSYBOX_FEATURE_FIND_MMIN
	select FREETZ_BUSYBOX_FEATURE_FIND_MTIME
	select FREETZ_BUSYBOX_FEATURE_FIND_NEWER
	select FREETZ_BUSYBOX_FEATURE_FIND_NOT
	select FREETZ_BUSYBOX_FEATURE_FIND_PAREN
	select FREETZ_BUSYBOX_FEATURE_FIND_PATH
	select FREETZ_BUSYBOX_FEATURE_FIND_PERM
	select FREETZ_BUSYBOX_FEATURE_FIND_PRINT0
	select FREETZ_BUSYBOX_FEATURE_FIND_PRUNE
	select FREETZ_BUSYBOX_FEATURE_FIND_REGEX
	select FREETZ_BUSYBOX_FEATURE_FIND_SIZE
	select FREETZ_BUSYBOX_FEATURE_FIND_TYPE
	select FREETZ_BUSYBOX_FEATURE_FIND_USER
	select FREETZ_BUSYBOX_FEATURE_FIND_XDEV
	select FREETZ_BUSYBOX_FEATURE_GETOPT_LONG
	select FREETZ_BUSYBOX_FEATURE_GREP_CONTEXT
	select FREETZ_BUSYBOX_FEATURE_HUMAN_READABLE
	select FREETZ_BUSYBOX_FEATURE_HWIB
	select FREETZ_BUSYBOX_FEATURE_IFCONFIG_BROADCAST_PLUS
	select FREETZ_BUSYBOX_FEATURE_IFCONFIG_HW
	select FREETZ_BUSYBOX_FEATURE_IFCONFIG_STATUS if FREETZ_BUSYBOX__RECOMMENDED
	select FREETZ_BUSYBOX_FEATURE_IFUPDOWN_IPV4
	select FREETZ_BUSYBOX_FEATURE_IFUPDOWN_MAPPING
	select FREETZ_BUSYBOX_FEATURE_INIT_SYSLOG
	select FREETZ_BUSYBOX_FEATURE_IP_ADDRESS if FREETZ_BUSYBOX_IP
	select FREETZ_BUSYBOX_FEATURE_IP_LINK if FREETZ_BUSYBOX_IP
	select FREETZ_BUSYBOX_FEATURE_IP_ROUTE if FREETZ_BUSYBOX_IP
	select FREETZ_BUSYBOX_FEATURE_IP_TUNNEL if FREETZ_BUSYBOX_IP
	select FREETZ_BUSYBOX_FEATURE_KILL_REMOVED
	select FREETZ_BUSYBOX_FEATURE_LS_FILETYPES
	select FREETZ_BUSYBOX_FEATURE_LS_FOLLOWLINKS
	select FREETZ_BUSYBOX_FEATURE_LSMOD_PRETTY_2_6_OUTPUT if !FREETZ_PACKAGE_MODULE_INIT_TOOLS_lsmod && !FREETZ_AVM_HAS_KMOD
	select FREETZ_BUSYBOX_FEATURE_LS_RECURSIVE
	select FREETZ_BUSYBOX_FEATURE_LS_SORTFILES
	select FREETZ_BUSYBOX_FEATURE_LS_TIMESTAMPS
	select FREETZ_BUSYBOX_FEATURE_LS_USERNAME
	select FREETZ_BUSYBOX_FEATURE_MAKEDEVS_TABLE
	select FREETZ_BUSYBOX_FEATURE_MD5_SHA1_SUM_CHECK if FREETZ_AVM_HAS_MULTI_ANNEX && ! FREETZ_REMOVE_MULTI_ANNEX_FIRMWARE_DIFFS
	select FREETZ_BUSYBOX_FEATURE_MOUNT_CIFS if FREETZ_BUSYBOX__RECOMMENDED
	select FREETZ_BUSYBOX_FEATURE_MOUNT_FLAGS if FREETZ_BUSYBOX__RECOMMENDED
	select FREETZ_BUSYBOX_FEATURE_MOUNT_FSTAB if FREETZ_BUSYBOX__RECOMMENDED
	select FREETZ_BUSYBOX_FEATURE_MOUNT_LOOP_CREATE if FREETZ_BUSYBOX__RECOMMENDED
	select FREETZ_BUSYBOX_FEATURE_MOUNT_LOOP if FREETZ_BUSYBOX__RECOMMENDED
	select FREETZ_BUSYBOX_FEATURE_MOUNT_NFS if FREETZ_BUSYBOX__RECOMMENDED && FREETZ_KERNEL_VERSION_2_6_19_MAX
	select FREETZ_BUSYBOX_FEATURE_MOUNT_VERBOSE if FREETZ_BUSYBOX__RECOMMENDED
	select FREETZ_BUSYBOX_FEATURE_NETSTAT_PRG
	select FREETZ_BUSYBOX_FEATURE_NOLOGIN if !FREETZ_REPLACE_AR7LOGIN
	select FREETZ_BUSYBOX_FEATURE_NON_POSIX_CP
	select FREETZ_BUSYBOX_FEATURE_PASSWD_WEAK_CHECK
	select FREETZ_BUSYBOX_FEATURE_PIDFILE
	select FREETZ_BUSYBOX_FEATURE_PIDOF_OMIT
	select FREETZ_BUSYBOX_FEATURE_PIDOF_SINGLE
	select FREETZ_BUSYBOX_FEATURE_PRESERVE_HARDLINKS if FREETZ_BUSYBOX__RECOMMENDED
	select FREETZ_BUSYBOX_FEATURE_SEAMLESS_GZ
	select FREETZ_BUSYBOX_FEATURE_SECURETTY if !FREETZ_REPLACE_AR7LOGIN
	select FREETZ_BUSYBOX_FEATURE_SH_MATH
	select FREETZ_BUSYBOX_FEATURE_SH_MATH_64
	select FREETZ_BUSYBOX_FEATURE_SHADOWPASSWDS
	select FREETZ_BUSYBOX_FEATURE_SKIP_ROOTFS
	select FREETZ_BUSYBOX_FEATURE_SORT_BIG if FREETZ_BUSYBOX__RECOMMENDED
	select FREETZ_BUSYBOX_FEATURE_SPLIT_FANCY
	select FREETZ_BUSYBOX_FEATURE_START_STOP_DAEMON_FANCY if FREETZ_BUSYBOX_START_STOP_DAEMON
	select FREETZ_BUSYBOX_FEATURE_STAT_FILESYSTEM
	select FREETZ_BUSYBOX_FEATURE_STAT_FORMAT
	select FREETZ_BUSYBOX_FEATURE_SUID
	select FREETZ_BUSYBOX_FEATURE_SYSLOG
	select FREETZ_BUSYBOX_FEATURE_TAB_COMPLETION
	select FREETZ_BUSYBOX_FEATURE_TAR_CREATE
	select FREETZ_BUSYBOX_FEATURE_TAR_FROM
	select FREETZ_BUSYBOX_FEATURE_TAR_GNU_EXTENSIONS
	select FREETZ_BUSYBOX_FEATURE_TAR_LONG_OPTIONS
	select FREETZ_BUSYBOX_FEATURE_TAR_OLDGNU_COMPATIBILITY
	select FREETZ_BUSYBOX_FEATURE_TEE_USE_BLOCK_IO
	select FREETZ_BUSYBOX_FEATURE_TOP_CPU_GLOBAL_PERCENTS if FREETZ_BUSYBOX__RECOMMENDED
	select FREETZ_BUSYBOX_FEATURE_TOP_CPU_USAGE_PERCENTAGE if FREETZ_BUSYBOX__RECOMMENDED
	select FREETZ_BUSYBOX_FEATURE_TOP_DECIMALS if FREETZ_BUSYBOX__RECOMMENDED
	select FREETZ_BUSYBOX_FEATURE_TOP_INTERACTIVE if FREETZ_BUSYBOX__RECOMMENDED
	select FREETZ_BUSYBOX_FEATURE_TOP_SMP_CPU if FREETZ_BUSYBOX__RECOMMENDED
	select FREETZ_BUSYBOX_FEATURE_TOP_SMP_PROCESS if FREETZ_BUSYBOX__RECOMMENDED
	select FREETZ_BUSYBOX_FEATURE_TOPMEM if FREETZ_BUSYBOX__RECOMMENDED
	select FREETZ_BUSYBOX_FEATURE_FAST_TOP if FREETZ_BUSYBOX__RECOMMENDED
	select FREETZ_BUSYBOX_FEATURE_TOUCH_SUSV3
	select FREETZ_BUSYBOX_FEATURE_TR_CLASSES
	select FREETZ_BUSYBOX_FEATURE_TR_EQUIV
	select FREETZ_BUSYBOX_FEATURE_UMOUNT_ALL
	select FREETZ_BUSYBOX_FEATURE_USE_INITTAB
	select FREETZ_BUSYBOX_FEATURE_VERBOSE_USAGE if FREETZ_BUSYBOX_FEATURE_VERBOSE
	select FREETZ_BUSYBOX_FEATURE_COMPRESS_USAGE if FREETZ_BUSYBOX_BZIP2 && FREETZ_BUSYBOX_SHOW_USAGE
	select FREETZ_BUSYBOX_FEATURE_VI_8BIT if FREETZ_BUSYBOX__RECOMMENDED
	select FREETZ_BUSYBOX_FEATURE_VI_ASK_TERMINAL if FREETZ_BUSYBOX__RECOMMENDED
	select FREETZ_BUSYBOX_FEATURE_VI_COLON if FREETZ_BUSYBOX__RECOMMENDED
	select FREETZ_BUSYBOX_FEATURE_VI_DOT_CMD if FREETZ_BUSYBOX__RECOMMENDED
	select FREETZ_BUSYBOX_FEATURE_VI_OPTIMIZE_CURSOR if FREETZ_BUSYBOX__RECOMMENDED
	select FREETZ_BUSYBOX_FEATURE_VI_READONLY if FREETZ_BUSYBOX__RECOMMENDED
	select FREETZ_BUSYBOX_FEATURE_VI_SEARCH if FREETZ_BUSYBOX__RECOMMENDED
	select FREETZ_BUSYBOX_FEATURE_VI_SETOPTS if FREETZ_BUSYBOX__RECOMMENDED
	select FREETZ_BUSYBOX_FEATURE_VI_SET if FREETZ_BUSYBOX__RECOMMENDED
	select FREETZ_BUSYBOX_FEATURE_VI_USE_SIGNALS if FREETZ_BUSYBOX__RECOMMENDED
	select FREETZ_BUSYBOX_FEATURE_VI_WIN_RESIZE if FREETZ_BUSYBOX__RECOMMENDED
	select FREETZ_BUSYBOX_FEATURE_VI_YANKMARK if FREETZ_BUSYBOX__RECOMMENDED
	select FREETZ_BUSYBOX_FEATURE_WC_LARGE if FREETZ_BUSYBOX__RECOMMENDED
	select FREETZ_BUSYBOX_FEATURE_WGET_AUTHENTICATION if FREETZ_BUSYBOX_WGET
	select FREETZ_BUSYBOX_FEATURE_WGET_STATUSBAR if FREETZ_BUSYBOX_WGET && FREETZ_BUSYBOX__RECOMMENDED
	select FREETZ_BUSYBOX_FEATURE_WGET_TIMEOUT if FREETZ_BUSYBOX_WGET
	select FREETZ_BUSYBOX_FEATURE_XARGS_SUPPORT_CONFIRMATION
	select FREETZ_BUSYBOX_FEATURE_XARGS_SUPPORT_QUOTES
	select FREETZ_BUSYBOX_FEATURE_XARGS_SUPPORT_TERMOPT
	select FREETZ_BUSYBOX_FEATURE_XARGS_SUPPORT_ZERO_TERM
	select FREETZ_BUSYBOX_FIND
	select FREETZ_BUSYBOX_FREE
	select FREETZ_BUSYBOX_GETOPT
	select FREETZ_BUSYBOX_GREP
	select FREETZ_BUSYBOX_EGREP
	select FREETZ_BUSYBOX_FGREP
	select FREETZ_BUSYBOX_GUNZIP
	select FREETZ_BUSYBOX_ZCAT
	select FREETZ_BUSYBOX_GZIP
	select FREETZ_BUSYBOX_HALT
	select FREETZ_BUSYBOX_HAVE_DOT_CONFIG
	select FREETZ_BUSYBOX_HEAD
	select FREETZ_BUSYBOX_HOSTNAME
	select FREETZ_BUSYBOX_ID
	select FREETZ_BUSYBOX_IFCONFIG
	select FREETZ_BUSYBOX_IFUP
	select FREETZ_BUSYBOX_IFDOWN
	select FREETZ_BUSYBOX_INIT
	select FREETZ_BUSYBOX_INSMOD if !FREETZ_PACKAGE_MODULE_INIT_TOOLS_insmod && !FREETZ_AVM_HAS_KMOD
	select FREETZ_BUSYBOX_INSTALL_APPLET_SYMLINKS
	select FREETZ_BUSYBOX_IOCTL_HEX2STR_ERROR
	select FREETZ_BUSYBOX_KILLALL
	select FREETZ_BUSYBOX_KILL
	select FREETZ_BUSYBOX_LFS
	select FREETZ_BUSYBOX_LONG_OPTS
	select FREETZ_BUSYBOX_LN
	select FREETZ_BUSYBOX_LOGGER
	select FREETZ_BUSYBOX_LOGIN
	select FREETZ_BUSYBOX_LSMOD if !FREETZ_PACKAGE_MODULE_INIT_TOOLS_lsmod && !FREETZ_AVM_HAS_KMOD
	select FREETZ_BUSYBOX_LS
	select FREETZ_BUSYBOX_MAKEDEVS
	select FREETZ_BUSYBOX_MD5SUM
	select FREETZ_BUSYBOX_MKDIR
	select FREETZ_BUSYBOX_MKFIFO
	select FREETZ_BUSYBOX_MKNOD
	select FREETZ_BUSYBOX_MKPASSWD
	select FREETZ_BUSYBOX_MODPROBE if !FREETZ_PACKAGE_MODULE_INIT_TOOLS_modprobe && !FREETZ_AVM_HAS_KMOD
	select FREETZ_BUSYBOX_MONOTONIC_SYSCALL
	select FREETZ_BUSYBOX_MOUNT
	select FREETZ_BUSYBOX_MV
	select FREETZ_BUSYBOX_NC_EXTRA if FREETZ_BUSYBOX_NC
	select FREETZ_BUSYBOX_NETSTAT
	select FREETZ_BUSYBOX_NO_DEBUG_LIB
	select FREETZ_BUSYBOX_NOHUP
	select FREETZ_BUSYBOX_PASSWD
	select FREETZ_BUSYBOX_PIDOF
	select FREETZ_BUSYBOX_PING
	select FREETZ_BUSYBOX_PIVOT_ROOT
	select FREETZ_BUSYBOX_PLATFORM_LINUX
	select FREETZ_BUSYBOX_POWEROFF
	select FREETZ_BUSYBOX_PRINTF
	select FREETZ_BUSYBOX_PS
	select FREETZ_BUSYBOX_PWD
	select FREETZ_BUSYBOX_REALPATH
	select FREETZ_BUSYBOX_REBOOT
	select FREETZ_BUSYBOX_RMDIR
	select FREETZ_BUSYBOX_RMMOD if !FREETZ_PACKAGE_MODULE_INIT_TOOLS_rmmod && !FREETZ_AVM_HAS_KMOD
	select FREETZ_BUSYBOX_RM
	select FREETZ_BUSYBOX_ROUTE
	select FREETZ_BUSYBOX_SED
	select FREETZ_BUSYBOX_SENDARP if FREETZ_AVM_HAS_SENDARP
	select FREETZ_BUSYBOX_SHOW_USAGE if FREETZ_BUSYBOX__RECOMMENDED
	select FREETZ_BUSYBOX_SLEEP
	select FREETZ_BUSYBOX_SORT
	select FREETZ_BUSYBOX_SPLIT
	select FREETZ_BUSYBOX_STAT
	select FREETZ_BUSYBOX_STTY if FREETZ_BUSYBOX__RECOMMENDED
	select FREETZ_BUSYBOX_STUN_IP if FREETZ_BUSYBOX__RECOMMENDED
	select FREETZ_BUSYBOX_SYNC
	select FREETZ_BUSYBOX_TAIL
	select FREETZ_BUSYBOX_TAR
	select FREETZ_BUSYBOX_TEE
	select FREETZ_BUSYBOX_TEST
	select FREETZ_BUSYBOX_TEST1
	select FREETZ_BUSYBOX_TEST2
	select FREETZ_BUSYBOX_FEATURE_TEST_64
	select FREETZ_BUSYBOX_TOP if FREETZ_BUSYBOX__RECOMMENDED
	select FREETZ_BUSYBOX_TOUCH
	select FREETZ_BUSYBOX_TRUE
	select FREETZ_BUSYBOX_TR
	select FREETZ_BUSYBOX_TTY
	select FREETZ_BUSYBOX_UMOUNT
	select FREETZ_BUSYBOX_UNAME
	select FREETZ_BUSYBOX_UPTIME
	select FREETZ_BUSYBOX_USE_BB_CRYPT
	select FREETZ_BUSYBOX_USE_BB_CRYPT_SHA if !FREETZ_TARGET_UCLIBC_0
	select FREETZ_BUSYBOX_UUDECODE if !FREETZ_STRIP_SCRIPTS
	select FREETZ_BUSYBOX_VCONFIG
	select FREETZ_BUSYBOX_VI if FREETZ_BUSYBOX__RECOMMENDED
	select FREETZ_BUSYBOX_WC
	select FREETZ_BUSYBOX_WHICH
	select FREETZ_BUSYBOX_WHOIS if FREETZ_BUSYBOX__RECOMMENDED
	select FREETZ_BUSYBOX_XARGS
	select FREETZ_BUSYBOX_YES
	select FREETZ_WGET if FREETZ_BUSYBOX__RECOMMENDED
	help
		Selects everything Freetz needs to run properly

config FREETZ_BUSYBOX__MANDATORY_05_2X
	bool # mandatory (since Fritz!OS 5.20)"
	depends on FREETZ_AVM_VERSION_05_2X_MIN
	select FREETZ_BUSYBOX_ARP
	select FREETZ_BUSYBOX_ARPING
	select FREETZ_BUSYBOX_BRCTL
	select FREETZ_BUSYBOX_BUNZIP2
	select FREETZ_BUSYBOX_BZCAT
	select FREETZ_BUSYBOX_BZIP2
	select FREETZ_BUSYBOX_CHGRP
	select FREETZ_BUSYBOX_CHROOT
	select FREETZ_BUSYBOX_FEATURE_BRCTL_FANCY # used by /etc/ath/*
	select FREETZ_BUSYBOX_FEATURE_BRCTL_SHOW  # used by /etc/ath/*
	select FREETZ_BUSYBOX_FEATURE_DD_IBS_OBS  # used by /var/install since Fritz!OS 6.5
	#
	# also enabled in AVM .config but (it looks like) unused (see ifconfig --help)
	select FREETZ_BUSYBOX_FEATURE_IFCONFIG_SLIP if FREETZ_BUSYBOX__RECOMMENDED
	select FREETZ_BUSYBOX_FEATURE_IFCONFIG_MEMSTART_IOADDR_IRQ if FREETZ_BUSYBOX__RECOMMENDED
	#
	select FREETZ_BUSYBOX_FEATURE_IP_ADDRESS
	select FREETZ_BUSYBOX_IPADDR
	select FREETZ_BUSYBOX_FEATURE_IP_LINK
	select FREETZ_BUSYBOX_IPLINK
	select FREETZ_BUSYBOX_FEATURE_IP_ROUTE
	select FREETZ_BUSYBOX_IPROUTE
	select FREETZ_BUSYBOX_FEATURE_IP_RULE
	select FREETZ_BUSYBOX_IPRULE
	select FREETZ_BUSYBOX_FEATURE_IP_TUNNEL
	select FREETZ_BUSYBOX_IPTUNNEL
	#
	# also enabled in AVM .config but (it looks like) unused (see mount/umount --help)
	select FREETZ_BUSYBOX_FEATURE_MOUNT_FAKE if FREETZ_BUSYBOX__RECOMMENDED
	select FREETZ_BUSYBOX_FEATURE_MOUNT_HELPERS if FREETZ_BUSYBOX__RECOMMENDED
	select FREETZ_BUSYBOX_FEATURE_MOUNT_LABEL if FREETZ_BUSYBOX__RECOMMENDED
	select FREETZ_BUSYBOX_FEATURE_MOUNT_OTHERTAB if FREETZ_BUSYBOX__RECOMMENDED
	select FREETZ_BUSYBOX_FEATURE_MTAB_SUPPORT if FREETZ_BUSYBOX__RECOMMENDED
	#
	# also enabled in AVM .config but (it looks like) unused (see netstat --help)
	select FREETZ_BUSYBOX_FEATURE_NETSTAT_WIDE if FREETZ_BUSYBOX__RECOMMENDED
	#
	select FREETZ_BUSYBOX_FEATURE_READLINK_FOLLOW
	select FREETZ_BUSYBOX_FEATURE_SHOW_THREADS if FREETZ_AVM_UCLIBC_NPTL_ENABLED
	#
	# enabled in AVM .config but (it looks like) unused (see sort --help)
	# select FREETZ_BUSYBOX_FEATURE_SORT_BIG
	#
	select FREETZ_BUSYBOX_MKSWAP
	select FREETZ_BUSYBOX_SWAPOFF
	select FREETZ_BUSYBOX_SWAPON
	# also enabled in AVM .config but (it looks like) unused (see swapon --help)
	select FREETZ_BUSYBOX_FEATURE_SWAPONOFF_LABEL if FREETZ_BUSYBOX__RECOMMENDED && !FREETZ_BUSYBOX__VERSION_V127
	select FREETZ_BUSYBOX_FEATURE_SWAPON_PRI if FREETZ_BUSYBOX__RECOMMENDED
	#
	select FREETZ_BUSYBOX_FEATURE_TFTP_GET
	select FREETZ_BUSYBOX_FEATURE_TFTP_PUT
	select FREETZ_BUSYBOX_FGCONSOLE
	select FREETZ_BUSYBOX_FLOCK
	select FREETZ_BUSYBOX_FTPGET
	select FREETZ_BUSYBOX_FTPPUT
	select FREETZ_BUSYBOX_FEATURE_FTPGETPUT_LONG_OPTIONS if FREETZ_BUSYBOX__RECOMMENDED
	select FREETZ_BUSYBOX_GROUPS
	#
	# enabled in AVM .config but (it looks like) unused
	# select FREETZ_BUSYBOX_INCLUDE_SUSv2
	#
	select FREETZ_BUSYBOX_IOSTAT
	select FREETZ_BUSYBOX_IP
	select FREETZ_BUSYBOX_FEATURE_IFUPDOWN_IP if FREETZ_BUSYBOX__RECOMMENDED
	select FREETZ_BUSYBOX_KILL
	select FREETZ_BUSYBOX_KILLALL5
	select FREETZ_BUSYBOX_LOGNAME
	select FREETZ_BUSYBOX_MORE
	select FREETZ_BUSYBOX_MPSTAT
	select FREETZ_BUSYBOX_NBDCLIENT
	select FREETZ_BUSYBOX_NC
	select FREETZ_BUSYBOX_NICE
	select FREETZ_BUSYBOX_NSLOOKUP if !FREETZ_PACKAGE_BIND_NSLOOKUP
	select FREETZ_BUSYBOX_PMAP
	select FREETZ_BUSYBOX_PRINTENV
	select FREETZ_BUSYBOX_PSTREE
	select FREETZ_BUSYBOX_PWDX
	select FREETZ_BUSYBOX_READLINK
	select FREETZ_BUSYBOX_RENICE
	select FREETZ_BUSYBOX_RESET
	select FREETZ_BUSYBOX_SEQ
	select FREETZ_BUSYBOX_SETCONSOLE
	select FREETZ_BUSYBOX_SETSERIAL
	select FREETZ_BUSYBOX_SMEMCAP
	select FREETZ_BUSYBOX_SWITCH_ROOT
	select FREETZ_BUSYBOX_TFTP
	select FREETZ_BUSYBOX_TIME
	select FREETZ_BUSYBOX_TRACEROUTE
	select FREETZ_BUSYBOX_TRACEROUTE6 if FREETZ_BUSYBOX__RECOMMENDED && FREETZ_TARGET_IPV6_SUPPORT
	select FREETZ_BUSYBOX_FEATURE_TRACEROUTE_USE_ICMP if FREETZ_BUSYBOX__RECOMMENDED
	select FREETZ_BUSYBOX_FEATURE_TRACEROUTE_VERBOSE if FREETZ_BUSYBOX__RECOMMENDED
	select FREETZ_BUSYBOX_UNIQ
	select FREETZ_BUSYBOX_UNXZ
	select FREETZ_BUSYBOX_XZCAT
	select FREETZ_BUSYBOX_UNZIP
	select FREETZ_BUSYBOX_XZ
	help
		Selects everything needed to run properly with Fritz!OS 5.20 and up

config FREETZ_BUSYBOX__MANDATORY_06_5X
	bool # mandatory (since Fritz!OS 6.50)"
	depends on FREETZ_AVM_VERSION_06_5X_MIN
	select FREETZ_BUSYBOX_BASE64 # used for extended support data in supportdata.tffs
	select FREETZ_BUSYBOX_FEATURE_MODPROBE_BLACKLIST if !FREETZ_PACKAGE_MODULE_INIT_TOOLS_modprobe && !FREETZ_AVM_HAS_KMOD
	select FREETZ_BUSYBOX_FEATURE_MODUTILS_ALIAS if !FREETZ_PACKAGE_MODULE_INIT_TOOLS_modprobe && !FREETZ_AVM_HAS_KMOD
	select FREETZ_BUSYBOX_FEATURE_MODUTILS_SYMBOLS if !FREETZ_PACKAGE_MODULE_INIT_TOOLS_modprobe && !FREETZ_AVM_HAS_KMOD
	select FREETZ_BUSYBOX_FEATURE_RTMINMAX
	select FREETZ_BUSYBOX_LSOF
	help
		Selects everything needed to run properly with Fritz!OS 6.50 and up

config FREETZ_BUSYBOX__MANDATORY_07_0X
	bool # mandatory (since Fritz!OS 7.00)"
	depends on FREETZ_AVM_VERSION_07_0X_MIN
	select FREETZ_BUSYBOX_AR
	select FREETZ_BUSYBOX_CPIO
	select FREETZ_BUSYBOX_FSTRIM
	select FREETZ_BUSYBOX_FUSER
	select FREETZ_BUSYBOX_MKTEMP
	select FREETZ_BUSYBOX_OD
	select FREETZ_BUSYBOX_SHA3SUM
	select FREETZ_BUSYBOX_TASKSET
	select FREETZ_BUSYBOX_UNICODE_SUPPORT
	select FREETZ_BUSYBOX_USERS
	select FREETZ_BUSYBOX_USLEEP
	select FREETZ_BUSYBOX_WHOAMI
	select FREETZ_BUSYBOX_WHO
	#
	select FREETZ_BUSYBOX_INCLUDE_SUSv2
	select FREETZ_BUSYBOX_USE_BB_PWD_GRP                         if FREETZ_AVM_HAS_NSSWITCH
	select FREETZ_BUSYBOX_USE_BB_SHADOW                          if FREETZ_AVM_HAS_NSSWITCH
	#
	select FREETZ_BUSYBOX_FEATURE_DD_STATUS                      if FREETZ_BUSYBOX__RECOMMENDED
	select FREETZ_BUSYBOX_FEATURE_DF_FANCY                       if FREETZ_BUSYBOX__RECOMMENDED
	select FREETZ_BUSYBOX_FEATURE_ENV_LONG_OPTIONS               if FREETZ_BUSYBOX__RECOMMENDED && !FREETZ_BUSYBOX__VERSION_V127
	select FREETZ_BUSYBOX_FEATURE_INIT_SCTTY
	select FREETZ_BUSYBOX_FEATURE_LS_COLOR                       if FREETZ_BUSYBOX__RECOMMENDED
	select FREETZ_BUSYBOX_FEATURE_MKDIR_LONG_OPTIONS             if FREETZ_BUSYBOX__RECOMMENDED && !FREETZ_BUSYBOX__VERSION_V127
	select FREETZ_BUSYBOX_FEATURE_MV_LONG_OPTIONS                if FREETZ_BUSYBOX__RECOMMENDED && !FREETZ_BUSYBOX__VERSION_V127
	select FREETZ_BUSYBOX_FEATURE_RMDIR_LONG_OPTIONS             if FREETZ_BUSYBOX__RECOMMENDED && !FREETZ_BUSYBOX__VERSION_V127
	select FREETZ_BUSYBOX_FEATURE_USE_SENDFILE                   if FREETZ_KERNEL_VERSION_3_MIN
	select FREETZ_BUSYBOX_FEATURE_SEAMLESS_BZ2                   if FREETZ_BUSYBOX__RECOMMENDED
	select FREETZ_BUSYBOX_FEATURE_SEAMLESS_LZMA                  if FREETZ_BUSYBOX__RECOMMENDED
	select FREETZ_BUSYBOX_FEATURE_SEAMLESS_XZ                    if FREETZ_BUSYBOX__RECOMMENDED
	select FREETZ_BUSYBOX_FEATURE_SEAMLESS_Z                     if FREETZ_BUSYBOX__RECOMMENDED
	select FREETZ_BUSYBOX_FEATURE_SETCONSOLE_LONG_OPTIONS        if FREETZ_BUSYBOX__RECOMMENDED && !FREETZ_BUSYBOX__VERSION_V127
	select FREETZ_BUSYBOX_FEATURE_TASKSET_FANCY
	select FREETZ_BUSYBOX_FEATURE_TAR_OLDSUN_COMPATIBILITY
	select FREETZ_BUSYBOX_FEATURE_TAR_TO_COMMAND                 if FREETZ_BUSYBOX__RECOMMENDED && !FREETZ_BUSYBOX__VERSION_V127
	select FREETZ_BUSYBOX_FEATURE_TAR_UNAME_GNAME
	select FREETZ_BUSYBOX_FEATURE_TOUCH_NODEREF
	select FREETZ_BUSYBOX_FEATURE_UTMP                           if FREETZ_BUSYBOX__RECOMMENDED
	select FREETZ_BUSYBOX_FEATURE_VERBOSE                        if FREETZ_BUSYBOX__RECOMMENDED
	select FREETZ_BUSYBOX_FEATURE_WGET_LONG_OPTIONS              if FREETZ_BUSYBOX__RECOMMENDED && FREETZ_BUSYBOX_WGET
	select FREETZ_BUSYBOX_FEATURE_WGET_OPENSSL                   if FREETZ_BUSYBOX__RECOMMENDED && FREETZ_BUSYBOX_WGET
	select FREETZ_BUSYBOX_VERBOSE_RESOLUTION_ERRORS              if FREETZ_BUSYBOX__RECOMMENDED
	#
	select FREETZ_BUSYBOX_BBCONFIG                               if FREETZ_BUSYBOX__RECOMMENDED
	select FREETZ_BUSYBOX_FEATURE_COMPRESS_BBCONFIG              if FREETZ_BUSYBOX__RECOMMENDED && FREETZ_BUSYBOX_BZIP2
	#
	select FREETZ_BUSYBOX_INETD
	select FREETZ_BUSYBOX_FEATURE_INETD_RPC                      if FREETZ_TARGET_UCLIBC_SUPPORTS_rpc
	select FREETZ_BUSYBOX_FEATURE_INETD_SUPPORT_BUILTIN_CHARGEN  if FREETZ_BUSYBOX__RECOMMENDED
	select FREETZ_BUSYBOX_FEATURE_INETD_SUPPORT_BUILTIN_DAYTIME  if FREETZ_BUSYBOX__RECOMMENDED
	select FREETZ_BUSYBOX_FEATURE_INETD_SUPPORT_BUILTIN_DISCARD  if FREETZ_BUSYBOX__RECOMMENDED
	select FREETZ_BUSYBOX_FEATURE_INETD_SUPPORT_BUILTIN_ECHO     if FREETZ_BUSYBOX__RECOMMENDED
	select FREETZ_BUSYBOX_FEATURE_INETD_SUPPORT_BUILTIN_TIME     if FREETZ_BUSYBOX__RECOMMENDED
	#
	# Enabled in (some) AVM .config but not used by default with Freetz.
	# Selected conditional by _INETD + _FEATURE_INETD_RPC
	# select FREETZ_BUSYBOX_FEATURE_HAVE_RPC                     if FREETZ_BUSYBOX__VERSION_V127
	#
	# enabled in AVM .config but does not exists in used Busybox versions anymore
	# select FREETZ_BUSYBOX_FEATURE_EXTRA_QUIET
	#
	# enabled in AVM .config but (it looks like) unused
	# select FREETZ_BUSYBOX_UDHCPC
	#
	# enabled in AVM .config but binarys exists
	# select FREETZ_BUSYBOX_NANDDUMP
	#
	# select FREETZ_BUSYBOX_UBIRENAME
	# enabled in AVM .config but binarys exists
	# select FREETZ_BUSYBOX_UBIATTACH
	# select FREETZ_BUSYBOX_UBIDETACH
	# select FREETZ_BUSYBOX_UBIMKVOL
	# select FREETZ_BUSYBOX_UBIRMVOL
	# select FREETZ_BUSYBOX_UBIRSVOL
	# select FREETZ_BUSYBOX_UBIUPDATEVOL
	#
	help
		Selects everything needed to run properly with Fritz!OS 7.00 and up

config FREETZ_BUSYBOX__MANDATORY_07_2X
	bool # mandatory (since Fritz!OS 7.20)"
	depends on FREETZ_AVM_VERSION_07_2X_MIN
	select FREETZ_BUSYBOX_STACK_OPTIMIZATION_386           if !FREETZ_BUSYBOX__VERSION_V127
	select FREETZ_BUSYBOX_FEATURE_EDITING_WINCH            if !FREETZ_BUSYBOX__VERSION_V127
	select FREETZ_BUSYBOX_FEATURE_UNZIP_CDF
	select FREETZ_BUSYBOX_FACTOR
	select FREETZ_BUSYBOX_FEATURE_XARGS_SUPPORT_ARGS_FILE  if !FREETZ_BUSYBOX__VERSION_V127
	select FREETZ_BUSYBOX_FEATURE_WAIT_FOR_INIT            if !FREETZ_BUSYBOX__VERSION_V127
	select FREETZ_BUSYBOX_FEATURE_INIT_QUIET
	select FREETZ_BUSYBOX_FEATURE_INIT_MODIFY_CMDLINE
	select FREETZ_BUSYBOX_HEXDUMP
	select FREETZ_BUSYBOX_FEATURE_HEXDUMP_REVERSE
	select FREETZ_BUSYBOX_XXD
	select FREETZ_BUSYBOX_FEATURE_VOLUMEID_EXFAT
	select FREETZ_BUSYBOX_FEATURE_VOLUMEID_F2FS
	select FREETZ_BUSYBOX_FEATURE_WGET_HTTPS               if FREETZ_BUSYBOX_WGET
	select FREETZ_BUSYBOX_ASH_BASH_NOT_FOUND_HOOK          if !FREETZ_BUSYBOX__VERSION_V127
	select FREETZ_BUSYBOX_FEATURE_SH_READ_FRAC             if !FREETZ_BUSYBOX__VERSION_V127
	select FREETZ_BUSYBOX_FEATURE_SH_HISTFILESIZE
	select FREETZ_BUSYBOX_CHRT
	select FREETZ_BUSYBOX_NETCAT
	select FREETZ_BUSYBOX_TCPSVD
	select FREETZ_BUSYBOX_TIMEOUT
	help
		Selects everything needed to run properly with Fritz!OS 7.20 and up

config FREETZ_BUSYBOX__MANDATORY_07_5X
	bool # mandatory (since Fritz!OS 7.50)"
	depends on FREETZ_AVM_VERSION_07_5X_MIN
	select FREETZ_BUSYBOX_BC
	select FREETZ_BUSYBOX_DEVMEM
	select FREETZ_BUSYBOX_I2CTRANSFER
	select FREETZ_BUSYBOX_MICROCOM
	select FREETZ_BUSYBOX_TFTPD
	select FREETZ_BUSYBOX_TS
	select FREETZ_BUSYBOX_FEATURE_SH_EMBEDDED_SCRIPTS
	select FREETZ_BUSYBOX_NOLOGIN
	select FREETZ_BUSYBOX_UDPSVD
	help
		Selects everything needed to run properly with Fritz!OS 7.50 and up

config FREETZ_BUSYBOX__MANDATORY_08_0X
	bool # mandatory (since Fritz!OS 8.00)"
	depends on FREETZ_AVM_VERSION_08_0X_MIN
	select FREETZ_BUSYBOX_SEEDRNG
	select FREETZ_BUSYBOX_TREE
	select FREETZ_BUSYBOX_TSORT
	help
		Selects everything needed to run properly with Fritz!OS 8.00 and up

#config FREETZ_BUSYBOX__NOEXEC_NOFORK_OPTIMIZATIONS
#	bool "enable NOEXEC/NOFORK performance optimizations"
#	depends on !FREETZ_BUSYBOX__KEEP_BINARIES
#	default n
#	select FREETZ_BUSYBOX_FEATURE_PREFER_APPLETS
#	select FREETZ_BUSYBOX_FEATURE_SH_NOFORK
#	select FREETZ_BUSYBOX_FEATURE_SH_STANDALONE
#	help
#		This option causes busybox' NOEXEC/NOFORK optimizations to be enabled,
#		see https://git.busybox.net/busybox/plain/docs/nofork_noexec.txt
#		for more details.
#
#		This option is known to sometimes cause compatibility issues with
#		AVM's startup scripts. Try disabling this option if you experience
#		problems like
#		 - non-finishing /etc/init.d/rc.S
#		 - or non-rebooting box

config FREETZ_BUSYBOX__BUILD_TIMESTAMP
	bool "allow build timestamp in banner"
	depends on !FREETZ_REPRODUCIBLE
	default y
	help
		no build timestamp allows reproducible binary

config FREETZ_BUSYBOX__KEEP_BINARIES
	bool "keep binaries - DEVELOPER" if FREETZ_SHOW_DEVELOPER
	default y
	help
		Rename applet links to $NAME-busybox if a file $NAME exists.

config FREETZ_BUSYBOX__IPV6_UTILS
	bool # IPv6
	depends on FREETZ_TARGET_IPV6_SUPPORT
	select FREETZ_BUSYBOX_FEATURE_IPV6
	select FREETZ_BUSYBOX_FEATURE_IFUPDOWN_IPV6
	select FREETZ_BUSYBOX_FEATURE_PREFER_IPV4_ADDRESS
	select FREETZ_BUSYBOX_PING6
	select FREETZ_BUSYBOX_FEATURE_IP_NEIGH if FREETZ_KERNEL_VERSION_2_6_19_MIN
	select FREETZ_BUSYBOX_IPNEIGH if FREETZ_KERNEL_VERSION_2_6_19_MIN
	help
		Selects everything Freetz needs to run properly

config FREETZ_BUSYBOX__PACKER
	bool "file (un)packer"
	select FREETZ_BUSYBOX_BASE64
	select FREETZ_BUSYBOX_BUNZIP2
	select FREETZ_BUSYBOX_BZIP2
	select FREETZ_BUSYBOX_FEATURE_SEAMLESS_BZ2
	select FREETZ_BUSYBOX_FEATURE_SEAMLESS_LZMA
	select FREETZ_BUSYBOX_FEATURE_SEAMLESS_XZ
	select FREETZ_BUSYBOX_FEATURE_TAR_AUTODETECT
	select FREETZ_BUSYBOX_LZMA
	select FREETZ_BUSYBOX_UNLZMA
	select FREETZ_BUSYBOX_UNXZ
	select FREETZ_BUSYBOX_UNZIP
	select FREETZ_BUSYBOX_UUENCODE
	select FREETZ_BUSYBOX_XZ if !FREETZ_PACKAGE_XZ
	#
	select FREETZ_BUSYBOX_FEATURE_SEAMLESS_LZ if FREETZ_BUSYBOX_LZIP
	select FREETZ_BUSYBOX_LUNZIP              if FREETZ_BUSYBOX_LZIP
	help
		Selects base64, b(un)zip2, unlzma, unzip, unxz,
		uuencode and some tar features.

config FREETZ_BUSYBOX__NETWORK
	bool "network tools"
	select FREETZ_BUSYBOX_ARP
	select FREETZ_BUSYBOX_ARPING
	select FREETZ_BUSYBOX_FTPGET
	select FREETZ_BUSYBOX_FTPPUT
	select FREETZ_BUSYBOX_FEATURE_FTPGETPUT_LONG_OPTIONS
	select FREETZ_BUSYBOX_NC
	select FREETZ_BUSYBOX_NC_SERVER
	select FREETZ_BUSYBOX_NTPD
	select FREETZ_BUSYBOX_NSLOOKUP if !FREETZ_PACKAGE_BIND_NSLOOKUP
	select FREETZ_BUSYBOX_RDATE
	select FREETZ_BUSYBOX_TRACEROUTE
	select FREETZ_BUSYBOX_TRACEROUTE6 if FREETZ_TARGET_IPV6_SUPPORT
	select FREETZ_BUSYBOX_FEATURE_TRACEROUTE_USE_ICMP
	select FREETZ_BUSYBOX_FEATURE_TRACEROUTE_VERBOSE
	help
		Selects arp, arping, ether-wake, ftpget, ftpput,
		nc, nslookup, rdate, traceroute.

config FREETZ_BUSYBOX__TERMINAL
	bool "terminal helper"
	select FREETZ_BUSYBOX_CLEAR
	select FREETZ_BUSYBOX_FEATURE_LESS_BRACKETS
	select FREETZ_BUSYBOX_FEATURE_LESS_FLAGS
	select FREETZ_BUSYBOX_FEATURE_LESS_REGEXP
	select FREETZ_BUSYBOX_FEATURE_LS_COLOR
	select FREETZ_BUSYBOX_FEATURE_LS_COLOR_IS_DEFAULT
	select FREETZ_BUSYBOX_FEATURE_TELNET_AUTOLOGIN
	select FREETZ_BUSYBOX_FEATURE_TELNET_TTYPE
	select FREETZ_BUSYBOX_LESS
	select FREETZ_BUSYBOX_MORE
	select FREETZ_BUSYBOX_RESET
	select FREETZ_BUSYBOX_TELNET
	help
		Selects clear, less, ls-color, more, reset, telnet.

config FREETZ_BUSYBOX__DEVELOPER
	bool "developer tools"
	select FREETZ_BUSYBOX_BEEP
	select FREETZ_BUSYBOX_FEATURE_DD_STATUS
	select FREETZ_BUSYBOX_DIFF
	select FREETZ_BUSYBOX_FEATURE_DIFF_BINARY
	select FREETZ_BUSYBOX_FEATURE_DIFF_DIR
	select FREETZ_BUSYBOX_FEATURE_DIFF_MINIMAL
	select FREETZ_BUSYBOX_FEATURE_MD5_SHA1_SUM_CHECK
	select FREETZ_BUSYBOX_DOS2UNIX
	select FREETZ_BUSYBOX_HEXDUMP
	select FREETZ_BUSYBOX_LSOF if !FREETZ_PACKAGE_LSOF
	select FREETZ_BUSYBOX_MD5SUM
	select FREETZ_BUSYBOX_MODINFO if !FREETZ_PACKAGE_MODULE_INIT_TOOLS_modinfo
	select FREETZ_BUSYBOX_PATCH
	select FREETZ_BUSYBOX_SHA1SUM
	select FREETZ_BUSYBOX_SHA256SUM
	select FREETZ_BUSYBOX_SHA512SUM
	select FREETZ_BUSYBOX_STRINGS
	select FREETZ_BUSYBOX_TIME
	help
		Selects diff (with some features), dos2unix, hexdump,
		lsof, md5sum with sum-check, modinfo, patch, strings,
		sha1sum, sha256sum, sha512sum and time.

config FREETZ_BUSYBOX__ADDITIONAL
	bool "additional binary - DEVELOPER"
	depends on FREETZ_SHOW_DEVELOPER
	default n
	select FREETZ_BUSYBOX__KEEP_BINARIES
	help
		Installs the binary as busybox-freetz, adds only
		new applet-links with default name and does not
		replace existing links but creates $NAME-freetz.
		If the target link is a file see 'keep binaries'.
		This option is to check for busybox problems and
		should only be used with attached serial console
		as errors are expected.
		This 2nd busybox needs about 1MB additional.

comment ""

source "make/busybox/Config.in.symbools"
source "make/busybox/Config.in.busybox"
```
