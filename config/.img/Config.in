## make/ccid/Config.in
```kconfig
config FREETZ_PACKAGE_CCID
	bool "CCID 1.5.0"
	select FREETZ_LIB_libpthread if FREETZ_TARGET_UCLIBC_HAS_multiple_libs
	select FREETZ_LIB_libusb_1
	select FREETZ_PACKAGE_PCSC_LITE
	default n
	help
		ccid provides the source code for a generic USB
		CCID (Chip/Smart Card Interface Devices) driver and
		ICCD (Integrated Circuit(s) Card Devices).
```

## make/lcd4linux/Config.in
```kconfig
config FREETZ_PACKAGE_LCD4LINUX
	bool "LCD4linux e2cfdc5-git"
	select FREETZ_LIB_libncurses
	select FREETZ_LIB_libgd
	select FREETZ_LIB_libjpeg
	select FREETZ_LIB_libusb_0
	select FREETZ_LIB_libusb_1
	select FREETZ_LIB_libftdi
	default n
	help
		LCD4Linux is a small program that grabs information
		from the kernel and some subsystems and displays it
		on an external liquid crystal display.
```

## make/libs/Config.in
```kconfig
menu "Apache Portable Runtime libs"
	source "make/libs/apr/Config.in"
	source "make/libs/apr-util/Config.in"
endmenu ### "Apache Portable Runtime libs"

menu "Avahi libraries"
	source "make/pkgs/avahi/Config.in.libs"
endmenu ### "Avahi libraries"

menu "Charsets & Internationalization"
	source "make/pkgs/iconv/Config.in.libs"
	source "make/libs/gettext/Config.in"
	source "make/libs/fribidi/Config.in"
	source "make/libs/utf8proc/Config.in"
endmenu ### "Charsets & Internationalization"

menu "Crypto & SSL"
	comment "GnuPG ----------------------------------"
		source "make/libs/libgpg-error/Config.in"
		source "make/libs/libgcrypt/Config.in"
	comment "GnuTLS ---------------------------------"
		source "make/pkgs/gnutls/Config.in.libs"
		source "make/libs/libtasn1/Config.in"
	comment "mbed TLS -------------------------------"
		source "make/libs/mbedtls/Config.in"
	comment "Nettle ---------------------------------"
		source "make/libs/nettle/Config.in"
	comment "OpenSSL --------------------------------"
		source "make/pkgs/openssl/Config.in.libs"
		source "make/libs/libavmhmac/Config.in"
	comment "PolarSSL -------------------------------"
		source "make/libs/polarssl12/Config.in"
		source "make/libs/polarssl13/Config.in"
	comment "Misc -----------------------------------"
		source "make/libs/gsasl/Config.in"
		source "make/libs/libssh2/Config.in"
endmenu ### "Crypto & SSL"

menu "Data compression"
	source "make/libs/libdeflate/Config.in"
	source "make/libs/lz4/Config.in"
	source "make/libs/lzo/Config.in"
	source "make/pkgs/xz/Config.in.libs"
	source "make/libs/zlib/Config.in"
endmenu ### "Data compression"

menu "Database"
	source "make/libs/db/Config.in"
	source "make/libs/libmaxminddb/Config.in"
	source "make/pkgs/sqlite/Config.in.libs"
endmenu ### "Database"

menu "File systems"
	source "make/pkgs/e2fsprogs/Config.in.libs"
	source "make/pkgs/fuse/Config.in.libs"
	source "make/pkgs/ntfs/Config.in.libs"
endmenu ### "File systems"

menu "Freetz"
	source "make/libs/libctlmgr/Config.in"
	source "make/libs/libmultid/Config.in"
endmenu ### "Freetz"

menu "GCC"
	source "make/libs/libatomic/Config.in"
	source "make/libs/libgcc_s/Config.in"
	source "make/libs/libstdcxx/Config.in"
endmenu ### "GCC"

menu "GLib"
	source "make/libs/glib2/Config.in"
endmenu ### "GLib"

menu "Graphics & fonts"
	source "make/libs/cairo/Config.in"
	source "make/pkgs/fontconfig/Config.in.libs"
	source "make/libs/freetype/Config.in"
	source "make/libs/harfbuzz/Config.in"
	source "make/libs/libart_lgpl/Config.in"
	source "make/libs/libexif/Config.in"
	source "make/libs/jpeg/Config.in"
	source "make/libs/leptonica/Config.in"
	source "make/libs/libpng/Config.in"
	source "make/libs/libgd/Config.in"
	source "make/libs/openjpeg/Config.in"
	source "make/libs/openjp2/Config.in"
	source "make/libs/pango/Config.in"
	source "make/libs/pixman/Config.in"
	source "make/pkgs/tesseract/Config.in.libs"
	source "make/pkgs/tiff/Config.in.libs"
	source "make/pkgs/netpbm/Config.in.libs"
endmenu ### "Graphics & fonts"

menu "Multi precision arithmetic libs"
	source "make/libs/gmp/Config.in"
	source "make/libs/mpfr/Config.in"
	source "make/libs/mpc/Config.in"
endmenu ### "Multi precision arithmetic libs"

menu "Multimedia"
	source "make/libs/libdvbcsa/Config.in"
	menu "Audio and video codecs"
		menu "Audio codecs"
			source "make/libs/flac/Config.in"
			source "make/libs/libmad/Config.in"
			source "make/libs/libogg/Config.in"
			source "make/libs/opus/Config.in"
			source "make/libs/speex/Config.in"
		endmenu
		source "make/pkgs/ffmpeg/Config.in.libs"
		menu "Video codecs"
			comment "Vorbis video codec ---------------------"
			source "make/libs/libvorbis/Config.in"
		endmenu
	endmenu ## "Audio and video codecs"
	menu "ID3 tag reading libs"
		source "make/libs/libid3tag/Config.in"
		source "make/libs/taglib/Config.in"
	endmenu ## "ID3 tag reading libs"
endmenu ### "Multimedia"

menu "ncurses"
	source "make/libs/ncurses/Config.in"
	source "make/libs/ncursesw/Config.in"
endmenu ### "ncurses"

menu "Networking"
	comment "ATM ------------------------------------"
		source "make/libs/linux-atm/Config.in"
	comment "Bluetooth ------------------------------"
		source "make/libs/bluez-libs/Config.in"
		source "make/libs/openobex/Config.in"
	comment "ISDN & CAPI ----------------------------"
		source "make/libs/libcapi/Config.in"
	comment "Misc networking ------------------------"
		source "make/libs/libdnet/Config.in"
		source "make/libs/libgsm/Config.in"
		source "make/libs/iksemel/Config.in"
		source "make/libs/ldns/Config.in"
		source "make/libs/libmnl/Config.in"
		source "make/libs/libnet/Config.in"
		source "make/libs/liboping/Config.in"
		source "make/libs/libosip2/Config.in"
		source "make/libs/libpcap/Config.in"
		source "make/pkgs/unbound/Config.in.libs"
		source "make/libs/spandsp/Config.in"
		source "make/libs/srtp/Config.in"
		source "make/libs/libtirpc/Config.in"
		source "make/libs/udns/Config.in"
endmenu ### "Networking"

menu "PJ Project"
	source "make/libs/pjproject2/Config.in"
endmenu ### "PJ Project"

menu "Readline"
	source "make/libs/readline/Config.in"
endmenu ### "Readline"

menu "Regular expressions"
	source "make/libs/libonig/Config.in"
	source "make/libs/pcre/Config.in"
	source "make/libs/pcre2/Config.in"
endmenu ### "Regular expressions"

menu "uClibc"
	source "make/libs/uclibc/Config.in"
	source "make/libs/uclibcxx/Config.in"
endmenu ### "uClibc"

menu "USB & related"
	source "make/libs/libftdi/Config.in"
	source "make/pkgs/ftdi1/Config.in.libs"
	source "make/pkgs/pcsc-lite/Config.in.libs"
	source "make/libs/libusb/Config.in"
	source "make/libs/libusb1/Config.in"
endmenu ### "USB & related"

menu "Web and WebDAV"
	source "make/pkgs/curl/Config.in.libs"
	source "make/libs/libidn/Config.in"
	source "make/libs/jansson/Config.in"
	source "make/pkgs/js/Config.in.libs"
	source "make/libs/neon/Config.in"
	source "make/pkgs/psl/Config.in.libs"
	source "make/libs/serf/Config.in"
endmenu ### "Web and WebDAV"

menu "XML & XSLT"
	source "make/libs/expat/Config.in"
	source "make/libs/libxml2/Config.in"
	source "make/pkgs/xsltproc/Config.in.libs"
endmenu ### "XML & XSLT"

comment " ---"

menu "Other"
	source "make/libs/attr/Config.in"
	source "make/pkgs/bind/Config.in.libs"
	source "make/libs/libcap/Config.in"
	source "make/libs/libcap-ng/Config.in"
	source "make/libs/libconfig/Config.in"
	source "make/libs/libconfuse/Config.in"
	source "make/libs/libdaemon/Config.in"
	source "make/pkgs/dbus/Config.in.libs"
	source "make/libs/devmapper/Config.in"
	source "make/libs/libelf/Config.in"
	source "make/libs/libev/Config.in"
	source "make/libs/libevent/Config.in"
	source "make/libs/libffi/Config.in"
	source "make/pkgs/lua/Config.in.libs"
	source "make/libs/libnfsidmap/Config.in"
	source "make/libs/popt/Config.in"
	source "make/pkgs/privatekeypassword/Config.in.libs"
	source "make/libs/protobuf-c/Config.in"
	source "make/pkgs/python/Config.in.libs"
	source "make/pkgs/python3/Config.in.libs"
	source "make/pkgs/rrdtool/Config.in.libs"
	source "make/pkgs/slang/Config.in.libs"
	source "make/libs/libsynce/Config.in"
	source "make/libs/sysfsutils/Config.in"
	source "make/libs/libtool/Config.in"
	source "make/libs/liburcu/Config.in"
	source "make/libs/libuv/Config.in"
	source "make/libs/yaml/Config.in"
endmenu ### "Other"
```

## make/libs/expat/Config.in
```kconfig
menu "libexpat"

	choice
		prompt "Version"
			default FREETZ_LIB_libexpat_WITH_VERSION_CURRENT

		config FREETZ_LIB_libexpat_WITH_VERSION_ABANDON
			bool "2.7.5"
			depends on FREETZ_TARGET_GCC_5_MAX

		config FREETZ_LIB_libexpat_WITH_VERSION_CURRENT
			bool "2.8.1"
			depends on !FREETZ_TARGET_GCC_5_MAX

	endchoice

	config FREETZ_LIB_libexpat
		bool "libexpat (libexpat.so)"
		select FREETZ_LIB_libm if FREETZ_TARGET_UCLIBC_HAS_multiple_libs
		default n
		help
			This is Expat, a C library for parsing XML, written by James Clark.
			Expat is a stream-oriented XML parser. This means that you register
			handlers with the parser before starting the parse. These handlers
			are called when the parser discovers the associated structures in the
			document being parsed. A start tag is an example of the kind of
			structures for which you may register handlers.

endmenu # libexpat
```

## make/libs/gettext/Config.in
```kconfig
config FREETZ_LIB_libintl
	bool "Intl (libintl.so)"
	select FREETZ_LIB_libiconv if FREETZ_TARGET_UCLIBC_0_9_28
	default n
	help
		GNU Internationalization library
```

## make/libs/gsasl/Config.in
```kconfig
config FREETZ_LIB_libgsasl
	bool "libgsasl (libgsasl.so)"
	default n
	help
		GNU SASL is an implementation of the Simple Authentication and Security Layer framework
		and a few common SASL mechanisms. SASL is used by network servers (e.g., IMAP, SMTP, XMPP)
		to request authentication from clients, and in clients to authenticate against servers.
```

## make/libs/libbz2/Config.in
```kconfig
config FREETZ_LIB_libbz2
	bool "Bzip2 (libbz2.so)"
	default n
	help
		bzip2 is a freely available, patent free, high-quality data compressor.
		It typically compresses files to within 10% to 15% of the best available
		techniques (the PPM family of statistical compressors), whilst being around
		twice as fast at compression and six times faster at decompression.
```

## make/libs/libcap-ng/Config.in
```kconfig
config FREETZ_LIB_libcap_ng
	bool "libcap-ng (libcap-ng.so)"
	default n
	help
		The libcap-ng library should make programming with posix capabilities
		easier. The library has some utilities to help you analyse a system
		for apps that may have too much privileges.

config FREETZ_LIB_libdrop_ambient
	bool "libdrop_ambient (libdrop_ambient.so)"
	default n
	help
		This library can be used via LD_PRELOAD to force an application
		started with ambient capabilities to drop them. It leaves other
		capabilities intact. This can also be linked against and
		automatically does the right thing. You do not need to make any
		calls into the library because all the work is done in the
		constructor which runs before main() is called.
```

## make/libs/libctlmgr/Config.in
```kconfig
config FREETZ_LIB_libctlmgr
	bool "libctlmgr (libctlmgr.so)"
	depends on FREETZ_AVM_HAS_AVMCTLMGR_PRELOAD
	depends on ((FREETZ_AVM_VERSION_07_0X_MIN) || (FREETZ_AVM_VERSION_07_5X_MIN || FREETZ_AVM_HAS_USB_HOST))
	default n
	help
		This is Freetz compatibility library which overwrites
		functions of AVM's libraries, e.g. write_etc_passwd.

if FREETZ_LIB_libctlmgr

	config FREETZ_LIB_libctlmgr_WITH_CHMOD
		bool
		depends on ((FREETZ_AVM_VERSION_07_0X_MIN)                                                             )
		default n
		help
			Alters chmod() for /var/tmp

	config FREETZ_LIB_libctlmgr_WITH_RENAME
		bool
		depends on (                                  (FREETZ_AVM_VERSION_07_5X_MIN || FREETZ_AVM_HAS_USB_HOST))
		default n
		help
			Alters rename() for /etc/passwd

endif # FREETZ_LIB_libctlmgr
```

## make/libs/libev/Config.in
```kconfig
config FREETZ_LIB_libev
	bool "libev (libev.so)"
	select FREETZ_LIB_libm if FREETZ_TARGET_UCLIBC_HAS_multiple_libs
	default n
	help
		libev provides a full-featured and high-performance event loop
		that is loosely modelled after libevent. It includes relative timers,
		absolute timers with customized rescheduling, synchronous signals,
		process status change events, event watchers dealing with the event
		loop itself, file watchers, and even limited support for fork events.
		It uses a priority queue to manage timers and uses arrays as fundamental
		data structure. It has no artificial limitations on the number
		of watchers waiting for the same event.
```

## make/libs/libiconv/Config.in
```kconfig
config FREETZ_LIB_libiconv
	bool "Iconv (libiconv.so)"
	default n
	help
		This library provides an iconv() implementation, for use on systems
		which don't have one, or whose implementation cannot convert from/to
		Unicode.

if FREETZ_LIB_libiconv

	choice
		prompt "Version"
			default FREETZ_LIB_libiconv_WITH_VERSION_CURRENT

		config FREETZ_LIB_libiconv_WITH_VERSION_ABANDON
			bool "2.5.0 (from libiconv 1.13.1)"
			help
				Older version with charset-stripping patches.
				Library size optimized for embedded systems (~300KB).
				Includes only Western European + Unicode charsets.
				
				Note: If you select iconv package, its version will
				override this selection.

		config FREETZ_LIB_libiconv_WITH_VERSION_CURRENT
			bool "2.7.0 (from libiconv 1.18)"
			help
				Modern version without charset-stripping patches (~933KB).
				Library includes all charsets.
				Use build options menu to reduce size.
				
				Note: If you select iconv package, its version will
				override this selection.

	endchoice

menu "Build options (version 1.18 only)"
	depends on FREETZ_LIB_libiconv_WITH_VERSION_CURRENT

	config FREETZ_LIB_libiconv_DISABLE_NLS
		bool "Disable Native Language Support (NLS)"
		default y
		help
			Do not include translation files.
			Saves approximately 200KB.

	config FREETZ_LIB_libiconv_DISABLE_RELOCATABLE
		bool "Disable relocatable installation"
		default n
		help
			Remove runtime path relocation support.
			Saves approximately 30KB.
			Only disable if library location is fixed.

endmenu

endif # FREETZ_LIB_libiconv
```

## make/libs/libidn/Config.in
```kconfig
config FREETZ_LIB_libidn
	bool "libidn (libidn.so)"
	default n
	help
		GNU Libidn is a fully documented implementation of the Stringprep,
		Punycode and IDNA 2003 specifications. Libidn's purpose is to encode
		and decode internationalized domain names.
```

## make/libs/libmaxminddb/Config.in
```kconfig
config FREETZ_LIB_libmaxminddb
	bool "libmaxminddb (libmaxminddb.so)"
	default n
	help
		C library for the MaxMind DB file format.
		You'll need an additional .mmdb file, put it on storage.
		Get it here: https://github.com/P3TERX/GeoLite.mmdb/
```

## make/libs/libmultid/Config.in
```kconfig
config FREETZ_LIB_libmultid
	bool "libmultid (libmultid.so)"
	depends on FREETZ_AVM_HAS_AVMMULTID_PRELOAD
	default n
	help
		If this library is preloaded to multid,
		some portbindings will be remapped.

if FREETZ_LIB_libmultid

	choice
		prompt "Listen on"
			default FREETZ_LIB_libmultid_WITH_ANYIP

		config FREETZ_LIB_libmultid_WITH_ANYIP
			bool "any ip"
			help
				Remapped ports listen on any ip.
				This is multid's default.

		config FREETZ_LIB_libmultid_WITH_LOCAL
			bool "localhost"
			depends on FREETZ_AVM_VERSION_04_XX_MAX
			help
				Remapped ports listen on localhost.
				This could be more secure.

	endchoice # "Listen on" #

	config FREETZ_LIB_libmultid_WITH_DNS
		bool "Disable DNS"
		depends on FREETZ_AVMDAEMON_DISABLE_DNS
		default n
		help
			Remapps port 53.

	config FREETZ_LIB_libmultid_WITH_DHCP
		bool "Disable DHCP"
		depends on FREETZ_AVMDAEMON_DISABLE_DHCP
		default n
		help
			Remapps port 67.

	config FREETZ_LIB_libmultid_WITH_LLMNR
		bool "Disable LLMNR"
		depends on FREETZ_AVMDAEMON_DISABLE_LLMNR
		default n
		help
			Remapps port 5353 and 5355.

endif # FREETZ_LIB_libmultid
```
