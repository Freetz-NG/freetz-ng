## config/.kos/separate/Config.in
```kconfig
source "config/.kos/separate/config-alder-5690_07.62.in"
source "config/.kos/separate/config-alder-5690_08.01.in"
source "config/.kos/separate/config-ar10-3272_06.86.in"
source "config/.kos/separate/config-ar10-7272_06.20.in"
source "config/.kos/separate/config-ar10-7272_06.87.in"
source "config/.kos/separate/config-ar7-04.30.in"
source "config/.kos/separate/config-ar7-04.33.in"
source "config/.kos/separate/config-ar7-04.40.in"
source "config/.kos/separate/config-ar7-04.49.in"
source "config/.kos/separate/config-ar934x-0546_07.12.in"
source "config/.kos/separate/config-ar934x-6810_06.21.in"
source "config/.kos/separate/config-ar9-7320_06.30.in"
source "config/.kos/separate/config-ar9-7330_06.50.in"
source "config/.kos/separate/config-bcm63138-7581_07.18.in"
source "config/.kos/separate/config-brcma9-7539_07.29.in"
source "config/.kos/separate/config-brcma9-7539_07.56.in"
source "config/.kos/separate/config-brcma9-7539_08.00.in"
source "config/.kos/separate/config-grx5-5530_07.29.in"
source "config/.kos/separate/config-grx5-5530_07.50.in"
source "config/.kos/separate/config-grx5-5530_08.00.in"
source "config/.kos/separate/config-grx5-7580_06.53.in"
source "config/.kos/separate/config-grx5-7580_06.81.in"
source "config/.kos/separate/config-grx5-7583_07.10.in"
source "config/.kos/separate/config-grx5-7590_06.92.in"
source "config/.kos/separate/config-grx5-7590_07.01.in"
source "config/.kos/separate/config-grx5-7590_07.25.in"
source "config/.kos/separate/config-grx5-7590_07.50.in"
source "config/.kos/separate/config-grx5-7590_07.56.in"
source "config/.kos/separate/config-grx5-7599_08.00.in"
source "config/.kos/separate/config-iks-7340_06.06.in"
source "config/.kos/separate/config-iks-7369_06.33.in"
source "config/.kos/separate/config-iks-7390_05.21.in"
source "config/.kos/separate/config-iks-7390_06.01.in"
source "config/.kos/separate/config-iks-7390_06.30.in"
source "config/.kos/separate/config-iks-7390_06.51.in"
source "config/.kos/separate/config-iks-7390_06.80.in"
source "config/.kos/separate/config-ipq40xx-1200_07.14.in"
source "config/.kos/separate/config-ipq40xx-1200_07.27.in"
source "config/.kos/separate/config-ipq40xx-1200_07.50.in"
source "config/.kos/separate/config-ipq40xx-4040_07.01.in"
source "config/.kos/separate/config-ipq40xx-4040_07.14.in"
source "config/.kos/separate/config-ipq40xx-4040_07.29.in"
source "config/.kos/separate/config-ipq40xx-4040_07.56.in"
source "config/.kos/separate/config-ipq40xx-4040_08.00.in"
source "config/.kos/separate/config-ipq40xx-7530_07.02.in"
source "config/.kos/separate/config-ipq40xx-7530_07.25.in"
source "config/.kos/separate/config-ipq40xx-7530_07.50.in"
source "config/.kos/separate/config-ipq40xx-7530_07.56.in"
source "config/.kos/separate/config-ipq40xx-7530_08.00.in"
source "config/.kos/separate/config-maple-1209_07.56.in"
source "config/.kos/separate/config-maple-1249_07.57.in"
source "config/.kos/separate/config-maple-3009_07.41.in"
source "config/.kos/separate/config-maple-3009_08.02.in"
source "config/.kos/separate/config-maple-4050_07.58.in"
source "config/.kos/separate/config-maple-4050_08.02.in"
source "config/.kos/separate/config-maple-7510_07.30.in"
source "config/.kos/separate/config-maple-7510_07.56.in"
source "config/.kos/separate/config-maple-7510_08.00.in"
source "config/.kos/separate/config-maple-7510_08.20.in"
source "config/.kos/separate/config-maple-GATE_07.54.in"
source "config/.kos/separate/config-miami-7690_07.61.in"
source "config/.kos/separate/config-miami-7690_08.01.in"
source "config/.kos/separate/config-ohio-04.33.in"
source "config/.kos/separate/config-ohio-04.57.in"
source "config/.kos/separate/config-ohio-04.67.in"
source "config/.kos/separate/config-ohio-04.70.in"
source "config/.kos/separate/config-ohio-04.76.in"
source "config/.kos/separate/config-ohio-04.80.in"
source "config/.kos/separate/config-ohio-04.87.in"
source "config/.kos/separate/config-ohio-5140_04.67.in"
source "config/.kos/separate/config-ohio-7140_04.33.in"
source "config/.kos/separate/config-ohio-r7203.in"
source "config/.kos/separate/config-puma6.x86-6490_06.87.in"
source "config/.kos/separate/config-puma6.x86-6490_07.02.in"
source "config/.kos/separate/config-puma6.x86-6490_07.10.in"
source "config/.kos/separate/config-puma6.x86-6590_06.87.in"
source "config/.kos/separate/config-puma6.x86-6590_07.02.in"
source "config/.kos/separate/config-puma6.x86-6590_07.25.in"
source "config/.kos/separate/config-puma6.x86-6590_07.56.in"
source "config/.kos/separate/config-puma7.x86-6591_07.04.in"
source "config/.kos/separate/config-puma7.x86-6591_07.13.in"
source "config/.kos/separate/config-puma7.x86-6591_07.50.in"
source "config/.kos/separate/config-puma7.x86-6591_08.00.in"
source "config/.kos/separate/config-puma7.x86-6591_08.20.in"
source "config/.kos/separate/config-puma7.x86-6660_07.14.in"
source "config/.kos/separate/config-puma7.x86-6660_07.26.in"
source "config/.kos/separate/config-puma7.x86-6670_07.61.in"
source "config/.kos/separate/config-puma7.x86-6690_07.29.in"
source "config/.kos/separate/config-puma7.x86-6690_07.56.in"
source "config/.kos/separate/config-qca955x-1750_07.01.in"
source "config/.kos/separate/config-qca955x-1750_07.12.in"
source "config/.kos/separate/config-qca955x-1750_07.27.in"
source "config/.kos/separate/config-qca955x-1759_06.30.in"
source "config/.kos/separate/config-qca955x-6820_07.56.in"
source "config/.kos/separate/config-qca956x-2400_07.27.in"
source "config/.kos/separate/config-qca956x-2400_07.50.in"
source "config/.kos/separate/config-qca956x-4020_06.50.in"
source "config/.kos/separate/config-qca956x-4020_06.83.in"
source "config/.kos/separate/config-qca956x-4020_07.01.in"
source "config/.kos/separate/config-qcaarmv8-4060_07.30.in"
source "config/.kos/separate/config-qcaarmv8-4060_07.56.in"
source "config/.kos/separate/config-qcaarmv8-4060_08.02.in"
source "config/.kos/separate/config-qcaarmv8-5590_07.29.in"
source "config/.kos/separate/config-qcaarmv8-5590_07.50.in"
source "config/.kos/separate/config-qcaarmv8-5590_08.00.in"
source "config/.kos/separate/config-qcaarmv8-6000_07.27.in"
source "config/.kos/separate/config-qcaarmv8-6000_07.56.in"
source "config/.kos/separate/config-ur8-7270_04.86.in"
source "config/.kos/separate/config-ur8-7270_05.21.in"
source "config/.kos/separate/config-ur8-7270_05.51.in"
source "config/.kos/separate/config-ur8-7270_06.05.in"
source "config/.kos/separate/config-vr9-3390_06.51.in"
source "config/.kos/separate/config-vr9-3490_06.31.in"
source "config/.kos/separate/config-vr9-5491_07.01.in"
source "config/.kos/separate/config-vr9-5491_07.27.in"
source "config/.kos/separate/config-vr9-7360_06.20.in"
source "config/.kos/separate/config-vr9-7490_06.30.in"
source "config/.kos/separate/config-vr9-7490_06.51.in"
source "config/.kos/separate/config-vr9-7490_06.60.in"
source "config/.kos/separate/config-vr9-7490_06.83.in"
source "config/.kos/separate/config-vr9-7490_06.93.in"
source "config/.kos/separate/config-vr9-7490_07.01.in"
source "config/.kos/separate/config-vr9-7490_07.11.in"
source "config/.kos/separate/config-vr9-7490_07.27.in"
source "config/.kos/separate/config-vr9-7490_07.56.in"
```

## make/apache2/Config.in
```kconfig
config FREETZ_PACKAGE_APACHE2
	bool "Apache HTTP Server 2.4.53 (binary only)"
	select FREETZ_LIB_libcrypt        if ! FREETZ_PACKAGE_APACHE2_STATIC && FREETZ_TARGET_UCLIBC_HAS_multiple_libs
	select FREETZ_LIB_libdl           if ! FREETZ_PACKAGE_APACHE2_STATIC && FREETZ_TARGET_UCLIBC_HAS_multiple_libs
	select FREETZ_LIB_libm            if ! FREETZ_PACKAGE_APACHE2_STATIC && FREETZ_TARGET_UCLIBC_HAS_multiple_libs
	select FREETZ_LIB_libapr          if ! FREETZ_PACKAGE_APACHE2_STATIC
	select FREETZ_LIB_libapr_WITH_DSO
	select FREETZ_LIB_libaprutil      if ! FREETZ_PACKAGE_APACHE2_STATIC
	select FREETZ_LIB_libpcre         if ! FREETZ_PACKAGE_APACHE2_STATIC
	select FREETZ_LIB_libz            if ! FREETZ_PACKAGE_APACHE2_STATIC && FREETZ_PACKAGE_APACHE2_DEFLATE
	select FREETZ_LIB_libcrypto       if ! FREETZ_PACKAGE_APACHE2_STATIC && FREETZ_PACKAGE_APACHE2_SSL
	select FREETZ_LIB_libssl          if ! FREETZ_PACKAGE_APACHE2_STATIC && FREETZ_PACKAGE_APACHE2_SSL
	select FREETZ_LIB_libxml2         if ! FREETZ_PACKAGE_APACHE2_STATIC && FREETZ_PACKAGE_APACHE2_LIBXML
	select FREETZ_LIB_libxml2_WITH_HTML if FREETZ_PACKAGE_APACHE2_LIBXML
	default n
	help
		The Apache httpd server

config FREETZ_PACKAGE_APACHE2_DEFLATE
	bool "Enable deflate"
	depends on FREETZ_PACKAGE_APACHE2
	default n
	help
		Enables the deflate compression. Requires libz.

config FREETZ_PACKAGE_APACHE2_SSL
	bool "Enable SSL"
	depends on FREETZ_PACKAGE_APACHE2
	default n
	help
		Enables the SSL module. Requires openssl.

config FREETZ_PACKAGE_APACHE2_LIBXML
	bool "Enable libxml dependent modules"
	depends on FREETZ_PACKAGE_APACHE2
	default n
	help
		Enables libxml dependent modules. Requires libxml2.

config FREETZ_PACKAGE_APACHE2_COMPILEINMODS
	bool "Compile modules in instead of building loadable modules"
	depends on FREETZ_PACKAGE_APACHE2
	default n
	help
		Causes all apache modules to be linked directly into the main binary.

config FREETZ_PACKAGE_APACHE2_STATIC
	bool "Link statically"
	depends on FREETZ_PACKAGE_APACHE2
	default n
	help
		Causes all libraries apache depends on to be linked in statically.
```

## make/atop/Config.in
```kconfig
config FREETZ_PACKAGE_ATOP
	bool "atop 2.2.3 (binary only)"
	select FREETZ_LIB_libm if FREETZ_TARGET_UCLIBC_HAS_multiple_libs
	select FREETZ_LIB_libncurses
	select FREETZ_LIB_libz
	default n
	help
		The program atop is an interactive monitor to view the load on a Linux system.
		It shows the occupation of the most critical hardware resources
		(from a performance point of view) on system level, i.e. cpu, memory, disk and network.
```

## make/autofs/Config.in
```kconfig
comment "AutoFS (not available, needs replace kernel)"
	depends on !FREETZ_AVM_HAS_AUTOFS4_FS_BUILTIN
	depends on FREETZ_KERNEL_VERSION_2_6_28_MAX && !FREETZ_REPLACE_KERNEL

comment "AutoFS (not available, no kernel sources from AVM)"
	depends on !FREETZ_AVM_HAS_AUTOFS4_FS_BUILTIN
	depends on FREETZ_KERNEL_VERSION_2_6_32_MIN && !FREETZ_REPLACE_MODULE_AVAILABLE

config FREETZ_PACKAGE_AUTOFS
	bool "AutoFS 5.0.5/5.1.8"
	depends on FREETZ_AVM_HAS_AUTOFS4_FS_BUILTIN \
		|| (FREETZ_KERNEL_VERSION_2_6_28_MAX && FREETZ_REPLACE_KERNEL) \
		|| (FREETZ_KERNEL_VERSION_2_6_32_MIN && FREETZ_REPLACE_MODULE_AVAILABLE)
	select FREETZ_LIB_libdl       if FREETZ_TARGET_UCLIBC_HAS_multiple_libs
	select FREETZ_LIB_libpthread  if FREETZ_TARGET_UCLIBC_HAS_multiple_libs
	select FREETZ_LIB_libtirpc    if !FREETZ_TARGET_UCLIBC_SUPPORTS_rpc
	select FREETZ_MODULE_autofs4  if !FREETZ_AVM_HAS_AUTOFS4_FS_BUILTIN
	select FREETZ_BUSYBOX_FEATURE_MOUNT_HELPERS
	select FREETZ_BUSYBOX_FEATURE_MOUNT_LABEL
	default n
	help
		Autofs is a kernel-based automounter for Linux. It performs a job
		similar to amd(8) but relies on a small stub of kernel code instead of
		pretending to be an NFS server. The result is simpler code, better
		reliability, and much faster operation in the common case (everything
		already mounted).

if FREETZ_PACKAGE_AUTOFS && FREETZ_REPLACE_MODULE_AVAILABLE

config FREETZ_PACKAGE_AUTOFS_NFS
	bool "select nfs module"
	select FREETZ_MODULE_nfs if !FREETZ_AVM_HAS_NFS_FS_BUILTIN
	default n
	help
		Select this if you want to mount NFS-shares.

comment "select cifs package (not available, needs replace kernel)"
	depends on !FREETZ_REPLACE_KERNEL && FREETZ_KERNEL_VERSION_2_6_28_MIN && !FREETZ_KERNEL_VERSION_3_MIN

config FREETZ_PACKAGE_AUTOFS_CIFS
	bool "select cifs package"
	depends on  FREETZ_REPLACE_KERNEL || FREETZ_KERNEL_VERSION_2_6_19_MAX ||  FREETZ_KERNEL_VERSION_3_MIN
	select FREETZ_PACKAGE_CIFSMOUNT
	select FREETZ_PACKAGE_CIFSMOUNT_REMOVE_WEBIF
	default n
	help
		Select this if you want to mount SMB-shares.

config FREETZ_PACKAGE_AUTOFS_CURLFTPFS
	bool "select curlftpfs package"
	depends on !FREETZ_TARGET_UCLIBC_0_9_28
	select FREETZ_PACKAGE_CURLFTPFS
	select FREETZ_PACKAGE_CURLFTPFS_REMOVE_WEBIF
	default n
	help
		Select this if you want to mount FTP-shares.

config FREETZ_PACKAGE_AUTOFS_DAVFS2
	bool "select davfs2 package"
	select FREETZ_PACKAGE_DAVFS2
	select FREETZ_PACKAGE_DAVFS2_REMOVE_WEBIF
	default n
	help
		Select this if you want to mount WebDAV-shares.
		Support for SSL and ZLIB could additionally be selected!

config FREETZ_PACKAGE_AUTOFS_SSHFS
	bool "select sshfs package"
	select FREETZ_PACKAGE_SSHFS_FUSE
	default n
	help
		Select this if you want to mount SSH-shares.

endif # FREETZ_PACKAGE_AUTOFS
```

## make/bind/Config.in
```kconfig
config FREETZ_PACKAGE_BIND
	bool "BIND 9.16.25"
	select FREETZ_LIB_libpthread if FREETZ_TARGET_UCLIBC_HAS_multiple_libs
	select FREETZ_LIB_libuv
	select FREETZ_LIB_libcap
	select FREETZ_LIB_libatomic
	default n
	help
		BIND is an implementation of the Domain Name System (DNS) protocols.
		The name BIND stands for "Berkeley Internet Name Daemon".
		You have to provide the config and needed zone files yourself.

if FREETZ_PACKAGE_BIND

	config FREETZ_PACKAGE_BIND_NAMED
		bool "named"
		default y
		help
			Adds named, a internet domain name server.

		comment "HINT: Don't forget to enable the DNS server."
		depends on FREETZ_PACKAGE_BIND_NAMED && \
			FREETZ_AVMDAEMON_DISABLE_DNS

		config FREETZ_PACKAGE_BIND_NAMED_DISABLE_DNS
			bool "Disable multid's DNS"
			depends on FREETZ_PACKAGE_BIND_NAMED
			depends on FREETZ_AVM_HAS_AVMDAEMON_PRELOAD
			select FREETZ_AVMDAEMON_DISABLE_MULTIDPORTS
			select FREETZ_AVMDAEMON_DISABLE_DNS
			select FREETZ_AVMDAEMON_DISABLE_LLMNR
			default y
			help
				This selects the remapping of multid's DNS (and LLMNR) ports.

	config FREETZ_PACKAGE_BIND_RNDC
		bool "rndc (binary only)"
		default n
		help
			Adds the rndc name server control utility binary.

	config FREETZ_PACKAGE_BIND_NSUPDATE
		bool "nsupdate (binary only)"
		default n
		help
			Adds the nsupdate binary for manipulation dynamic Zones.

	config FREETZ_PACKAGE_BIND_DIG
		bool "dig (binary only)"
		default n
		help
			Adds the dig DNS lookup utility.

	config FREETZ_PACKAGE_BIND_OPENSSL
		bool "Enable OpenSSL support"
		select FREETZ_PACKAGE_OPENSSL
		default n
		help
			Compile bind with openssl support for verification of TSIG / DoT

endif # FREETZ_PACKAGE_BIND
```
