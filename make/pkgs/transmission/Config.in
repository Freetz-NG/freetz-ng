## make/pkgs/transmission/Config.in
```kconfig
menuconfig FREETZ_PACKAGE_TRANSMISSION
	bool "Transmission 3.00/4.1.2 (binary only)"
	default n
	#
	select FREETZ_LIB_libcurl    if !FREETZ_PACKAGE_TRANSMISSION_STATIC
	select FREETZ_LIB_libevent   if !FREETZ_PACKAGE_TRANSMISSION_STATIC
	select FREETZ_LIB_libm       if !FREETZ_PACKAGE_TRANSMISSION_STATIC && FREETZ_TARGET_UCLIBC_HAS_multiple_libs
	select FREETZ_LIB_libpthread if !FREETZ_PACKAGE_TRANSMISSION_STATIC && FREETZ_TARGET_UCLIBC_HAS_multiple_libs
	select FREETZ_LIB_librt      if !FREETZ_PACKAGE_TRANSMISSION_STATIC && FREETZ_TARGET_UCLIBC_HAS_multiple_libs
	select FREETZ_LIB_libz       if !FREETZ_PACKAGE_TRANSMISSION_STATIC
	help
		If needed, remember to change the base directory as well
		as the installation directory on the webif.

if FREETZ_PACKAGE_TRANSMISSION

	choice
		prompt "Version"
			default FREETZ_PACKAGE_TRANSMISSION_VERSION_CURRENT

		config FREETZ_PACKAGE_TRANSMISSION_VERSION_ABANDON
			bool "3.00"

		config FREETZ_PACKAGE_TRANSMISSION_VERSION_CURRENT
			bool "4.1.2"
			depends on FREETZ_SEPARATE_AVM_UCLIBC
			select FREETZ_STDCXXLIB_FORCE_GNULIBSTDCXX
			select FREETZ_LIB_STDCXXLIB                 if !FREETZ_PACKAGE_TRANSMISSION_STATIC
			select FREETZ_LIB_libpsl                    if !FREETZ_PACKAGE_TRANSMISSION_STATIC
			select FREETZ_LIB_libdeflate                if !FREETZ_PACKAGE_TRANSMISSION_STATIC

	endchoice

	config FREETZ_PACKAGE_TRANSMISSION_WITH_FINISHDIR
		bool "With finish-dir patch"
		default y
		depends on FREETZ_PACKAGE_TRANSMISSION_VERSION_ABANDON
		help
			Applies the Freetz specific finish-dir patch.
			If you want it also for v4, you have to fix it by yourself.

	choice
		prompt "SSL library"
		help
			To change the crypto lib, change the crypto lib of libcurl!

		config FREETZ_PACKAGE_TRANSMISSION_WITH_OPENSSL
			bool "OpenSSL"
			depends on FREETZ_LIB_libcurl_WITH_OPENSSL || !FREETZ_LIB_libcurl_WITH_SSL
			select FREETZ_LIB_libcrypto          if !FREETZ_PACKAGE_TRANSMISSION_STATIC
			select FREETZ_LIB_libssl             if !FREETZ_PACKAGE_TRANSMISSION_STATIC
			select FREETZ_LIB_libdl              if !FREETZ_PACKAGE_TRANSMISSION_STATIC && FREETZ_TARGET_UCLIBC_HAS_multiple_libs
			select FREETZ_LIB_libcrypto_WITH_RC4

		config FREETZ_PACKAGE_TRANSMISSION_WITH_MBEDTLS
			bool "MbedTLS"
			depends on FREETZ_LIB_libcurl_WITH_MBEDTLS
			select FREETZ_LIB_libmbedcrypto      if !FREETZ_PACKAGE_TRANSMISSION_STATIC

	endchoice

	comment "WARNING: Transmission v3 does not work with OpenSSL newer than 1.1.1"
		depends on FREETZ_PACKAGE_TRANSMISSION_VERSION_ABANDON && FREETZ_PACKAGE_TRANSMISSION_WITH_OPENSSL && !FREETZ_OPENSSL_VERSION_11_MAX
	comment "WARNING: Transmission v4 does not work with MbedTLS older than 3.2.0"
		depends on FREETZ_PACKAGE_TRANSMISSION_VERSION_CURRENT && FREETZ_PACKAGE_TRANSMISSION_WITH_MBEDTLS && !FREETZ_MBEDTLS_VERSION_306_MIN

	config FREETZ_PACKAGE_TRANSMISSION_CLIENT
		bool "Transmission client"
		default n
		help
			Torrent client (interactive)

			Note: transmission client is deprecated (see http://trac.transmissionbt.com/ticket/2983)
			and will be removed in one of the next releases. Consider using web-interface controlled
			daemon instead.

	config FREETZ_PACKAGE_TRANSMISSION_DAEMON
		bool "Transmission daemon"
		default y
		help
			Torrent client (daemon)

		config FREETZ_PACKAGE_TRANSMISSION_REMOTE
			bool "Transmission remote"
			depends on FREETZ_PACKAGE_TRANSMISSION_DAEMON
			default n
			help
				A remote control utility for transmission-daemon

		config FREETZ_PACKAGE_TRANSMISSION_WEBINTERFACE
			bool "Transmission web interface"
			depends on FREETZ_PACKAGE_TRANSMISSION_DAEMON
			default y
			help
				The official web interface for transmission called clutch

	config FREETZ_PACKAGE_TRANSMISSION_CREATE
		bool "transmission-create"
		default n
		help
			A command-line utility to create .torrent files

	config FREETZ_PACKAGE_TRANSMISSION_EDIT
		bool "transmission-edit"
		default n
		help
			A command-line utility to modify .torrent files' announce URLs

	config FREETZ_PACKAGE_TRANSMISSION_SHOW
		bool "transmission-show"
		default n
		help
			A command-line utility to show .torrent file metadata

	config FREETZ_PACKAGE_TRANSMISSION_STATIC
		bool "Link statically"
		default n
		depends on FREETZ_PACKAGE_TRANSMISSION_VERSION_ABANDON
		help
			Build transmission binaries with statically linked libraries.

	config FREETZ_PACKAGE_TRANSMISSION_SELECT_CGI
		bool "Select Transmission CGI"
		select FREETZ_PACKAGE_TRANSMISSION_CGI
		select FREETZ_PACKAGE_TRANSMISSION_DAEMON
		default y
		help
			Configuration web interface for Freetz.

endif # FREETZ_PACKAGE_TRANSMISSION
```

## make/pkgs/tree/Config.in
```kconfig
config FREETZ_PACKAGE_TREE
	bool "tree 2.1.1 (binary only)"
	default n
	help
		Tree is a recursive directory listing program
		that produces a depth indented listing of files,
		which is colorized ala dircolors if the LS_COLORS
		environment variable is set and output is to tty.
```

## make/pkgs/unbound/Config.in
```kconfig
menuconfig FREETZ_PACKAGE_UNBOUND
	bool "Unbound 1.23.1"
	depends on FREETZ_KERNEL_VERSION_2_6_39_MIN
	select FREETZ_LIB_libssl
	select FREETZ_LIB_libcrypto
	select FREETZ_LIB_libunbound
	default n
	help
		 Unbound is designed as a set of modular components, so that also
		 DNSSEC (secure DNS) validation and stub-resolvers (that do not run as
		 a server, but are linked into an application) are easily possible.

if FREETZ_PACKAGE_UNBOUND

	config FREETZ_PACKAGE_UNBOUND_WEBIF
		bool "Add webinterface"
		select FREETZ_PACKAGE_UNBOUND_DAEMON
		default y
		help
			Freetz web interface to configure unbound daemon.

if FREETZ_PACKAGE_UNBOUND_WEBIF

		config FREETZ_PACKAGE_UNBOUND_WEBIF_CRON
			bool "Update root servers"
			select FREETZ_BUSYBOX_MD5SUM
			select FREETZ_PACKAGE_WGET
			select FREETZ_PACKAGE_WGET_WITH_SSL
			select FREETZ_PACKAGE_WGET_CA_BUNDLE
			default n
			help
				Updates root.hints with wget by cron.

		config FREETZ_PACKAGE_UNBOUND_WEBIF_STATS
			bool "Show daemon stats"
			select FREETZ_PACKAGE_UNBOUND_CONTROL
			default n
			help
				Uses unbound-control to show stats.

		comment "HINT: Don't forget to enable the DNS server."
		depends on FREETZ_AVMDAEMON_DISABLE_DNS

		config FREETZ_PACKAGE_UNBOUND_DISABLE_DNS
			bool "Disable multid's DNS"
			depends on FREETZ_AVM_HAS_AVMMULTID_PRELOAD
			select FREETZ_AVMDAEMON_DISABLE_MULTIDPORTS
			select FREETZ_AVMDAEMON_DISABLE_DNS
			select FREETZ_AVMDAEMON_DISABLE_LLMNR
			default n
			help
				This selects the remapping of multid's DNS (and LLMNR) ports.
				By default unbound uses 5353 and this is not needed.

endif # FREETZ_PACKAGE_UNBOUND_WEBIF

	config FREETZ_PACKAGE_UNBOUND_DAEMON
		bool "Binary unbound"
		default n
		help
			unbound - Unbound DNS validating resolver
			
			It  uses a built in list of authoritative nameservers for the root zone
			(.), the so called root hints.  On receiving a DNS query  it  will  ask
			the root nameservers for an answer and will in almost all cases receive
			a delegation to a top level domain (TLD) authoritative nameserver.   It
			will  then ask that nameserver for an answer.  It will recursively con-
			tinue until an answer is found or no answer  is  available  (NXDOMAIN).
			For performance and efficiency reasons that answer is cached for a cer-
			tain time (the answer's time-to-live or TTL).  A second query  for  the
			same  name  will  then be answered from the cache.  Unbound can also do
			DNSSEC validation.

			About 1,1 MB uncompressed.

	config FREETZ_PACKAGE_UNBOUND_ANCHOR
		bool "Binary unbound-anchor"
		default n
		help
			unbound-anchor - Unbound anchor utility.
			
			Unbound-anchor performs setup or update of the root trust anchor for
			DNSSEC validation. The program fetches the trust anchor with the
			method from RFC7958 when regular RFC5011 update fails to bring it up to
			date. It can be run (as root) from the commandline, or run as part of
			startup scripts. Before you start the unbound DNS server.
			
			About 60 kB uncompressed.

	config FREETZ_PACKAGE_UNBOUND_CHECKCONF
		bool "Binary unbound-checkconf"
		default n
		help
			unbound-checkconf - Check unbound configuration file for errors.
			
			Unbound-checkconf checks the configuration file for the unbound DNS
			resolver for syntax and other errors. The config file syntax is de-
			scribed in unbound.conf.
			
			About 1,0 MB uncompressed.

	config FREETZ_PACKAGE_UNBOUND_CONTROL
		bool "Binary unbound-control"
		default n
		help
			unbound-control - Unbound remote server control utility.
			
			Unbound-control performs remote administration on the unbound DNS
			server. It reads the configuration file, contacts the unbound server
			over SSL sends the command and displays the result.
			
			About 1,0 MB uncompressed.

		config FREETZ_PACKAGE_UNBOUND_CONTROL_SETUP
			bool "Script unbound-control-setup"
			depends on FREETZ_PACKAGE_UNBOUND_CONTROL
			select FREETZ_PACKAGE_OPENSSL
			default n
			help
				unbount-control-setup - helper script for unbound-control
				
				About 6 kB uncompressed.

	config FREETZ_PACKAGE_UNBOUND_HOST
		bool "Binary unbound-host"
		default n
		help
			unbound-host - unbound DNS lookup utility
			
			Unbound-host uses the unbound validating resolver to query for the
			hostname and display results. With the -v option it displays validation
			status: secure, insecure, bogus (security failure).
			
			By default it reads no configuration file whatsoever. It attempts to
			reach the internet root servers. With -C an unbound config file and
			with -r resolv.conf can be read.
			
			About 119 kB uncompressed.

endif # FREETZ_PACKAGE_UNBOUND
```

## make/pkgs/unrar/Config.in
```kconfig
config FREETZ_PACKAGE_UNRAR
	bool "UnRAR 6.1.7/7.1.6 (binary only)"
	select FREETZ_STDCXXLIB_FORCE_GNULIBSTDCXX
	select FREETZ_LIB_STDCXXLIB if ! FREETZ_PACKAGE_UNRAR_STATIC
	default n
	help
		Unarchiver for .rar files

if FREETZ_PACKAGE_UNRAR

	choice
		prompt "Version"
			default FREETZ_PACKAGE_UNRAR_VERSION_CURRENT

		config FREETZ_PACKAGE_UNRAR_VERSION_ABANDON
			bool "6.1.7"
			depends on FREETZ_TARGET_GCC_5_MAX

		config FREETZ_PACKAGE_UNRAR_VERSION_CURRENT
			bool "7.1.6"
			depends on !FREETZ_TARGET_GCC_5_MAX

	endchoice

	config FREETZ_PACKAGE_UNRAR_STATIC
		bool "Link statically"
		depends on FREETZ_PACKAGE_UNRAR
		default n
		help
			Causes all libraries unrar depends on to be linked in statically

endif # FREETZ_PACKAGE_UNRAR
```

## make/pkgs/util-linux/Config.in
```kconfig
config FREETZ_PACKAGE_UTIL_LINUX
	bool "util-linux (Linux disk utilities)"
	# TODO: util-linux' libsysfs requires fdopendir, which is missing in uClibc-0.9.28/0.9.29
	depends on !FREETZ_TARGET_UCLIBC_0_9_28 && !FREETZ_TARGET_UCLIBC_0_9_29
	default n
	help
		Provides essential disk and block device utilities from util-linux project.

if FREETZ_PACKAGE_UTIL_LINUX

choice
	prompt "util-linux version"
	default FREETZ_UTIL_LINUX_VERSION_2_27_1 if FREETZ_TARGET_UCLIBC_0_9_32 || FREETZ_TARGET_UCLIBC_0_9_33 || FREETZ_TARGET_GCC_5_MAX
	default FREETZ_UTIL_LINUX_VERSION_2_41

	config FREETZ_UTIL_LINUX_VERSION_2_27_1
		bool "2.27.1 (legacy - minimal, for old devices)"
		help
			Legacy version 2.27.1 (November 2015) - minimal build.
			
			Provides only:
			- blkid: Block device identification
			
			Recommended for old toolchains (uClibc 0.9.x or GCC <= 5.5).
			Includes 7 patches for old uClibc/toolchain compatibility.
			Automatically selected for uClibc 0.9.32/0.9.33 or GCC 5.x and older.

	config FREETZ_UTIL_LINUX_VERSION_2_41
		bool "2.41 (modern - full featured)"
		help
			Modern version 2.41 (August 2022) - full featured build.
			
			Provides configurable utilities (see below for selection).
			
			Requires modern toolchain (gcc >= 4.9, uClibc >= 0.9.32).
			All legacy patches applied upstream.

endchoice

if FREETZ_UTIL_LINUX_VERSION_2_41

menu "Utilities selection"

config FREETZ_UTIL_LINUX_BLKID
	bool "blkid - identify block devices (renamed to blkid-util-linux)"
	default y
	help
		blkid is used to identify block device attributes such as
		filesystem type, UUID, LABEL, etc.
		
		Conflicts with busybox blkid, renamed to blkid-util-linux.

config FREETZ_UTIL_LINUX_LOSETUP
	bool "losetup - manage loop devices (renamed to losetup-util-linux)"
	default y
	help
		losetup is used to associate loop devices with regular files
		or block devices, to detach loop devices, and to query the
		status of a loop device.
		
		Conflicts with busybox losetup, renamed to losetup-util-linux.

config FREETZ_UTIL_LINUX_MKSWAP
	bool "mkswap - create swap area (renamed to mkswap-util-linux)"
	default y
	help
		mkswap sets up a Linux swap area on a device or in a file.
		
		Conflicts with busybox mkswap, renamed to mkswap-util-linux.

config FREETZ_UTIL_LINUX_SWAPON
	bool "swapon/swapoff - enable/disable swap (renamed to *-util-linux)"
	default y
	help
		swapon is used to activate swap areas.
		swapoff is used to deactivate swap areas.
		
		Conflicts with busybox swapon, renamed to swapon-util-linux and swapoff-util-linux.

config FREETZ_UTIL_LINUX_LSBLK
	bool "lsblk - list block devices"
	select FREETZ_LIB_libncursesw
	default y
	help
		lsblk lists information about all available or specified block
		devices. It reads the sysfs filesystem and udev db to gather
		information.
		
		Requires ncursesw library for colored output.
		Unique to util-linux (no busybox equivalent).

config FREETZ_UTIL_LINUX_FINDMNT
	bool "findmnt - find mounted filesystems"
	default y
	help
		findmnt will list all mounted filesystems or search for a
		filesystem. It can search in /etc/fstab, /etc/mtab or /proc/self/mountinfo.
		
		Unique to util-linux (no busybox equivalent).

endmenu

endif # FREETZ_UTIL_LINUX_VERSION_2_41

endif # FREETZ_PACKAGE_UTIL_LINUX
```

## make/pkgs/uvncrepeater/Config.in
```kconfig
config FREETZ_PACKAGE_UVNCREPEATER
	bool "UVNC IPv4 repeater 014 (binary only)"
	default n
	help
		A IPv4 only linux port of the UltraVNC
		Repeater. The Repeater acts like a
		proxy, sitting in the middle between
		the UltraVNC Server and Viewer. All
		data for the session is passed through
		the UltraVNC Repeater meaning that the
		UltraVNC Viewer and UltraVNC Server can
		both be behind a NAT firewall, without
		having to worry about forwarding ports
		or anything else (providing the Repeater
		is visible to both UltraVNC Viewer and
		UltraVNC Server).
```

## make/pkgs/virtualip-ng/Config.in
```kconfig
config FREETZ_PACKAGE_VIRTUALIP_NG
	bool "Virtualip NG"
	depends on FREETZ_SHOW_EXPERT
	default n
	help
		Creates one or more virtual IPv4/IPv6 addresses on selected interfaces.

		This package is a maintained NG variant derived from the former
		virtualip-cgi module and provides a web configuration page for
		interface, IP/netmask-or-prefix entries, autostart and timing controls.
```

## make/pkgs/vlmcsd/Config.in
```kconfig
config FREETZ_PACKAGE_VLMCSD
	bool "VLMCSD 1113 (binary only)"
        select FREETZ_PACKAGE_VLMCSDSETUP
	default n
	help
		vlmcsd is a fully Microsoft compatible KMS server hat provides
		product activation services to clients.
		It is designed to run on POSIX compatible operating systens.
		Only requirements are a basic C library with a BSD-style
		sockets API and either fork(2) or pthreads(7). That allows it
		to run on most embedded systems like routers, NASes, etc.
```

## make/pkgs/vlmcsdsetup/Config.in
```kconfig
config FREETZ_PACKAGE_VLMCSDSETUP
	bool "VLMCSD-Setup 0.0.1 (binary only)"
	depends on FREETZ_PACKAGE_VLMCSD
	select FREETZ_LIB_libutil if FREETZ_TARGET_UCLIBC_HAS_multiple_libs
	default y
	help
		A utility to make the setup of vlmcsd easier.
```
