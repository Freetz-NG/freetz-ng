## make/pkgs/wget/Config.in
```kconfig
config FREETZ_PACKAGE_WGET
	bool "Wget GNU 1.21.4 (binary only)"
	default n
	help
		GNU Wget is a free software package for retrieving files using
		HTTP, HTTPS and FTP, the most widely-used Internet protocols. It
		is a non-interactive commandline tool, so it may easily be
		called from scripts, cron jobs, terminals, etc.

config FREETZ_PACKAGE_WGET_WITH_SSL
	bool "build with SSL support"
	depends on FREETZ_PACKAGE_WGET
	default y
	help
		This option enables SSL support for Wget.

if FREETZ_PACKAGE_WGET_WITH_SSL

	choice
		prompt "SSL library"
		default FREETZ_PACKAGE_WGET_OPENSSL

		config FREETZ_PACKAGE_WGET_OPENSSL
			bool "OpenSSL"
			select FREETZ_LIB_libcrypto if !FREETZ_PACKAGE_WGET_STATIC
			select FREETZ_LIB_libcrypto_WITH_EC
			select FREETZ_LIB_libssl    if !FREETZ_PACKAGE_WGET_STATIC

		config FREETZ_PACKAGE_WGET_GNUTLS
			bool "GnuTLS"
			select FREETZ_LIB_libgnutls if !FREETZ_PACKAGE_WGET_STATIC
	endchoice

	config FREETZ_PACKAGE_WGET_CA_BUNDLE
		bool "Select CA-bundle"
		default y
		select FREETZ_PACKAGE_CA_BUNDLE

	config FREETZ_PACKAGE_WGET_STATIC
		bool "Link statically"
		default n
		help
			Wget with SSL support needs the following shared libraries which
			can be linked in statically by activating this switch:
			- libcrypto
			- libssl
			- libgnutls

endif # FREETZ_PACKAGE_WGET_WITH_SSL

config FREETZ_WGET
	bool
	default n
	select FREETZ_BUSYBOX_WGET if !FREETZ_PACKAGE_WGET || FREETZ_WGET_ALWAYS_AVAILABLE
```

## make/pkgs/whois/Config.in
```kconfig
config FREETZ_PACKAGE_WHOIS
	bool "Whois 5.6.3 (binary only)"
	default n
	help
		Whois - client for the whois directory service.

if FREETZ_PACKAGE_WHOIS

	config FREETZ_PACKAGE_WHOIS_WHIS_LIBIDN
		bool "With libidn"
		default y
		select FREETZ_LIB_libidn

endif # FREETZ_PACKAGE_WHOIS
```

## make/pkgs/wireguard-linux-compat/Config.in
```kconfig
config FREETZ_PACKAGE_WIREGUARD_LINUX_COMPAT
	bool "wireguard-linux-compat 1.0.20220627"
	depends on ( !FREETZ_AVM_HAS_WIREGUARD_BUILTIN && !FREETZ_AVM_HAS_WIREGUARD_KERNEL )
	depends on FREETZ_PACKAGE_WIREGUARD
	default n
	select FREETZ_MODULE_wireguard
	help
		This package provides the kernel module required for Wireguard

if FREETZ_PACKAGE_WIREGUARD_LINUX_COMPAT

	config FREETZ_PACKAGE_WIREGUARD_LINUX_COMPAT_skb_put_data
		bool
		default y
		depends on \
			FREETZ_AVM_SOURCE_1200_07_14 || \
			FREETZ_AVM_SOURCE_1200_07_27 || \
			FREETZ_AVM_SOURCE_1200_07_50 || \
			FREETZ_AVM_SOURCE_1200_08_20 || \
			FREETZ_AVM_SOURCE_1209_07_56 || \
			FREETZ_AVM_SOURCE_1249_07_57 || \
			FREETZ_AVM_SOURCE_3009_07_41 || \
			FREETZ_AVM_SOURCE_3009_08_02 || \
			FREETZ_AVM_SOURCE_4040_07_01 || \
			FREETZ_AVM_SOURCE_4040_07_14 || \
			FREETZ_AVM_SOURCE_4040_07_29 || \
			FREETZ_AVM_SOURCE_4040_07_56 || \
			FREETZ_AVM_SOURCE_4040_08_00 || \
			FREETZ_AVM_SOURCE_4050_07_58 || \
			FREETZ_AVM_SOURCE_4050_08_02 || \
			FREETZ_AVM_SOURCE_4060_07_30 || \
			FREETZ_AVM_SOURCE_4060_07_56 || \
			FREETZ_AVM_SOURCE_4060_08_02 || \
			FREETZ_AVM_SOURCE_5590_07_29 || \
			FREETZ_AVM_SOURCE_5590_07_50 || \
			FREETZ_AVM_SOURCE_5590_08_00 || \
			FREETZ_AVM_SOURCE_6000_07_27 || \
			FREETZ_AVM_SOURCE_6000_07_56 || \
			FREETZ_AVM_SOURCE_6690_07_29 || \
			FREETZ_AVM_SOURCE_6690_07_56 || \
			FREETZ_AVM_SOURCE_7510_07_56 || \
			FREETZ_AVM_SOURCE_7510_08_00 || \
			FREETZ_AVM_SOURCE_7510_08_20 || \
			FREETZ_AVM_SOURCE_7530_07_02 || \
			FREETZ_AVM_SOURCE_7530_07_20 || \
			FREETZ_AVM_SOURCE_7530_07_25 || \
			FREETZ_AVM_SOURCE_7530_07_50 || \
			FREETZ_AVM_SOURCE_7530_07_56 || \
			FREETZ_AVM_SOURCE_7530_08_00 || \
			FREETZ_AVM_SOURCE_GATE_07_54 || \
			FREETZ_AVM_SOURCE_GATE_08_20

endif # FREETZ_PACKAGE_WIREGUARD_LINUX_COMPAT
```

## make/pkgs/xsltproc/Config.in
```kconfig
config FREETZ_PACKAGE_XSLTPROC
	bool "xsltproc 1.1.37 (binary only)"
	select FREETZ_LIB_libxslt  if !FREETZ_PACKAGE_XSLTPROC_STATIC
	select FREETZ_LIB_libexslt if !FREETZ_PACKAGE_XSLTPROC_STATIC
	default n
	help
		xsltproc is a command line tool for applying XSLT stylesheets to XML
		documents. It is part of libxslt, the XSLT C library for GNOME.
		While it was developed as part of the GNOME project, it can operate
		independently of the GNOME desktop.

config FREETZ_PACKAGE_XSLTPROC_STATIC
	bool "Link statically"
	depends on FREETZ_PACKAGE_XSLTPROC
	default n
	help
		Causes all libraries xsltproc depends on to be linked in statically
```

## make/pkgs/xz/Config.in
```kconfig
config FREETZ_PACKAGE_XZ
	bool "XZ Utils 5.2.10 (binary only)"
	select FREETZ_LIB_liblzma
	default n
	help
		XZ is the successor to the Lempel-Ziv/Markov-chain Algorithm compression format,
		which provides memory-hungry but powerful compression (often better than bzip2)
		and fast, easy decompression.

		This package provides the command line tools for working with XZ compression.
		They can also handle the older LZMA format, and if invoked via appropriate
		symlinks will emulate the behavior of the commands in the lzma package.
```

## make/pkgs/zip/Config.in
```kconfig
config FREETZ_PACKAGE_ZIP
	bool "zip 3.0 (binary only)"
	default n
	help
		zip - package and compress (archive) files

		Zip is a compression and file packaging utility for Unix, VMS, MSDOS,
		OS/2, Windows 9x/NT/XP, Minix, Atari, Macintosh, Amiga, and Acorn RISC OS.
		It is analogous to a combination of the Unix commands tar(1) and compress(1)
		and is compatible with PKZIP (Phil Katz's ZIP for MSDOS systems).

		This utility is essential for creating compressed archives on the target
		system, especially useful for packaging files and reducing storage space.
		
		Can be externalized to save flash memory.
```

## make/tinyproxy/Config.in
```kconfig
config FREETZ_PACKAGE_TINYPROXY
	bool "Tinyproxy 1.11.0"
	default n
	help
		Tinyproxy is a lightweight HTTP and HTTPS proxy.

if FREETZ_PACKAGE_TINYPROXY

	config FREETZ_PACKAGE_TINYPROXY_WITH_TRANSPARENT_PROXY
		bool "Enable transparent proxying"
		depends on FREETZ_AVM_VERSION_04_XX_MAX
		default n

	config FREETZ_PACKAGE_TINYPROXY_WITH_FILTER
		bool "Enable filtering support"
		default y

	config FREETZ_PACKAGE_TINYPROXY_WITH_UPSTREAM
		bool "Enable upstream support"
		default n

	config FREETZ_PACKAGE_TINYPROXY_WITH_REVERSE
		bool "Enable reverse proxy support"
		default n

	config FREETZ_PACKAGE_TINYPROXY_STATIC
		bool "Link statically"
		default n

endif # FREETZ_PACKAGE_TINYPROXY
```

## make/wireguard-linux-compat/Config.in
```kconfig
config FREETZ_PACKAGE_WIREGUARD_LINUX_COMPAT
	bool "wireguard-linux-compat 1.0.20211208"
	depends on FREETZ_PACKAGE_WIREGUARD
	default n
	select FREETZ_MODULE_wireguard
	help
		This package provides the kernel module required for Wireguard
```
