## make/pkgs/openssh/Config.in
```kconfig
comment "OpenSSH (not available, needs OpenSSL 1.0 or newer)"
	depends on !FREETZ_OPENSSL_VERSION_1_MIN

config FREETZ_PACKAGE_OPENSSH
	bool "OpenSSH 9.3p2/9.4p1"
	depends on FREETZ_OPENSSL_VERSION_1_MIN
	select FREETZ_LIB_libcrypto_WITH_EC       if !FREETZ_PACKAGE_OPENSSH_INTERNAL_CRYPTO
	select FREETZ_LIB_libcrypt                if !FREETZ_PACKAGE_OPENSSH_STATIC && FREETZ_TARGET_UCLIBC_HAS_multiple_libs
	select FREETZ_LIB_libutil                 if !FREETZ_PACKAGE_OPENSSH_STATIC && FREETZ_TARGET_UCLIBC_HAS_multiple_libs
	default n
	help
		OpenSSH is the premier connectivity tool for remote login with the SSH
		protocol. It encrypts all traffic to eliminate eavesdropping, connection
		hijacking, and other attacks. In addition, OpenSSH provides a large suite
		of secure tunneling capabilities, several authentication methods, and
		sophisticated configuration options. 

if FREETZ_PACKAGE_OPENSSH

	choice
		prompt "Version"
			default FREETZ_PACKAGE_OPENSSH_VERSION_CURRENT

		config FREETZ_PACKAGE_OPENSSH_VERSION_ABANDON
			bool "9.3p2"
			depends on FREETZ_PACKAGE_OPENSSL_VERSION_0 || FREETZ_PACKAGE_OPENSSL_VERSION_1
			help
				Version 9.3p2 is the last with support for OpenSSL 1.0.2.

		config FREETZ_PACKAGE_OPENSSH_VERSION_CURRENT
			bool "9.4p1"
			depends on !FREETZ_PACKAGE_OPENSSL_VERSION_0 && !FREETZ_PACKAGE_OPENSSL_VERSION_1

	endchoice

	config FREETZ_PACKAGE_OPENSSH_AUTHORIZED_KEYS
		bool "Select authorized_keys"
		default y
		select FREETZ_PACKAGE_AUTHORIZED_KEYS
		help
			Selects the "authorized_keys: Frontend for SSH keys" web
			interface package to manage the authorized_keys file for
			key-based authentication and private keys.

	config FREETZ_PACKAGE_OPENSSH_sshd
		bool "SSH server (sshd)"
		select FREETZ_LIB_libcrypto               if !FREETZ_PACKAGE_OPENSSH_STATIC && !FREETZ_PACKAGE_OPENSSH_INTERNAL_CRYPTO
		select FREETZ_LIB_libz                    if !FREETZ_PACKAGE_OPENSSH_STATIC
		default n

	comment "SSH client (ssh) (not available, provided by dropbear)"
		depends on FREETZ_PACKAGE_DROPBEAR && !FREETZ_PACKAGE_DROPBEAR_SERVER_ONLY
	config FREETZ_PACKAGE_OPENSSH_ssh
		bool "SSH client (ssh)"
		depends on !FREETZ_PACKAGE_DROPBEAR || FREETZ_PACKAGE_DROPBEAR_SERVER_ONLY
		select FREETZ_LIB_libcrypto               if !FREETZ_PACKAGE_OPENSSH_STATIC && !FREETZ_PACKAGE_OPENSSH_INTERNAL_CRYPTO
		select FREETZ_LIB_libz                    if !FREETZ_PACKAGE_OPENSSH_STATIC
		default n

	comment "Secure copy (scp) (not available, provided by dropbear)"
		depends on FREETZ_PACKAGE_DROPBEAR && !FREETZ_PACKAGE_DROPBEAR_SERVER_ONLY
	config FREETZ_PACKAGE_OPENSSH_scp
		bool "Secure copy (scp)"
		depends on !FREETZ_PACKAGE_DROPBEAR || FREETZ_PACKAGE_DROPBEAR_SERVER_ONLY
		select FREETZ_PACKAGE_OPENSSH_ssh
		default n

	config FREETZ_PACKAGE_OPENSSH_CLIENTUTILS
		bool "Client utilities (ssh-add, ssh-agent)"
		select FREETZ_LIB_libcrypto               if !FREETZ_PACKAGE_OPENSSH_STATIC && !FREETZ_PACKAGE_OPENSSH_INTERNAL_CRYPTO
		select FREETZ_LIB_libz                    if !FREETZ_PACKAGE_OPENSSH_STATIC
		select FREETZ_PACKAGE_OPENSSH_ssh_add
		select FREETZ_PACKAGE_OPENSSH_ssh_agent
		default n
	if FREETZ_PACKAGE_OPENSSH_CLIENTUTILS
		config FREETZ_PACKAGE_OPENSSH_ssh_add
			bool
		config FREETZ_PACKAGE_OPENSSH_ssh_agent
			bool
	endif # FREETZ_PACKAGE_OPENSSH_CLIENTUTILS

	config FREETZ_PACKAGE_OPENSSH_KEYUTILS
		bool "Key utilities (ssh-keygen, ssh-keysign, ssh-keyscan)"
		select FREETZ_LIB_libcrypto               if !FREETZ_PACKAGE_OPENSSH_STATIC && !FREETZ_PACKAGE_OPENSSH_INTERNAL_CRYPTO
		select FREETZ_LIB_libz                    if !FREETZ_PACKAGE_OPENSSH_STATIC
		select FREETZ_PACKAGE_OPENSSH_ssh_keygen
		select FREETZ_PACKAGE_OPENSSH_ssh_keysign
		select FREETZ_PACKAGE_OPENSSH_ssh_keyscan
		default n
	if FREETZ_PACKAGE_OPENSSH_KEYUTILS
		config FREETZ_PACKAGE_OPENSSH_ssh_keygen
			bool
		config FREETZ_PACKAGE_OPENSSH_ssh_keysign
			bool
		config FREETZ_PACKAGE_OPENSSH_ssh_keyscan
			bool
	endif # FREETZ_PACKAGE_OPENSSH_KEYUTILS

	config FREETZ_PACKAGE_OPENSSH_sftp
		bool "SFTP client (sftp)"
		default n

	config FREETZ_PACKAGE_OPENSSH_sftp_server
		bool "SFTP server (sftp-server)"
		default n

	comment "Configuration ---"

	config FREETZ_PACKAGE_OPENSSH_INTERNAL_CRYPTO
		bool "Use internal crypto algorithms only"
		default n
		help
			Disable use of OpenSSL and use internal crypto algorithms only.

			Note: enabling this option
			 - eliminates OpenSSL as OpenSSH runtime dependency on the one hand
			 - limits the available KEy eXchange algorithms to ed25519 only
			   on the other one (your client must support it)

	config FREETZ_PACKAGE_OPENSSH_STATIC
		bool "Link statically"
		default n
		help
			OpenSSH needs the following shared libraries which
			can be linked in statically by activating this switch:
			- libcrypt
			- libcrypto
			- libdl
			- libutil
			- libz

endif # FREETZ_PACKAGE_OPENSSH
```

## make/pkgs/openssl/Config.in
```kconfig
config FREETZ_PACKAGE_OPENSSL
	bool "OpenSSL 0.9.8zh/1.0.2u/1.1.1w/3.0.17/3.5.1 (binary only)"
	default n
	select FREETZ_LIB_libdl              if !FREETZ_PACKAGE_OPENSSL_STATIC && FREETZ_TARGET_UCLIBC_HAS_multiple_libs
	select FREETZ_LIB_libpthread         if !FREETZ_PACKAGE_OPENSSL_STATIC && FREETZ_TARGET_UCLIBC_HAS_multiple_libs && FREETZ_OPENSSL_VERSION_11_MIN
	select FREETZ_LIB_libcrypto          if !FREETZ_PACKAGE_OPENSSL_STATIC
	select FREETZ_LIB_libssl             if !FREETZ_PACKAGE_OPENSSL_STATIC
	help
		This package contains the OpenSSL command-line utility.

if FREETZ_PACKAGE_OPENSSL

	choice
		prompt "Version"

		config FREETZ_PACKAGE_OPENSSL_VERSION_09
			bool "0.9.8 - DEPRECATED"
			depends on FREETZ_OPENSSL_VERSION_09

		config FREETZ_PACKAGE_OPENSSL_VERSION_10
			bool "1.0.2 - DEPRECATED"
			depends on FREETZ_OPENSSL_VERSION_10

		config FREETZ_PACKAGE_OPENSSL_VERSION_11
			bool "1.1.1 - DEPRECATED"
			depends on FREETZ_OPENSSL_VERSION_11

		config FREETZ_PACKAGE_OPENSSL_VERSION_30
			bool "3.0"
			depends on FREETZ_OPENSSL_VERSION_30

		config FREETZ_PACKAGE_OPENSSL_VERSION_35
			bool "3.5 - EXPERIMENTAL"
			depends on FREETZ_OPENSSL_VERSION_35

	endchoice

	config FREETZ_PACKAGE_OPENSSL_TRACE
		bool "With trace output support"
		depends on FREETZ_OPENSSL_VERSION_10_MIN
		default n
		help
			Build OpenSSL binary with SSL trace support.

	config FREETZ_PACKAGE_OPENSSL_STATIC
		bool "Link statically"
		default n
		help
			Causes all libraries OpenSSL binary depends on to be linked in statically.

endif # FREETZ_PACKAGE_OPENSSL
```

## make/pkgs/php8/Config.in
```kconfig
config FREETZ_PACKAGE_PHP8
	bool "PHP8 8.3.31/8.4.22/8.5.7 (binary only)"
	select FREETZ_PACKAGE_PHP8_cgi
	select FREETZ_LIB_libonig
	select FREETZ_LIB_libxml2
	select FREETZ_LIB_libxml2_WITH_HTML
	select FREETZ_LIB_libxml2_WITH_RELAXNG
	default n
	help
		PHP: Hypertext Preprocessor

		PHP is a widely-used general-purpose scripting language that is especially
		suited for Web development and can be embedded into HTML. Much of its syntax
		is borrowed from C, Java and Perl with a couple of unique PHP-specific features
		thrown in. The goal of the language is to allow web developers to write
		dynamically generated pages quickly.

if FREETZ_PACKAGE_PHP8

	choice
		prompt "Version"

		config FREETZ_PACKAGE_PHP8_VERSION_83
			bool "8.3"

		config FREETZ_PACKAGE_PHP8_VERSION_84
			bool "8.4"

		config FREETZ_PACKAGE_PHP8_VERSION_85
			bool "8.5"

	endchoice

menu "Binaries"

config FREETZ_PACKAGE_PHP8_cgi
	bool "PHP CGI"
	select FREETZ_LIB_libdl   if FREETZ_TARGET_UCLIBC_HAS_multiple_libs
	select FREETZ_LIB_libpcre2
	default y

config FREETZ_PACKAGE_PHP8_cli
	bool "PHP CLI"
	select FREETZ_LIB_libdl   if FREETZ_TARGET_UCLIBC_HAS_multiple_libs
	select FREETZ_LIB_libpcre2
	default n

config FREETZ_PACKAGE_PHP8_apxs2
	bool "Apache2 module"
	depends on !FREETZ_PACKAGE_PHP5_apxs2 && !FREETZ_PACKAGE_PHP_apxs2
	select FREETZ_LIB_libapr_WITH_DSO
	select FREETZ_LIB_libpcre2
	select FREETZ_LIB_libcurl            if FREETZ_PACKAGE_PHP8_WITH_CURL
	select FREETZ_LIB_libxml2            if FREETZ_PACKAGE_PHP8_WITH_LIBXML
	select FREETZ_LIB_libiconv           if FREETZ_PACKAGE_PHP8_WITH_LIBICONV
	select FREETZ_LIB_libsqlite3         if FREETZ_PACKAGE_PHP8_WITH_SQLITE3
	select FREETZ_LIB_libcrypto          if FREETZ_PACKAGE_PHP8_WITH_SSL
	select FREETZ_LIB_libssl             if FREETZ_PACKAGE_PHP8_WITH_SSL
	select FREETZ_LIB_libz               if FREETZ_PACKAGE_PHP8_WITH_ZLIB
	default n

endmenu

menu "PHP features"

config FREETZ_PACKAGE_PHP8_WITH_CURL
	bool "build with CURL support"
	select FREETZ_LIB_libcurl
	default n
	help
		This option enables the CURL support for PHP

config FREETZ_PACKAGE_PHP8_WITH_FILEINFO
	bool "build with FILEINFO support"
	default n
	help
		This option enables the FILEINFO support for PHP

config FREETZ_PACKAGE_PHP8_WITH_FTP
	bool "build with FTP support"
	depends on !FREETZ_PACKAGE_PHP8_VERSION_85
	default n
	help
		This option enables the FTP support for PHP.
		Note: The FTP extension was removed in PHP 8.5.

config FREETZ_PACKAGE_PHP8_WITH_GD
	bool "build with GD support"
	select FREETZ_LIB_libpng16
	default n
	help
		This option enables the bundled GD support for PHP

config FREETZ_PACKAGE_PHP8_WITH_GETTEXT
	bool "build with gettext support"
	select FREETZ_LIB_libintl
	default n
	help
		This option enables the gettext support for PHP

config FREETZ_PACKAGE_PHP8_WITH_ICONV
	bool "build with ICONV support"
	select FREETZ_PACKAGE_PHP8_WITH_LIBICONV if FREETZ_TARGET_UCLIBC_0_9_28
	default n
	help
		This option enables the ICONV support for PHP

	config FREETZ_PACKAGE_PHP8_WITH_LIBICONV
		bool "prefer libiconv to libc"
		depends on FREETZ_PACKAGE_PHP8_WITH_ICONV
		depends on FREETZ_TARGET_UCLIBC_0_9_28
		select FREETZ_LIB_libiconv
		default n
		help
			This option causes PHP to use libiconv implementation of iconv function
			instead of the libc one. Select this option if you need more charsets
			than supported by libc (ISO-8859-1 and UTF-8 only) or your application
			relies on libiconv specific features like TRANSLIT, IGNORE, etc.

config FREETZ_PACKAGE_PHP8_WITH_LIBXML
	bool "build with XML support"
	select FREETZ_LIB_libxml2
	select FREETZ_LIB_libxml2_WITH_HTML
	select FREETZ_LIB_libxml2_WITH_RELAXNG
	default n
	help
		This option enables the XML, DOM, SimpleXML, XMLReader and XMLWriter
		support for PHP.
		Note: libxml2 is always linked into PHP regardless of this setting,
		as PHP's core requires it internally. Disabling this option only
		omits the higher-level XML extension APIs.

config FREETZ_PACKAGE_PHP8_WITH_PCNTL
	bool "build with PCNTL support"
	default n
	help
		This option enables the PCNTL support for PHP

config FREETZ_PACKAGE_PHP8_WITH_SESSION
	bool "build with SESSION support"
	default n
	help
		This option enables the SESSION support for PHP

config FREETZ_PACKAGE_PHP8_WITH_SOCKETS
	bool "build with SOCKETS support"
	default n
	help
		This option enables the SOCKETS support for PHP

config FREETZ_PACKAGE_PHP8_WITH_SQLITE3
	bool "build with SQLite (v3) support"
	select FREETZ_LIB_libsqlite3
	default n
	help
		This option enables the SQLite (v3) support for PHP

config FREETZ_PACKAGE_PHP8_WITH_SSL
	bool "build with SSL support"
	select FREETZ_LIB_libcrypto
	select FREETZ_LIB_libssl
	default n
	help
		This option enables the SSL support for PHP

config FREETZ_PACKAGE_PHP8_WITH_SYSVIPC
	bool "build with SYSVIPC support"
	default n
	help
		This option enables the SYSVIPC support for PHP

config FREETZ_PACKAGE_PHP8_WITH_ZLIB
	bool "build with ZLIB support"
	select FREETZ_LIB_libz
	default n
	help
		This option enables the ZLIB support for PHP

config FREETZ_PACKAGE_PHP8_WITH_ZIP
	bool "build with ZIP support"
	select FREETZ_LIB_libzip
	select FREETZ_PACKAGE_PHP8_WITH_ZLIB
	default n
	help
		This option enables the ZIP support for PHP

config FREETZ_PACKAGE_PHP8_WITH_FFI
	bool "build with FFI support"
	select FREETZ_LIB_libffi
	default n
	help
		This option enables the Foreign Function Interface (FFI) support for PHP

config FREETZ_PACKAGE_PHP8_WITH_MYSQLI
	bool "build with MySQLi/PDO_MySQL support (mysqlnd)"
	default n
	help
		Enables the mysqli and PDO_MySQL extensions using the bundled
		mysqlnd driver. No external MySQL library is required.
		For SSL-encrypted connections, also enable SSL support.

endmenu

endif # FREETZ_PACKAGE_PHP8
```

## make/pkgs/privoxy/Config.in
```kconfig
config FREETZ_PACKAGE_PRIVOXY
	bool "Privoxy 4.1.0"
	default n
	help
		Privoxy is a web proxy with advanced filtering capabilities for protecting privacy, modifying web page
		data, managing cookies, controlling access, and removing ads, banners, pop-ups and other obnoxious
		Internet junk.

		It can also be used together with Tor Proxy to forward HTTP traffic to Tor as described in the Tor
		documentation.

		Open http://config.privoxy.org/show-status for details.

if FREETZ_PACKAGE_PRIVOXY

	config FREETZ_PACKAGE_PRIVOXY_WITH_ADBLOCK
		bool "With AdBlock filter list downloader"
		select FREETZ_PACKAGE_WGET
		select FREETZ_PACKAGE_WGET_WITH_SSL
		default n
		help
			This option enables automatic filter list downloads from adblock.org.
			Requires and selects GNU wget (busybox wget does not support https).

	choice
		prompt "pcre"
			default FREETZ_PACKAGE_PRIVOXY_WITH_PCRE2

		config FREETZ_PACKAGE_PRIVOXY_WITH_PCRE1
			bool "shared v1"
			select FREETZ_LIB_libpcre
			select FREETZ_LIB_libpcreposix

		config FREETZ_PACKAGE_PRIVOXY_WITH_PCRE2
			bool "shared v2"
			select FREETZ_LIB_libpcre2
			select FREETZ_LIB_libpcre2_posix

	endchoice

	config FREETZ_PACKAGE_PRIVOXY_WITH_ZLIB
		bool "With zlib Compression"
		select FREETZ_LIB_libz
		default n
		help
			ZLIB Compression for privoxy

endif # FREETZ_PACKAGE_PRIVOXY
```
