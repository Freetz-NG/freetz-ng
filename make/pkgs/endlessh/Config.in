## make/pkgs/nano/Config.in
```kconfig
menuconfig FREETZ_PACKAGE_NANO
	bool "Nano 7.1 (binary only)"
	select FREETZ_LIB_libncurses if !FREETZ_PACKAGE_NANO_UTF8
	default n
	help
		GNU GPL'd Pico clone with more functionality.

		GNU nano is a small and friendly text editor. Besides basic text
		editing, nano offers many extra features like an interactive search
		and replace, go to line and column number, auto-indentation, feature
		toggles and filename tab completion.

		The original goal for nano was a complete bug-for-bug compatible
		emulation of Pico, but nano's current goal is to be as compatible as
		possible while offering a superset of Pico's functionality.

		IMPORTANT NOTES:

		1.) Selecting any option besides "Tiny binary" will make the nano binary
		bigger. The range is somewhere between 142 KB and 249 KB, depending on
		the options chosen.

		2.) Please also be aware of the fact that changing any feature options
		results in an automatic rebuild of the package - just in case you were
		wondering.

		3.) Note that UTF8 support and spell checking is disabled by default.

if FREETZ_PACKAGE_NANO

	config FREETZ_PACKAGE_NANO_UTF8
		bool "With UTF8 support"
		select FREETZ_LIB_libncursesw
		default y
		help
			Use ncursesw for UTF8 support.

	config FREETZ_PACKAGE_NANO_TINY
		bool "Tiny binary"
		default y
		help
			Strip whichever feature possible from the Nano binary and keep
			everything small and simple, yet powerful and easy to use.

			With this option enabled as the only one, Nano's binary has an
			approximate size of 142 KB. NOTE that deselecting this option
			already results in a 182 KB binary in size although no other
			option has been selected. This is because nano compiler option
			"--enable-tiny" also disables some larger internals like
			marking and cutting to the end of a line.

	config FREETZ_PACKAGE_NANO_HELP
		bool "Online help"
		depends on ! FREETZ_PACKAGE_NANO_TINY
		select FREETZ_PACKAGE_NANO_MULTIBUFFER
		default n
		help
			Show a list of available keyboard commands via Ctrl-G or F1. As the
			name suggests, this is quite helpful. ;-)

			This option adds about 8.4 KB to the minimum 182 KB of Nano's non-tiny binary.

			If you are unfamiliar with Nano and Pico and have some space left
			in the firmware image, you are recommended choosing this option anyway.

	config FREETZ_PACKAGE_NANO_TABCOMP
		bool "Tab completion for file names"
		depends on ! FREETZ_PACKAGE_NANO_TINY
		default n
		help
			When opening or saving files, you get tab completion for directory and
			file names. Even with the file browser switched off, this is a
			powerful tool to help you save time when typing in path names.

			This option adds about 4.7 KB to the minimum 182 KB
			of Nano's non-tiny binary.

	config FREETZ_PACKAGE_NANO_BROWSER
		bool "File browser"
		depends on ! FREETZ_PACKAGE_NANO_TINY
		default n
		help
			Browse the directory structure in a multi-line area showing
			directories and files between which you can navigate with the
			keyboard. The Browser is invoked by pressing ^T when entering
			a file name to open/write.

			This option adds about 9.7 KB to the minimum 182 KB
			of Nano's non-tiny binary.

	config FREETZ_PACKAGE_NANO_OPERATINGDIR
		bool "Set operating directory"
		depends on ! FREETZ_PACKAGE_NANO_TINY
		default n
		help
			Set operating directory. Makes Nano set up something
			similar to a chroot by using the '-o' command line option.

			This option adds almost nothing to the minimum 182 KB
			of Nano's non-tiny binary.

	config FREETZ_PACKAGE_NANO_JUSTIFY
		bool "Justify/unjustify functions"
		depends on ! FREETZ_PACKAGE_NANO_TINY
		default n
		help
			Support for (un-)justifying paragraphs of text, e.g. program code.

			This option adds about 9.4 KB to the minimum 182 KB
			of Nano's non-tiny binary.

	config FREETZ_PACKAGE_NANO_WRAPPING
		depends on ! FREETZ_PACKAGE_NANO_TINY
		bool "Long line wrapping"
		default n
		help
			Enable long line wrapping. This also creates the -w command line
			option which enables long line wrapping.

			This option adds about 4.4 KB to the minimum 182 KB
			of Nano's non-tiny binary.

	config FREETZ_PACKAGE_NANO_WRAPPING_ROOT
		depends on FREETZ_PACKAGE_NANO_WRAPPING
		bool "Disable long line wrapping for root"
		default n
		help
			Disable long line wrapping feature if nano is run as root.

			This option adds almost nothing to the minimum 182 KB
			of Nano's non-tiny binary.

	config FREETZ_PACKAGE_NANO_MULTIBUFFER
		bool "Multiple file buffers"
		default n
		help
			Edit multiple files at once and cycle through the different buffers
			via simple keyboard commands.

			This option adds about 4.4 KB to the minimum 182 KB
			of Nano's non-tiny binary.

	config FREETZ_PACKAGE_NANO_MOUSE_CONTROL
		bool "Mouse control"
		default n
		help
			Nano has its own built-in mouse services, but they are limited.
			They provide only the ability to move the cursor to the point
			where you click, and to mark the beginning and end of a section
			of text. Use the Alt-M key combination to toggle between using
			the terminal's mouse services and nano's built-in mouse services.

	config FREETZ_PACKAGE_NANO_NANORC
		bool "Nanorc startup file support"
		default n
		help
			Enable support for reading the nanorc file at startup. You can store
			custom settings in the nanorc file rather than having to pass command
			line options to get desired behavior.

			This option adds about 9.6 KB to the minimum 182 KB
			of Nano's non-tiny binary.

			NOTE: A nanorc file with editing support is added to your firmware.

	config FREETZ_PACKAGE_NANO_COLOR_SYNTAX
		bool "Coloured syntax highlighting support"
		default n
		select FREETZ_PACKAGE_NANO_NANORC
		help
			Enable support for syntax coloring of files using the nanorc file.
			This enables nanorc support, but does NOT automatically copy any
			syntax files to the target system.

			This option adds about 21.4 KB plus possibly a few KB of your
			syntax files to the minimum 182 KB of Nano's non-tiny binary,
			including nanorc support.

			IMPORTANT NOTES:

			If you want to include any syntax definition files by yourself
			(look for *.nanorc in the nano source package (doc/systax), define
			or download your own files), you are advised to copy them into
			make/nano/files/root/usr/share/nano/ before compiling Freetz.
			This way your snytax files are enabled automatically when saving
			your customized nanorc via WebIf or on startup.

			You can select some of nano's default syntax highlighting files
			to be integrated into the firmware image by the "Nano syntax
			highlighting files" menu below (visible if this option is selected).
			Files selected in the menu are also enabled automatically.

	if FREETZ_PACKAGE_NANO_COLOR_SYNTAX

		config FREETZ_PACKAGE_NANO_SYNTAX_FILE_SH
			bool "Syntax highlighting for .sh files"
			default y
			help
				Adds sh.nanorc to /usr/share/nano so you can use it in nanorc to
				enable syntax highlighting for .sh files.

		config FREETZ_PACKAGE_NANO_SYNTAX_FILE_NANORC
			bool "Syntax highlighting for .nanorc files"
			default y
			help
				Adds nanorc.nanorc to /usr/share/nano so you can use it in nanorc to
				enable syntax highlighting for .nanorc files.

		config FREETZ_PACKAGE_NANO_SYNTAX_FILE_C
			bool "Syntax highlighting for .c files"
			default y
			help
				Adds c.nanorc to /usr/share/nano so you can use it in nanorc to
				enable syntax highlighting for .c files.

		config FREETZ_PACKAGE_NANO_SYNTAX_FILE_CSS
			bool "Syntax highlighting for .css files"
			default y
			help
				Adds css.nanorc to /usr/share/nano so you can use it in nanorc to
				enable syntax highlighting for .css files.

		config FREETZ_PACKAGE_NANO_SYNTAX_FILE_HTML
			bool "Syntax highlighting for .html files"
			default y
			help
				Adds html.nanorc to /usr/share/nano so you can use it in nanorc to
				enable syntax highlighting for .html files.

		config FREETZ_PACKAGE_NANO_SYNTAX_FILE_PHP
			bool "Syntax highlighting for .php files"
			default y
			help
				Adds php.nanorc to /usr/share/nano so you can use it in nanorc to
				enable syntax highlighting for .php files.

		config FREETZ_PACKAGE_NANO_SYNTAX_FILE_TEX
			bool "Syntax highlighting for .tex files"
			default y
			help
				Adds tex.nanorc to /usr/share/nano so you can use it in nanorc to
				enable syntax highlighting for .tex files.

		config FREETZ_PACKAGE_NANO_SYNTAX_FILE_PATCH
			bool "Syntax highlighting for .patch files"
			default y
			help
				Adds patch.nanorc to /usr/share/nano so you can use it in nanorc to
				enable syntax highlighting for .patch files.

		config FREETZ_PACKAGE_NANO_SYNTAX_FILE_XML
			bool "Syntax highlighting for .xml files"
			default y
			help
				Adds xml.nanorc to /usr/share/nano so you can use it in nanorc to
				enable syntax highlighting for .xml files.

	endif # FREETZ_PACKAGE_NANO_COLOR_SYNTAX

endif # FREETZ_PACKAGE_NANO
```

## make/pkgs/nginx/Config.in
```kconfig
menuconfig FREETZ_PACKAGE_NGINX
	bool "Nginx 1.29.3"
	select FREETZ_LIB_libpthread if FREETZ_TARGET_UCLIBC_HAS_multiple_libs
	default n
	help
		Nginx is a high-performance HTTP server and reverse proxy, as well as
		an IMAP/POP3 proxy server. Nginx is known for its high performance,
		stability, rich feature set, simple configuration, and low resource
		consumption.

if FREETZ_PACKAGE_NGINX

config FREETZ_PACKAGE_NGINX_WITH_SSL
	bool "SSL support"
	select FREETZ_LIB_libssl
	select FREETZ_LIB_libcrypto
	default y
	help
		Enable HTTPS/SSL support and HTTP/2.

config FREETZ_PACKAGE_NGINX_WITH_STUB_STATUS
	bool "Stub status module"
	default y
	help
		Provides access to basic status information.

config FREETZ_PACKAGE_NGINX_WITH_GZIP_STATIC
	bool "Gzip static module"
	default y
	help
		Allows sending precompressed files with the ".gz" filename extension
		instead of regular files.

config FREETZ_PACKAGE_NGINX_WITH_REALIP
	bool "Real IP module"
	default n
	help
		Changes the client address to the one sent in the specified header field.

config FREETZ_PACKAGE_NGINX_WITH_AUTH_REQUEST
	bool "Auth request module"
	default n
	help
		Implements client authorization based on the result of a subrequest.

config FREETZ_PACKAGE_NGINX_WITH_DAV
	bool "WebDAV module"
	default n
	help
		Adds WebDAV support (PUT, DELETE, MKCOL, COPY, and MOVE methods).

config FREETZ_PACKAGE_NGINX_WITH_FLV
	bool "FLV module"
	default n
	help
		Provides pseudo-streaming server-side support for Flash Video (FLV) files.

config FREETZ_PACKAGE_NGINX_WITH_MP4
	bool "MP4 module"
	default n
	help
		Provides pseudo-streaming server-side support for MP4 files.

config FREETZ_PACKAGE_NGINX_WITH_SUB
	bool "Substitution filter module"
	default n
	help
		Modifies a response by replacing one specified string by another.

config FREETZ_PACKAGE_NGINX_WITH_PROXY
	bool "Proxy module"
	default y
	help
		Allows passing requests to another server.

config FREETZ_PACKAGE_NGINX_WITH_FASTCGI
	bool "FastCGI module"
	default y
	help
		Allows passing requests to a FastCGI server (e.g., PHP-FPM).

config FREETZ_PACKAGE_NGINX_WITH_STREAM
	bool "Stream module"
	default n
	help
		Provides support for TCP/UDP proxying and load balancing.

comment "Additional HTTP modules (disabled by default to save space)"

config FREETZ_PACKAGE_NGINX_WITH_SSI
	bool "SSI (Server Side Includes) module"
	default n
	help
		Processes SSI (Server Side Includes) commands in responses passing through it.

config FREETZ_PACKAGE_NGINX_WITH_USERID
	bool "User ID module"
	default n
	help
		Issues cookies suitable for client identification.

config FREETZ_PACKAGE_NGINX_WITH_AUTOINDEX
	bool "Autoindex module"
	default n
	help
		Processes requests ending with the slash character and produces a directory listing.

config FREETZ_PACKAGE_NGINX_WITH_GEO
	bool "Geo module"
	default n
	help
		Creates variables with values depending on the client IP address.

config FREETZ_PACKAGE_NGINX_WITH_MAP
	bool "Map module"
	default n
	help
		Creates variables whose values depend on values of other variables.

config FREETZ_PACKAGE_NGINX_WITH_SPLIT_CLIENTS
	bool "Split clients module"
	default n
	help
		Creates variables suitable for A/B testing (split testing).

config FREETZ_PACKAGE_NGINX_WITH_REFERER
	bool "Referer module"
	default n
	help
		Blocks access to the site for requests with invalid values in the Referer header field.

config FREETZ_PACKAGE_NGINX_WITH_UWSGI
	bool "uWSGI module"
	default n
	help
		Allows passing requests to a uwsgi server.

config FREETZ_PACKAGE_NGINX_WITH_SCGI
	bool "SCGI module"
	default n
	help
		Allows passing requests to an SCGI server.

config FREETZ_PACKAGE_NGINX_WITH_MEMCACHED
	bool "Memcached module"
	default n
	help
		Obtains responses from a memcached server.

config FREETZ_PACKAGE_NGINX_WITH_LIMIT_CONN
	bool "Limit conn module"
	default n
	help
		Limits the number of connections per the defined key.

config FREETZ_PACKAGE_NGINX_WITH_LIMIT_REQ
	bool "Limit req module"
	default n
	help
		Limits the request processing rate per a defined key.

config FREETZ_PACKAGE_NGINX_WITH_EMPTY_GIF
	bool "Empty GIF module"
	default n
	help
		Emits single-pixel transparent GIF.

config FREETZ_PACKAGE_NGINX_WITH_BROWSER
	bool "Browser module"
	default n
	help
		Creates variables whose values depend on the value of the User-Agent request header.

config FREETZ_PACKAGE_NGINX_WITH_UPSTREAM_HASH
	bool "Upstream hash module"
	default n
	help
		Specifies a load balancing method where the server is selected based on a user-defined hashed key.

config FREETZ_PACKAGE_NGINX_WITH_UPSTREAM_IP_HASH
	bool "Upstream IP hash module"
	default n
	help
		Specifies that a group should use a load balancing method where requests are distributed between servers based on client IP addresses.

config FREETZ_PACKAGE_NGINX_WITH_UPSTREAM_LEAST_CONN
	bool "Upstream least conn module"
	default n
	help
		Specifies that a group should use a load balancing method where a request is passed to the server with the least number of active connections.

config FREETZ_PACKAGE_NGINX_WITH_UPSTREAM_RANDOM
	bool "Upstream random module"
	default n
	help
		Specifies that a group should use a load balancing method where a request is passed to a randomly selected server.

config FREETZ_PACKAGE_NGINX_WITH_UPSTREAM_KEEPALIVE
	bool "Upstream keepalive module"
	default n
	help
		Activates the cache for connections to upstream servers.

config FREETZ_PACKAGE_NGINX_WITH_UPSTREAM_ZONE
	bool "Upstream zone module"
	default n
	help
		Defines the name and size of the shared memory zone that keeps the group's configuration and run-time state.

comment "Mail proxy modules (disabled by default)"

config FREETZ_PACKAGE_NGINX_WITH_MAIL
	bool "Mail proxy support"
	default n
	help
		Enable mail proxy functionality (POP3/IMAP/SMTP).

if FREETZ_PACKAGE_NGINX_WITH_MAIL

config FREETZ_PACKAGE_NGINX_WITH_MAIL_SSL
	bool "Mail SSL module"
	default n
	help
		Adds SSL/TLS protocol support to a mail proxy server.

endif

config FREETZ_PACKAGE_NGINX_CONF_PATH
	string "Configuration file path"
	default "/mod/etc/nginx/nginx.conf"
	help
		Path to the nginx configuration file.

config FREETZ_PACKAGE_NGINX_PID_PATH
	string "PID file path"
	default "/var/run/nginx.pid"
	help
		Path to the nginx PID file.

config FREETZ_PACKAGE_NGINX_ERROR_LOG_PATH
	string "Error log path"
	default "/var/log/nginx/error.log"
	help
		Path to the nginx error log file.

config FREETZ_PACKAGE_NGINX_HTTP_LOG_PATH
	string "HTTP access log path"
	default "/var/log/nginx/access.log"
	help
		Path to the nginx HTTP access log file.

endif
```

## make/pkgs/openntpd/Config.in
```kconfig
config FREETZ_PACKAGE_OPENNTPD
	bool "Openntpd 3.9p1"
	select FREETZ_ADD_ETCSERVICES        if !FREETZ_AVM_HAS_ETCSERVICES
	select FREETZ_AVMDAEMON_DISABLE_NTP  if FREETZ_AVM_HAS_AVMMULTID_NTPCLIENT
	select FREETZ_REMOVE_CHRONYD         if FREETZ_AVM_HAS_CHRONYD
	default n
	help
		OpenNTPD is a FREE, easy to use implementation of the Network Time Protocol.

		This package automatically removes AVM'S chronyd if necessary.
```
