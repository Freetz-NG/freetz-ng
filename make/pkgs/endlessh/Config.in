## make/pkgs/endlessh/Config.in
```kconfig
config FREETZ_PACKAGE_ENDLESSH
	bool "endlessh 1.0"
	default n
	help
		Endlessh is an SSH tarpit that very slowly sends an endless, 
		random SSH banner. It keeps SSH clients locked up for hours 
		or even days at a time. The purpose is to put your real 
		SSH server on another port and then let the script kiddies 
		get stuck in this tarpit instead of bothering a real server.
```

## make/pkgs/ffmpeg/Config.in
```kconfig
menuconfig FREETZ_PACKAGE_FFMPEG
	bool "FFmpeg 5.1.4/7.1.1"
	default n
	depends on !FREETZ_TARGET_UCLIBC_0_9_28 && !FREETZ_TARGET_UCLIBC_0_9_29
	help
		FFmpeg is a complete, cross-platform solution to record,
		convert and stream audio and video.

if FREETZ_PACKAGE_FFMPEG

	choice
		prompt "Version"
			default FREETZ_PACKAGE_FFMPEG_VERSION_CURRENT

		config FREETZ_PACKAGE_FFMPEG_VERSION_ABANDON
			bool "5.1.4"

		config FREETZ_PACKAGE_FFMPEG_VERSION_CURRENT
			bool "7.1.1"
			depends on !FREETZ_TARGET_GCC_4_MAX
			depends on !FREETZ_PACKAGE_MINIDLNA

	endchoice

	config FREETZ_PACKAGE_FFMPEG_ffmpeg
		bool "Include ffmpeg"
		select FREETZ_LIB_libm        if FREETZ_TARGET_UCLIBC_HAS_multiple_libs
		select FREETZ_LIB_libpthread  if FREETZ_TARGET_UCLIBC_HAS_multiple_libs
		select FREETZ_LIB_libavcodec
		select FREETZ_LIB_libavdevice
		select FREETZ_LIB_libavfilter
		select FREETZ_LIB_libavformat
		select FREETZ_LIB_libavutil
		select FREETZ_LIB_libpostproc
		select FREETZ_LIB_libswresample
		select FREETZ_LIB_libswscale
		default n

	config FREETZ_PACKAGE_FFMPEG_ffprobe
		bool "Include ffprobe"
		select FREETZ_LIB_libm        if FREETZ_TARGET_UCLIBC_HAS_multiple_libs
		select FREETZ_LIB_libpthread  if FREETZ_TARGET_UCLIBC_HAS_multiple_libs
		select FREETZ_LIB_libavcodec
		select FREETZ_LIB_libavdevice
		select FREETZ_LIB_libavfilter
		select FREETZ_LIB_libavformat
		select FREETZ_LIB_libavutil
		select FREETZ_LIB_libpostproc
		select FREETZ_LIB_libswresample
		select FREETZ_LIB_libswscale
		default n

	config FREETZ_PACKAGE_FFMPEG_LZMA
		bool # "Include LZMA support"
		depends on FREETZ_PACKAGE_FFMPEG_ENCODER_tiff || FREETZ_PACKAGE_FFMPEG_DECODER_tiff

	config FREETZ_PACKAGE_FFMPEG_SSL
		bool "Include SSL support"
		default n

		choice
			prompt "Provided by"
			depends on FREETZ_PACKAGE_FFMPEG_SSL
			default FREETZ_PACKAGE_FFMPEG_SSL_MBEDTLS

			config FREETZ_PACKAGE_FFMPEG_SSL_OPENSSL
				bool "OpenSSL"
				depends on !FREETZ_OPENSSL_VERSION_10
				select FREETZ_PACKAGE_FFMPEG_NONFREE if FREETZ_OPENSSL_VERSION_11

			config FREETZ_PACKAGE_FFMPEG_SSL_MBEDTLS
				bool "MbedTLS"

#			config FREETZ_PACKAGE_FFMPEG_SSL_GNUTLS
#				bool "GnuTLS"

		endchoice # "Provided by"

	config FREETZ_PACKAGE_FFMPEG_NONFREE
		bool "Include nonfree code"
		default n

	config FREETZ_PACKAGE_FFMPEG_PATENTED
		bool "Include patented codecs and technologies"
		default n

	config FREETZ_PACKAGE_FFMPEG_LIBDLNA_SUPPORT
		bool "Include support for libdlna/ushare"
		depends on FREETZ_PACKAGE_FFMPEG_PATENTED
		select FREETZ_PACKAGE_FFMPEG_DECODER_ac3
		select FREETZ_PACKAGE_FFMPEG_DECODER_atrac3
		select FREETZ_PACKAGE_FFMPEG_DECODER_h264
		select FREETZ_PACKAGE_FFMPEG_DECODER_jpegls
		select FREETZ_PACKAGE_FFMPEG_DECODER_mp2
		select FREETZ_PACKAGE_FFMPEG_DECODER_mp3
		select FREETZ_PACKAGE_FFMPEG_DECODER_mpeg1video
		select FREETZ_PACKAGE_FFMPEG_DECODER_mpeg2video
		select FREETZ_PACKAGE_FFMPEG_DECODER_mpeg4
		select FREETZ_PACKAGE_FFMPEG_DECODER_mpegvideo
		select FREETZ_PACKAGE_FFMPEG_DECODER_wmav1
		select FREETZ_PACKAGE_FFMPEG_DECODER_wmav2
		select FREETZ_PACKAGE_FFMPEG_DECODER_png
		select FREETZ_PACKAGE_FFMPEG_DEMUXER_ac3
		select FREETZ_PACKAGE_FFMPEG_DEMUXER_avi
		select FREETZ_PACKAGE_FFMPEG_DEMUXER_h264
		select FREETZ_PACKAGE_FFMPEG_DEMUXER_matroska
		select FREETZ_PACKAGE_FFMPEG_DEMUXER_mp3
		select FREETZ_PACKAGE_FFMPEG_DEMUXER_mpegvideo
		select FREETZ_PACKAGE_FFMPEG_PROTOCOL_file
		default n

	config FREETZ_PACKAGE_FFMPEG_EVERYTHING
		bool "Include everything - EXPERIMENTAL"
		select FREETZ_PACKAGE_FFMPEG_PATENTED
		select FREETZ_PACKAGE_FFMPEG_LIBDLNA_SUPPORT
		select FREETZ_PACKAGE_FFMPEG_ENCODER_ac3
		select FREETZ_PACKAGE_FFMPEG_ENCODER_jpegls
		select FREETZ_PACKAGE_FFMPEG_ENCODER_mjpeg
		select FREETZ_PACKAGE_FFMPEG_ENCODER_mpeg1video
		select FREETZ_PACKAGE_FFMPEG_ENCODER_mpeg2video
		select FREETZ_PACKAGE_FFMPEG_ENCODER_mpeg4
		select FREETZ_PACKAGE_FFMPEG_ENCODER_pcm_s16be
		select FREETZ_PACKAGE_FFMPEG_ENCODER_pcm_s16le
		select FREETZ_PACKAGE_FFMPEG_ENCODER_png
		select FREETZ_PACKAGE_FFMPEG_ENCODER_tiff
		select FREETZ_PACKAGE_FFMPEG_ENCODER_vorbis
		select FREETZ_PACKAGE_FFMPEG_ENCODER_zlib
		select FREETZ_PACKAGE_FFMPEG_DECODER_aac
		select FREETZ_PACKAGE_FFMPEG_DECODER_ac3
		select FREETZ_PACKAGE_FFMPEG_DECODER_atrac3
		select FREETZ_PACKAGE_FFMPEG_DECODER_gif
		select FREETZ_PACKAGE_FFMPEG_DECODER_h264
		select FREETZ_PACKAGE_FFMPEG_DECODER_jpegls
#		select FREETZ_PACKAGE_FFMPEG_DECODER_libopenjpeg
		select FREETZ_PACKAGE_FFMPEG_DECODER_mjpeg
		select FREETZ_PACKAGE_FFMPEG_DECODER_mjpegb
		select FREETZ_PACKAGE_FFMPEG_DECODER_mp2
		select FREETZ_PACKAGE_FFMPEG_DECODER_mp3
		select FREETZ_PACKAGE_FFMPEG_DECODER_mpegvideo
		select FREETZ_PACKAGE_FFMPEG_DECODER_mpeg1video
		select FREETZ_PACKAGE_FFMPEG_DECODER_mpeg2video
		select FREETZ_PACKAGE_FFMPEG_DECODER_mpeg4
		select FREETZ_PACKAGE_FFMPEG_DECODER_pcm_s16be
		select FREETZ_PACKAGE_FFMPEG_DECODER_pcm_s16le
		select FREETZ_PACKAGE_FFMPEG_DECODER_png
		select FREETZ_PACKAGE_FFMPEG_DECODER_tiff
		select FREETZ_PACKAGE_FFMPEG_DECODER_vorbis
		select FREETZ_PACKAGE_FFMPEG_DECODER_wmav1
		select FREETZ_PACKAGE_FFMPEG_DECODER_wmav2
		select FREETZ_PACKAGE_FFMPEG_DECODER_zlib
		select FREETZ_PACKAGE_FFMPEG_MUXER_ac3
		select FREETZ_PACKAGE_FFMPEG_MUXER_avi
		select FREETZ_PACKAGE_FFMPEG_MUXER_flv
		select FREETZ_PACKAGE_FFMPEG_MUXER_h264
		select FREETZ_PACKAGE_FFMPEG_MUXER_matroska
		select FREETZ_PACKAGE_FFMPEG_MUXER_mjpeg
		select FREETZ_PACKAGE_FFMPEG_MUXER_mov
		select FREETZ_PACKAGE_FFMPEG_MUXER_mp3
		select FREETZ_PACKAGE_FFMPEG_MUXER_mp4
		select FREETZ_PACKAGE_FFMPEG_MUXER_mpeg1video
		select FREETZ_PACKAGE_FFMPEG_MUXER_mpeg2video
		select FREETZ_PACKAGE_FFMPEG_MUXER_mpegts
		select FREETZ_PACKAGE_FFMPEG_MUXER_ogg
		select FREETZ_PACKAGE_FFMPEG_MUXER_rtp
		select FREETZ_PACKAGE_FFMPEG_DEMUXER_ac3
		select FREETZ_PACKAGE_FFMPEG_DEMUXER_avi
		select FREETZ_PACKAGE_FFMPEG_DEMUXER_flv
		select FREETZ_PACKAGE_FFMPEG_DEMUXER_h264
		select FREETZ_PACKAGE_FFMPEG_DEMUXER_image2
		select FREETZ_PACKAGE_FFMPEG_DEMUXER_matroska
		select FREETZ_PACKAGE_FFMPEG_DEMUXER_mjpeg
		select FREETZ_PACKAGE_FFMPEG_DEMUXER_mov
		select FREETZ_PACKAGE_FFMPEG_DEMUXER_mp3
		select FREETZ_PACKAGE_FFMPEG_DEMUXER_mpegvideo
		select FREETZ_PACKAGE_FFMPEG_DEMUXER_mpegps
		select FREETZ_PACKAGE_FFMPEG_DEMUXER_mpegts
		select FREETZ_PACKAGE_FFMPEG_DEMUXER_ogg
		select FREETZ_PACKAGE_FFMPEG_DEMUXER_rm
		select FREETZ_PACKAGE_FFMPEG_DEMUXER_rtsp
		select FREETZ_PACKAGE_FFMPEG_DEMUXER_sdp
		select FREETZ_PACKAGE_FFMPEG_PARSER_aac
		select FREETZ_PACKAGE_FFMPEG_PARSER_ac3
		select FREETZ_PACKAGE_FFMPEG_PARSER_h264
		select FREETZ_PACKAGE_FFMPEG_PARSER_mjpeg
		select FREETZ_PACKAGE_FFMPEG_PARSER_mpegaudio
		select FREETZ_PACKAGE_FFMPEG_PARSER_mpegvideo
		select FREETZ_PACKAGE_FFMPEG_PARSER_mpeg4video
		select FREETZ_PACKAGE_FFMPEG_PROTOCOL_file
		select FREETZ_PACKAGE_FFMPEG_PROTOCOL_http
		select FREETZ_PACKAGE_FFMPEG_PROTOCOL_https
		select FREETZ_PACKAGE_FFMPEG_PROTOCOL_pipe
		select FREETZ_PACKAGE_FFMPEG_PROTOCOL_rtp
		select FREETZ_PACKAGE_FFMPEG_PROTOCOL_tcp
		select FREETZ_PACKAGE_FFMPEG_PROTOCOL_udp
		default n


	comment "Encoders ---"

	config FREETZ_PACKAGE_FFMPEG_ENCODER_ac3
		bool "AC3"
		depends on FREETZ_PACKAGE_FFMPEG_PATENTED
		select FREETZ_PACKAGE_FFMPEG_PARSER_ac3

	config FREETZ_PACKAGE_FFMPEG_ENCODER_jpegls
		bool "JPEG-LS"

	config FREETZ_PACKAGE_FFMPEG_ENCODER_mjpeg
		bool "MJPEG"

	config FREETZ_PACKAGE_FFMPEG_ENCODER_mpeg1video
		bool "MPEG-1 Video"

	config FREETZ_PACKAGE_FFMPEG_ENCODER_mpeg2video
		bool "MPEG-2 Video"
		depends on FREETZ_PACKAGE_FFMPEG_PATENTED

	config FREETZ_PACKAGE_FFMPEG_ENCODER_mpeg4
		bool "MPEG-4"
		depends on FREETZ_PACKAGE_FFMPEG_PATENTED

	config FREETZ_PACKAGE_FFMPEG_ENCODER_pcm_s16be
		bool "PCM signed 16-bit big-endian"

	config FREETZ_PACKAGE_FFMPEG_ENCODER_pcm_s16le
		bool "PCM signed 16-bit little-endian"

	config FREETZ_PACKAGE_FFMPEG_ENCODER_png
		bool "PNG"
		select FREETZ_PACKAGE_FFMPEG_ENCODER_zlib

	config FREETZ_PACKAGE_FFMPEG_ENCODER_tiff
		bool "TIFF"
		select FREETZ_PACKAGE_FFMPEG_LZMA

	config FREETZ_PACKAGE_FFMPEG_ENCODER_vorbis
		bool "Vorbis"

	config FREETZ_PACKAGE_FFMPEG_ENCODER_zlib
		bool "Zlib"


	comment "Decoders ---"

	config FREETZ_PACKAGE_FFMPEG_DECODER_aac
		bool "AAC (Advanced Audio Coding)"
		depends on FREETZ_PACKAGE_FFMPEG_PATENTED
		select FREETZ_PACKAGE_FFMPEG_PARSER_aac

	config FREETZ_PACKAGE_FFMPEG_DECODER_ac3
		bool "AC3"
		depends on FREETZ_PACKAGE_FFMPEG_PATENTED
		select FREETZ_PACKAGE_FFMPEG_PARSER_ac3

	config FREETZ_PACKAGE_FFMPEG_DECODER_atrac3
		bool "ATRAC3"
		depends on FREETZ_PACKAGE_FFMPEG_PATENTED

	config FREETZ_PACKAGE_FFMPEG_DECODER_gif
		bool "GIF"

	config FREETZ_PACKAGE_FFMPEG_DECODER_h264
		bool "H.264"
		depends on FREETZ_PACKAGE_FFMPEG_PATENTED

	config FREETZ_PACKAGE_FFMPEG_DECODER_jpegls
		bool "JPEG-LS"

# 	# min v2.1 - cmake since v2.0
#	config FREETZ_PACKAGE_FFMPEG_DECODER_libopenjpeg
#		bool "JPEG-2000"

	config FREETZ_PACKAGE_FFMPEG_DECODER_mjpeg
		bool "MJPEG"

	config FREETZ_PACKAGE_FFMPEG_DECODER_mjpegb
		bool "MJPEGB"

	config FREETZ_PACKAGE_FFMPEG_DECODER_mp2
		bool "MP2 (MPEG Audio Layer 2)"
		depends on FREETZ_PACKAGE_FFMPEG_PATENTED

	config FREETZ_PACKAGE_FFMPEG_DECODER_mp3
		bool "MP3 (MPEG Audio Layer 2)"
		depends on FREETZ_PACKAGE_FFMPEG_PATENTED

	config FREETZ_PACKAGE_FFMPEG_DECODER_mpegvideo
		bool "MPEG Video"

	config FREETZ_PACKAGE_FFMPEG_DECODER_mpeg1video
		bool "MPEG-1 Video"

	config FREETZ_PACKAGE_FFMPEG_DECODER_mpeg2video
		bool "MPEG-2 Video"
		depends on FREETZ_PACKAGE_FFMPEG_PATENTED

	config FREETZ_PACKAGE_FFMPEG_DECODER_mpeg4
		bool "MPEG-4"
		depends on FREETZ_PACKAGE_FFMPEG_PATENTED

	config FREETZ_PACKAGE_FFMPEG_DECODER_pcm_s16be
		bool "PCM signed 16-bit big-endian"

	config FREETZ_PACKAGE_FFMPEG_DECODER_pcm_s16le
		bool "PCM signed 16-bit little-endian"

	config FREETZ_PACKAGE_FFMPEG_DECODER_png
		bool "PNG"
		select FREETZ_PACKAGE_FFMPEG_DECODER_zlib

	config FREETZ_PACKAGE_FFMPEG_DECODER_tiff
		bool "TIFF"
		select FREETZ_PACKAGE_FFMPEG_LZMA

	config FREETZ_PACKAGE_FFMPEG_DECODER_vorbis
		bool "Vorbis"

	config FREETZ_PACKAGE_FFMPEG_DECODER_wmav1
		bool "WMAv1"
		depends on FREETZ_PACKAGE_FFMPEG_PATENTED

	config FREETZ_PACKAGE_FFMPEG_DECODER_wmav2
		bool "WMAv2"
		depends on FREETZ_PACKAGE_FFMPEG_PATENTED

	config FREETZ_PACKAGE_FFMPEG_DECODER_zlib
		bool "Zlib"


	comment "Muxers ---"

	config FREETZ_PACKAGE_FFMPEG_MUXER_ac3
		bool "AC3"
		depends on FREETZ_PACKAGE_FFMPEG_PATENTED

	config FREETZ_PACKAGE_FFMPEG_MUXER_avi
		bool "AVI"

	config FREETZ_PACKAGE_FFMPEG_MUXER_flv
		bool "FLV"

	config FREETZ_PACKAGE_FFMPEG_MUXER_h264
		bool "H.264"
		depends on FREETZ_PACKAGE_FFMPEG_PATENTED

	config FREETZ_PACKAGE_FFMPEG_MUXER_matroska
		bool "MATROSKA"

	config FREETZ_PACKAGE_FFMPEG_MUXER_mjpeg
		bool "MJPEG"

	config FREETZ_PACKAGE_FFMPEG_MUXER_mov
		bool "MOV"

	config FREETZ_PACKAGE_FFMPEG_MUXER_mp3
		bool "MP3 (MPEG Audio Layer 3)"

	config FREETZ_PACKAGE_FFMPEG_MUXER_mp4
		bool "MP4"

	config FREETZ_PACKAGE_FFMPEG_MUXER_mpeg1video
		bool "MPEG-1 Video"

	config FREETZ_PACKAGE_FFMPEG_MUXER_mpeg2video
		bool "MPEG-2 Video"

	config FREETZ_PACKAGE_FFMPEG_MUXER_mpegts
		bool "MPEG-2 (TS)"

	config FREETZ_PACKAGE_FFMPEG_MUXER_ogg
		bool "Ogg"

	config FREETZ_PACKAGE_FFMPEG_MUXER_rtp
		bool "RTP"


	comment "Demuxers ---"

	config FREETZ_PACKAGE_FFMPEG_DEMUXER_ac3
		bool "AC3"

	config FREETZ_PACKAGE_FFMPEG_DEMUXER_avi
		bool "AVI"

	config FREETZ_PACKAGE_FFMPEG_DEMUXER_flv
		bool "FLV"

	config FREETZ_PACKAGE_FFMPEG_DEMUXER_h264
		bool "H.264"
		depends on FREETZ_PACKAGE_FFMPEG_PATENTED

	config FREETZ_PACKAGE_FFMPEG_DEMUXER_image2
		bool "Image2"
		select FREETZ_PACKAGE_FFMPEG_DECODER_gif
		select FREETZ_PACKAGE_FFMPEG_DECODER_jpegls
#		select FREETZ_PACKAGE_FFMPEG_DECODER_libopenjpeg
		select FREETZ_PACKAGE_FFMPEG_DECODER_mjpeg
		select FREETZ_PACKAGE_FFMPEG_DECODER_mjpegb
		select FREETZ_PACKAGE_FFMPEG_DECODER_png

	config FREETZ_PACKAGE_FFMPEG_DEMUXER_matroska
		bool "MATROSKA"

	config FREETZ_PACKAGE_FFMPEG_DEMUXER_mjpeg
		bool "MJPEG"

	config FREETZ_PACKAGE_FFMPEG_DEMUXER_mov
		bool "MOV"

	config FREETZ_PACKAGE_FFMPEG_DEMUXER_mp3
		bool "MP3 (MPEG Audio Layer 3)"

	config FREETZ_PACKAGE_FFMPEG_DEMUXER_mpegvideo
		bool "MPEG Video"

	config FREETZ_PACKAGE_FFMPEG_DEMUXER_mpegps
		bool "MPEG-2 (PS)"

	config FREETZ_PACKAGE_FFMPEG_DEMUXER_mpegts
		bool "MPEG-2 (TS)"

	config FREETZ_PACKAGE_FFMPEG_DEMUXER_ogg
		bool "Ogg"

	config FREETZ_PACKAGE_FFMPEG_DEMUXER_rm
		bool "RM"

	config FREETZ_PACKAGE_FFMPEG_DEMUXER_rtsp
		bool "RTSP"
		select FREETZ_PACKAGE_FFMPEG_DEMUXER_rm
		select FREETZ_PACKAGE_FFMPEG_DEMUXER_sdp

	config FREETZ_PACKAGE_FFMPEG_DEMUXER_sdp
		bool "SDP"
		select FREETZ_PACKAGE_FFMPEG_DEMUXER_mpegts


	comment "Parsers ---"

	config FREETZ_PACKAGE_FFMPEG_PARSER_aac
		bool "AAC (Advanced Audio Coding)"
		depends on FREETZ_PACKAGE_FFMPEG_PATENTED

	config FREETZ_PACKAGE_FFMPEG_PARSER_ac3
		bool "AC3"

	config FREETZ_PACKAGE_FFMPEG_PARSER_h264
		bool "H.264"
		depends on FREETZ_PACKAGE_FFMPEG_PATENTED
		select FREETZ_PACKAGE_FFMPEG_DECODER_h264

	config FREETZ_PACKAGE_FFMPEG_PARSER_mjpeg
		bool "MJPEG"
		select FREETZ_PACKAGE_FFMPEG_DECODER_mjpeg

	config FREETZ_PACKAGE_FFMPEG_PARSER_mpegaudio
		bool "MPEG Audio"

	config FREETZ_PACKAGE_FFMPEG_PARSER_mpegvideo
		bool "MPEG Video"

	config FREETZ_PACKAGE_FFMPEG_PARSER_mpeg4video
		bool "MPEG-4 Video"


	comment "Protocols ---"

	config FREETZ_PACKAGE_FFMPEG_PROTOCOL_file
		bool "file:"

	config FREETZ_PACKAGE_FFMPEG_PROTOCOL_http
		bool "http:"

	config FREETZ_PACKAGE_FFMPEG_PROTOCOL_https
		bool "https:"
		select FREETZ_PACKAGE_FFMPEG_SSL

	config FREETZ_PACKAGE_FFMPEG_PROTOCOL_pipe
		bool "pipe:"

	config FREETZ_PACKAGE_FFMPEG_PROTOCOL_rtp
		bool "rtp:"
		select FREETZ_PACKAGE_FFMPEG_PROTOCOL_udp

	config FREETZ_PACKAGE_FFMPEG_PROTOCOL_tcp
		bool "tcp:"

	config FREETZ_PACKAGE_FFMPEG_PROTOCOL_udp
		bool "udp:"

endif # FREETZ_PACKAGE_FFMPEG
```

## make/pkgs/file/Config.in
```kconfig
config FREETZ_PACKAGE_FILE
	bool "file 5.45 (binary only)"
	default n
	help
		file - determine file type

		The file command is used to identify a particular file according to the
		type of data contained by the file. File can identify many different
		file types, including ELF binaries, system libraries, RPM packages, and
		many different graphics formats.

		This utility is essential for analyzing binaries and file formats on the
		target system, especially useful for debugging cross-compilation issues.
		
		Can be externalized to save flash memory.
```

## make/pkgs/fontconfig/Config.in
```kconfig
config FREETZ_PACKAGE_FONTCONFIG
	bool "Fontconfig 2.17.1 (binary only)"
	depends on FREETZ_LIB_libfontconfig
	default n
	help
		Fontconfig is a library for configuring and customizing
		font access. This package adds /etc/fontsfonts.conf
```
