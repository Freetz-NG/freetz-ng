## make/pkgs/gcc-toolchain/Config.in
```kconfig
config FREETZ_PACKAGE_GCC_TOOLCHAIN
	bool "GCC (Native Compiler for On-Device Compilation)"
	select FREETZ_TARGET_TOOLCHAIN
	select FREETZ_LIB_libgcc_s
	select FREETZ_PACKAGE_BINUTILS_TOOLS
	select FREETZ_PACKAGE_BINUTILS_TOOLS_AR
	select FREETZ_PACKAGE_BINUTILS_TOOLS_RANLIB
	default n
	help
		Install the GCC compiler on Fritz!Box for native compilation.
		
		Base installation includes:
		- gcc, g++, cpp (compilers)
		- ar, ranlib (archive tools from Binutils package)

if FREETZ_PACKAGE_GCC_TOOLCHAIN

	config FREETZ_PACKAGE_GCC_TOOLCHAIN_FULL_BINUTILS
		bool "Include full binutils tools"
		select FREETZ_PACKAGE_BINUTILS_TOOLS_ADDR2LINE
		select FREETZ_PACKAGE_BINUTILS_TOOLS_AR
		select FREETZ_PACKAGE_BINUTILS_TOOLS_NM
		select FREETZ_PACKAGE_BINUTILS_TOOLS_OBJCOPY
		select FREETZ_PACKAGE_BINUTILS_TOOLS_OBJDUMP
		select FREETZ_PACKAGE_BINUTILS_TOOLS_RANLIB
		select FREETZ_PACKAGE_BINUTILS_TOOLS_SIZE
		select FREETZ_PACKAGE_BINUTILS_TOOLS_STRINGS
		select FREETZ_PACKAGE_BINUTILS_TOOLS_STRIP
		select FREETZ_PACKAGE_BINUTILS_TOOLS_READELF
		select FREETZ_PACKAGE_BINUTILS_TOOLS_CXXFILT
		select FREETZ_PACKAGE_BINUTILS_TOOLS_ELFEDIT
		default y
		help
			Include complete binutils and profiling toolset.
			
			Adds to base GCC installation:
			- Profiling/coverage: gcov, gprof
			- Binutils: addr2line, ar, nm, objcopy, objdump, 
			  ranlib, size, strings, strip, readelf, as, ld,
			  c++filt, elfedit
			
	config FREETZ_PACKAGE_GCC_TOOLCHAIN_HEADERS
		bool "Include development headers"
		default y
		help
			Include C/C++ standard library headers for compilation.
			Required for compiling most programs.
			
			Size: ~20 MB

endif # FREETZ_PACKAGE_GCC_TOOLCHAIN
```

## make/pkgs/gh/Config.in
```kconfig
config FREETZ_PACKAGE_GH
	bool "gh 2.83.2 - GitHub CLI"
	select FREETZ_LIB_libpthread if FREETZ_TARGET_UCLIBC_HAS_multiple_libs
	default n
	help
		gh is GitHub on the command line. It brings pull requests, issues, and
		other GitHub concepts to the terminal next to where you are already
		working with git and your code.
		
		GitHub CLI provides a more efficient way to interact with GitHub
		repositories, issues, pull requests, and more from your terminal.
		
		Can be externalized to save flash memory.
```

## make/pkgs/git/Config.in
```kconfig
config FREETZ_PACKAGE_GIT
	bool "Git 2.26.2/2.50.1"
	select FREETZ_BUSYBOX_START_STOP_DAEMON
	select FREETZ_LIB_libpthread if FREETZ_TARGET_UCLIBC_HAS_multiple_libs
	select FREETZ_LIB_libcurl
	select FREETZ_LIB_libexpat
	select FREETZ_LIB_libiconv if FREETZ_TARGET_UCLIBC_0_9_28
	select FREETZ_LIB_libcrypto
	select FREETZ_LIB_libz
	default n
	help
		Git is a fast, scalable, distributed revision control system with an
		unusually rich command set that provides both high-level operations
		and full access to internals.

if FREETZ_PACKAGE_GIT

	choice
		prompt "Version"
			default FREETZ_PACKAGE_GIT_VERSION_CURRENT

		config FREETZ_PACKAGE_GIT_VERSION_ABANDON
			bool "2.26.2"
			depends on !FREETZ_SEPARATE_AVM_UCLIBC

		config FREETZ_PACKAGE_GIT_VERSION_CURRENT
			bool "2.50.1"
			depends on FREETZ_SEPARATE_AVM_UCLIBC

	endchoice

	config FREETZ_PACKAGE_GIT_REMOVE_WEBIF
		bool "remove webinterface"
		default n
		help
			This option removes the webinterface

	config FREETZ_PACKAGE_GIT_WITH_PCRE
		bool "build with pcre support"
		select FREETZ_LIB_libpcre
		default n
		help
			With this option enabled git-grep will be able to use
			Perl-compatible regular expressions (pcre).

			Note: git supports all kinds of POSIX regular expressions
			without libpcre. Most users want to say no here.

endif # FREETZ_PACKAGE_GIT
```

## make/pkgs/haproxy/Config.in
```kconfig
config FREETZ_PACKAGE_HAPROXY
	bool "HAProxy 2.6.29 - DEPRECATED"
	depends on FREETZ_TARGET_GCC_5_MIN
	select FREETZ_LIB_libcrypt if FREETZ_TARGET_UCLIBC_HAS_multiple_libs
	select FREETZ_BUSYBOX_START_STOP_DAEMON
	default n
	help
		HAProxy is a free, very fast and reliable solution offering high
		availability, load balancing, and proxying for TCP and HTTP-based
		applications.

if FREETZ_PACKAGE_HAPROXY

	config FREETZ_PACKAGE_HAPROXY_WITH_OPENSSL
		bool "With OpenSSL support"
		select FREETZ_LIB_libcrypto
		select FREETZ_LIB_libssl
		default n
		help
			This option enables SSL support in HAProxy.

	config FREETZ_PACKAGE_HAPROXY_WITH_PCRE
		bool "With regex support"
		default n
		help
			This option enables regex support in HAProxy.

		choice
			prompt "PCRE"
				default FREETZ_PACKAGE_HAPROXY_WITH_PCRE2
				depends on FREETZ_PACKAGE_HAPROXY_WITH_PCRE

			config FREETZ_PACKAGE_HAPROXY_WITH_PCRE1
				bool "v1"
				select FREETZ_LIB_libpcre

			config FREETZ_PACKAGE_HAPROXY_WITH_PCRE2
				bool "v2"
				select FREETZ_LIB_libpcre2
				select FREETZ_LIB_libpcre2_posix

		endchoice

endif # FREETZ_PACKAGE_HAPROXY
```

## make/pkgs/htpdate/Config.in
```kconfig
config FREETZ_PACKAGE_HTPDATE
	bool "htpdate 1.3.7"
	select FREETZ_AVMDAEMON_DISABLE_NTP  if !FREETZ_PACKAGE_HTPDATE_REMOVE_WEBIF && FREETZ_AVM_HAS_AVMMULTID_NTPCLIENT
	select FREETZ_REMOVE_CHRONYD         if !FREETZ_PACKAGE_HTPDATE_REMOVE_WEBIF && FREETZ_AVM_HAS_CHRONYD
	default n
	help
		The HTTP Time Protocol (HTP) is used to synchronize a computer's time
		with web servers as reference time source. Htpdate will synchronize your
		computer's time by extracting timestamps from HTTP headers found
		in web server responses. Htpdate can be used as a daemon, to keep your
		computer synchronized.
		WWW: http://www.clevervest.com/htp/
		Manpage: http://linux.die.net/man/8/htpdate

		This package automatically removes AVM'S chronyd if necessary.

if FREETZ_PACKAGE_HTPDATE

	config FREETZ_PACKAGE_HTPDATE_REMOVE_WEBIF
		bool "remove webinterface"
		default n
		help
			This option removes the webinterface

endif # FREETZ_PACKAGE_HTPDATE
```

## make/pkgs/iconv/Config.in
```kconfig
config FREETZ_PACKAGE_ICONV
	bool "iconv 1.13.1/1.18 (binary only) - see library for version"
	select FREETZ_LIB_libiconv
	default n
	help
		A program for converting text from one encoding to another.
		
		Version follows the selected libiconv library version:
		  - libiconv 2.5.0 (1.13.1) → iconv 1.13.1
		  - libiconv 2.7.0 (1.18)   → iconv 1.18
		
		Select the library version in:
		Packages → Shared libraries → Charsets & Internationalization → Iconv
```

## make/pkgs/igmpproxy/Config.in
```kconfig
config FREETZ_PACKAGE_IGMPPROXY
	bool "IGMPproxy 0.4"
	select FREETZ_BUSYBOX_START_STOP_DAEMON
	select FREETZ_AVMDAEMON_DISABLE_IGM
	default n
	help
		IGMPproxy is a simple dynamic Multicast Routing Daemon using only
		IGMP signalling.
		It's intended for simple forwarding of Multicast traffic between networks.
```

## make/pkgs/imagemagick/Config.in
```kconfig
menuconfig FREETZ_PACKAGE_IMAGEMAGICK
	bool "ImageMagick 7.1.0-62/7.1.1-47 (binary only)"
	depends on FREETZ_KERNEL_VERSION_2_6_28_MIN
	select FREETZ_LIB_libpthread  if FREETZ_TARGET_UCLIBC_HAS_multiple_libs
	select FREETZ_LIB_libm        if FREETZ_TARGET_UCLIBC_HAS_multiple_libs
	default n
	help
		ImageMagick is a robust collection of tools and libraries to read,
		write, and manipulate an image in many image formats, including popular
		formats like TIFF, JPEG, PNG, PDF, PhotoCD, and GIF. With ImageMagick,
		you can create images dynamically, making it suitable for Web
		applications. You can also resize, rotate, sharpen, color-reduce, or
		add special effects to an image and save your completed work in many
		different image formats. Image processing operations are available from
		the command line as well as through C, C++, and PERL-based programming
		interfaces.

if FREETZ_PACKAGE_IMAGEMAGICK

	choice
		prompt "Version"
			default FREETZ_PACKAGE_IMAGEMAGICK_VERSION_CURRENT

		config FREETZ_PACKAGE_IMAGEMAGICK_VERSION_ABANDON
			bool "7.1.0-62"
			depends on !FREETZ_SEPARATE_AVM_UCLIBC

		config FREETZ_PACKAGE_IMAGEMAGICK_VERSION_CURRENT
			bool "7.1.1-47"
			depends on FREETZ_SEPARATE_AVM_UCLIBC

	endchoice

	config FREETZ_PACKAGE_IMAGEMAGICK_ghostscript_fonts
		bool "Ghostscript fonts"
		default n
		select FREETZ_PACKAGE_GHOSTSCRIPT_FONTS

	config FREETZ_PACKAGE_IMAGEMAGICK_freetype
		bool "Support freetype"
		default y
		select FREETZ_LIB_libfreetype

	config FREETZ_PACKAGE_IMAGEMAGICK_jpeg
		bool "Support jpeg"
		default y
		select FREETZ_LIB_libjpeg

	config FREETZ_PACKAGE_IMAGEMAGICK_libz
		bool "Support libz"
		default y
		select FREETZ_LIB_libz

	config FREETZ_PACKAGE_IMAGEMAGICK_png
		bool "Support png"
		default y
		select FREETZ_LIB_libpng16

	config FREETZ_PACKAGE_IMAGEMAGICK_xml
		bool "Support xml"
		default y
		select FREETZ_LIB_libxml2

	config FREETZ_PACKAGE_IMAGEMAGICK_STATIC
		bool "Link statically"
		default n
		help
			Causes all dependent libraries to be linked in statically.

endif # FREETZ_PACKAGE_IMAGEMAGICK
```

## make/pkgs/iptables-ng/Config.in
```kconfig
config FREETZ_PACKAGE_IPTABLES_NG
	bool "Iptables NG"
	depends on FREETZ_PACKAGE_IPTABLES
	depends on FREETZ_REMOVE_DSLD
	select FREETZ_PACKAGE_IPTABLES_SAVE_RESTORE
	default n
	help
		Advanced iptables/ip6tables management page with dynamic table
		and module capability detection, plus save/restore controls.

		Runtime status (started/stopped) is independent from startup mode
		(automatic/manual). Startup mode only controls boot behavior.

		README in the package has more hints.

		This package requires dsld to be removed
		(FREETZ_REMOVE_DSLD=y).
```

## make/pkgs/jamvm/Config.in
```kconfig
config FREETZ_PACKAGE_JAMVM
	bool "JamVM 2.0.0 (binary only)"
	select FREETZ_PACKAGE_CLASSPATH
	select FREETZ_LIB_libffi
	select FREETZ_LIB_libz
	default n
	help
		JamVM - extremely small Java VM

		JamVM 2.0.0 is the first release of JamVM with support for OpenJDK.  Although
		IcedTea already includes JamVM with OpenJDK support, this has been based on
		periodic snapshots of the development tree.

		This release supports OpenJDK 6, 7 and 8 (the latest).  With OpenJDK 7 and 8
		this includes full support for JSR 292 (invokedynamic).  JamVM 2.0.0
		with OpenJDK 8 also includes full support for Lambda expressions (JSR 335),
		type annotations (JSR 308) and method parameter reflection.

		In addition to OpenJDK support, JamVM 2.0.0 also includes many bug-fixes,
		performance improvements and improved compatibility (from running the OpenJDK
		jtreg tests).  The following is an edited list of the top ~100 commits (out
		of 300+) in date order (most recent first).  The list has been categorised
		into those affecting OpenJDK only, GNU Classpath only, and both OpenJDK and
		GNU Classpath (All).
```

## make/pkgs/jq/Config.in
```kconfig
config FREETZ_PACKAGE_JQ
	bool "jq 1.8.1 (binary only)"
	default n
	select FREETZ_LIB_libm      if !FREETZ_PACKAGE_JQ_STATIC && FREETZ_TARGET_UCLIBC_HAS_multiple_libs
	select FREETZ_LIB_libonig   if !FREETZ_PACKAGE_JQ_STATIC && FREETZ_PACKAGE_JQ_WITH_RE_SUPPORT
	help
		jq is a lightweight and flexible command-line JSON processor.

if FREETZ_PACKAGE_JQ

	config FREETZ_PACKAGE_JQ_WITH_RE_SUPPORT
		bool "with regular expresssions support"
		default y

	config FREETZ_PACKAGE_JQ_STATIC
		bool "Link statically"
		default n

endif # FREETZ_PACKAGE_JQ
```

## make/pkgs/ldd/Config.in
```kconfig
config FREETZ_PACKAGE_LDD
	bool "ldd 0.1/1.0.56 (binary only)"
	default n
	help
		ldd prints the shared libraries required by each program or shared
		library specified on the command line.

if FREETZ_PACKAGE_LDD

	choice
		prompt "Version"
			default FREETZ_PACKAGE_LDD_VERSION_CURRENT

		config FREETZ_PACKAGE_LDD_VERSION_ABANDON
			bool "0.1"
			depends on !FREETZ_SEPARATE_AVM_UCLIBC
			help
				Old version of ldd from uClibc 0.9.x era.
				For old devices with ancient uClibc version
				0.9.28 + 0.9.29 or gcc < 4.x toolchains.

		config FREETZ_PACKAGE_LDD_VERSION_CURRENT
			bool "1.0.56"
			depends on  FREETZ_SEPARATE_AVM_UCLIBC
			help
				New version of ldd from uClibc-ng with support
				for 28+ architectures and improved MIPS. Requires
				uClibc >= 0.9.32 or uClibc-ng and gcc >= 4.x.

	endchoice

endif # FREETZ_PACKAGE_LDD
```
