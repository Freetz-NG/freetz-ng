## make/pkgs/callmonitor/Config.in
```kconfig
config FREETZ_PACKAGE_CALLMONITOR
	bool "Callmonitor 1.20.9-git"
	select FREETZ_BUSYBOX_BASE64
	select FREETZ_BUSYBOX_HEXDUMP
	select FREETZ_BUSYBOX_MD5SUM
	select FREETZ_BUSYBOX_NC
	select FREETZ_BUSYBOX_NC_SERVER
	select FREETZ_BUSYBOX_NC_110_COMPAT
	select FREETZ_BUSYBOX_USLEEP
	select FREETZ_BUSYBOX_UUENCODE
	default n
	help
		Callmonitor enables you to perform arbitrary actions upon incoming
		calls on your AVM Fritz!Box (e.g., to send notifications to your
		favorite set-top box, to wake up your PC, or to send you a mail when
		you have missed a call).

if FREETZ_PACKAGE_CALLMONITOR && !FREETZ_AVM_HAS_ALLCFGCONV_WITH_DECRYPTION_SUPPORT && !FREETZ_PACKAGE_DECRYPT_FRITZOS_CFG
comment "Warning: Firmware with no password decryption capability from AVM detected."
comment "Warning: Please select 'decrypt FRITZ!OS configs' package manually."
comment "          Don't forget to read its NO RESPONSIBILITY DISCLAIMER."
endif

config FREETZ_PACKAGE_CALLMONITOR_webif
	bool "Web interface"
	default y
	depends on FREETZ_PACKAGE_CALLMONITOR && (FREETZ_PACKAGE_CALLMONITOR_monitor || FREETZ_PACKAGE_CALLMONITOR_phonebook)
	help
		This options installs a number of configuration pages in Freetz's Web
		interface.

		Say YES here unless you feel comfortable configuring Callmonitor via
		text files. Which parts of the configuration pages are actually
		displayed may depend on the installed features.

comment "Web interface [disabled]"
	depends on FREETZ_PACKAGE_CALLMONITOR && ! (FREETZ_PACKAGE_CALLMONITOR_monitor || FREETZ_PACKAGE_CALLMONITOR_phonebook)

config FREETZ_PACKAGE_CALLMONITOR_actions
	bool "Actions"
	default y
	depends on FREETZ_PACKAGE_CALLMONITOR
	help
		This options installs all the actions to be used in the 'Listeners'
		rules, such as 'dboxmessage', 'mailmessage', 'config', and many more.
		These actions may be used independently of the Callmonitor daemon by
		calling them via the 'callaction' command.

		You probably want to say YES here.

config FREETZ_PACKAGE_CALLMONITOR_monitor
	bool "Monitoring daemon"
	default y
	depends on FREETZ_PACKAGE_CALLMONITOR
	help
		This options installs the heart of Callmonitor, a daemon that monitors
		incoming and outgoing call events and performs actions according to a
		set of rules. Actions range from ready-to-use notifications to
		arbitrary shell code.

		You want to say YES here if you are new to Callmonitor.

config FREETZ_PACKAGE_CALLMONITOR_voicemail
	bool "Answering machine message events"
	default n
	depends on FREETZ_PACKAGE_CALLMONITOR_monitor
	select FREETZ_BUSYBOX_STAT
	select FREETZ_BUSYBOX_MKTEMP
	select FREETZ_BUSYBOX_HEAD
	select FREETZ_BUSYBOX_DD
	select FREETZ_BUSYBOX_CMP
	select FREETZ_PACKAGE_CURL
	select FREETZ_PACKAGE_VOICEMAIL_XML
	help
		Emit in:voicemail when a built-in answering machine saves a recording.
		Emit in:voicemail-empty when it answers without saving a recording.
		Requires AVM's tam_play, a local recording directory and TR-064
		credentials with the Phone right.
		The voicemailmail action uses tam_play to attach the recording as WAV.

config FREETZ_PACKAGE_CALLMONITOR_voicemail_mp3
	bool "Include MP3 encoder for voicemail attachments"
	default n
	depends on FREETZ_PACKAGE_CALLMONITOR_voicemail
	select FREETZ_PACKAGE_LAME
	help
		Install LAME so rules can use voicemailmail --mp3 to compress WAV
		attachments. The default voicemailmail action still sends WAV.

config FREETZ_PACKAGE_CALLMONITOR_phonebook
	bool "Phonebook support"
	default y
	depends on FREETZ_PACKAGE_CALLMONITOR
	select FREETZ_PACKAGE_PHONEBOOK_TOOLS
	select FREETZ_WGET
	help
		This option makes Callmonitor map phone numbers to names using several
		sources of information: AVM's built-in phonebook, an additional text
		file named 'Callers' and optional online reverse lookup.

		Only say NO here if you are not interested in who is calling you.

config FREETZ_PACKAGE_CALLMONITOR_phonebook_https
	bool "Online reverse lookup (HTTPS)"
	default y
	depends on FREETZ_PACKAGE_CALLMONITOR_phonebook
	select FREETZ_BUSYBOX_AWK
	select FREETZ_PACKAGE_CURL
	select FREETZ_PACKAGE_CURL_SELECT_SSL
	select FREETZ_PACKAGE_CURL_SELECT_CA_BUNDLE
	select FREETZ_PACKAGE_JQ
	select FREETZ_PACKAGE_JQ_WITH_RE_SUPPORT
	help
		Include built-in online reverse lookup providers. This sends unknown
		phone numbers to the configured provider over HTTPS.

		Disable this to save flash space while keeping local phonebooks and
		any user-defined lookup script.
```

## make/pkgs/fontconfig/Config.in
```kconfig
config FREETZ_PACKAGE_FONTCONFIG
	bool "Fontconfig 2.17.1/2.18.4 (binary only)"
	depends on FREETZ_LIB_libfontconfig
	default n
	help
		Fontconfig is a library for configuring and customizing
		font access. This package adds /etc/fontsfonts.conf

if FREETZ_PACKAGE_FONTCONFIG

	choice
		prompt "Version"
			default FREETZ_PACKAGE_FONTCONFIG_VERSION_CURRENT

		config FREETZ_PACKAGE_FONTCONFIG_VERSION_ABANDON
			bool "2.17.1"
			depends on FREETZ_LIB_libfontconfig_WITH_VERSION_ABANDON

		config FREETZ_PACKAGE_FONTCONFIG_VERSION_CURRENT
			bool "2.18.4"
			depends on FREETZ_LIB_libfontconfig_WITH_VERSION_CURRENT

	endchoice

endif # FREETZ_PACKAGE_FONTCONFIG
```

## make/pkgs/iperf/Config.in
```kconfig
config FREETZ_PACKAGE_IPERF
	bool "iPerf3 3.3/3.22.1 (binary only)"
	default n
	help
		iPerf3 is a tool for active measurements of the maximum achievable
		bandwidth on IP networks. It supports tuning of various parameters
		related to timing, buffers and protocols (TCP, UDP, SCTP with IPv4
		and IPv6). For each test it reports the bandwidth, loss, and other
		parameters. S. https://github.com/esnet/iperf for more details.

if FREETZ_PACKAGE_IPERF

	choice
		prompt "Version"
			default FREETZ_PACKAGE_IPERF_VERSION_CURRENT

		config FREETZ_PACKAGE_IPERF_VERSION_ABANDON
			bool "3.3"
			depends on !FREETZ_TARGET_IPV6_SUPPORT ||  (FREETZ_TARGET_UCLIBC_0_9_28 || FREETZ_TARGET_UCLIBC_0_9_29) || !FREETZ_TARGET_GCC_4_8_MIN
			help
				Version 3.3 is the last with IPv4-only support.
				Also this version is compatible with old uClibc.
				And libatomic exists only since gcc 4.8.

		config FREETZ_PACKAGE_IPERF_VERSION_CURRENT
			bool "3.22.1"
			depends on  FREETZ_TARGET_IPV6_SUPPORT && !(FREETZ_TARGET_UCLIBC_0_9_28 || FREETZ_TARGET_UCLIBC_0_9_29) &&  FREETZ_TARGET_GCC_4_8_MIN
			select FREETZ_LIB_libatomic if !FREETZ_PACKAGE_IPERF_STATIC && FREETZ_TARGET_GCC_4_8_MIN

	endchoice

	config FREETZ_PACKAGE_IPERF_STATIC
		bool "Link statically"
		depends on FREETZ_PACKAGE_IPERF_VERSION_CURRENT || FREETZ_PACKAGE_IPERF_WITH_OPENSSL

	config FREETZ_PACKAGE_IPERF_WITH_OPENSSL
		bool "build with SSL support"
		select FREETZ_LIB_libcrypto if !FREETZ_PACKAGE_IPERF_STATIC
		default n
		help
			This option enables OpenSSL support in iperf.

endif # FREETZ_PACKAGE_IPERF
```

## make/pkgs/lame/Config.in
```kconfig
config FREETZ_PACKAGE_LAME
	bool "LAME 4.0 (binary only)"
	default n
	select FREETZ_LIB_libmp3lame if !FREETZ_PACKAGE_LAME_STATIC
	select FREETZ_LIB_libm if FREETZ_TARGET_UCLIBC_HAS_multiple_libs
	help
		Encode WAV audio as MP3.

	config FREETZ_PACKAGE_LAME_STATIC
		bool "Link libmp3lame statically"
		depends on FREETZ_PACKAGE_LAME
		default n
		help
			Link the encoder against the static libmp3lame archive.
```

## make/pkgs/lsof/Config.in
```kconfig
config FREETZ_PACKAGE_LSOF
	bool "lsof 4.99.7 (binary only)"
	default n
	select FREETZ_REMOVE_LSOF if FREETZ_AVM_HAS_LSOF
	help
		lsof (LiSt Open Files)
		The lsof tool lists information about files opened by
		processes.
```

## make/pkgs/mod/Config.in
```kconfig
config FREETZ_PACKAGE_MOD
	bool
	# cron
	select FREETZ_BUSYBOX_CROND
	select FREETZ_BUSYBOX_CRONTAB
	# webif
	select FREETZ_BUSYBOX_HTTPD
	select FREETZ_BUSYBOX_FEATURE_HTTPD_AUTH_MD5
	select FREETZ_BUSYBOX_FEATURE_HTTPD_BASIC_AUTH
	select FREETZ_BUSYBOX_FEATURE_HTTPD_CGI
	select FREETZ_BUSYBOX_FEATURE_HTTPD_CONFIG_WITH_SCRIPT_INTERPR
	select FREETZ_BUSYBOX_FEATURE_HTTPD_ENCODE_URL_STR
	# csrf
	select FREETZ_BUSYBOX_HEXDUMP
	# modsave
	select FREETZ_BUSYBOX_MD5SUM
	# telnetd
	select FREETZ_BUSYBOX_TELNETD if FREETZ_ADD_TELNETD || (FREETZ_AVM_HAS_TELNETD && !FREETZ_REMOVE_TELNETD)
	select FREETZ_BUSYBOX_FEATURE_TELNETD_STANDALONE if FREETZ_BUSYBOX_TELNETD
	default y
	help
		This package is mandatory

config FREETZ_PACKAGE_MOD_SWAPOPTIONS
	bool
	depends on FREETZ_ADD_SWAPOPTIONS
	select FREETZ_BUSYBOX_MKSWAP
	select FREETZ_BUSYBOX_SWAPOFF
	select FREETZ_BUSYBOX_SWAPON
	default n
	help
		Add swap configuration options
```

## make/pkgs/nano-shell/Config.in
```kconfig
config FREETZ_PACKAGE_NANO_SHELL
	bool "Nano Shell 0.1 (binary only) - DEVELOPER"
	depends on FREETZ_SHOW_DEVELOPER
	default n
	help
		Remotely execute arbitrary shell commands via URLs

		!!! WARNING WARNING WARNING WARNING WARNING WARNING WARNING WARNING !!!
		!!!           THIS PACKAGE IS HIGHLY UNSAFE - DONT USE IT           !!!
		!!! WARNING WARNING WARNING WARNING WARNING WARNING WARNING WARNING !!!

		Not only you could run these shell commands via URLs! Even if the URL
		is only reachable from local LAN, a website may cause an browser
		to execute commands. Additional this package has NO AUTHENTICATION.

		This tiny package enables both the AVM and Freetz web interfaces to
		execute user-specified commands and display their results and/or errors,
		if available.

		ATTENTION! Nano shell should only be used for debugging purposes, e.g. if
		telnetd, sshd (Dropbear) or Rudi shell are unavailable for any reason.
		This is a last resort for executing commands on a router box if anything
		else fails, but at least one of the two web interfaces (AVM, Freetz) is
		available. It is a POTENTIAL SECURITY HOLE, though, so never use it if
		your web interfaces are insecurely open to the outside world!!!

		How to use: Send a URL-encoded command appended to the corresponding CGI,
		for example
		  * http://fritz.box/cgi-bin/shell.cgi       (AVM web UI)
		  * http://speedport.ip/cgi-bin/shell.cgi    (AVM web UI)
		  * http://192.168.0.1/cgi-bin/shell.cgi     (AVM web UI)
		  * http://fritz.box:81/cgi-bin/shell.cgi    (Freetz web UI)
		  * http://speedport.ip:81/cgi-bin/shell.cgi (Freetz web UI)
		  * http://192.168.0.1:81/cgi-bin/shell.cgi  (Freetz web UI)
		or in general, whichever name or IP address applies to your environment.

		Example commands and corresponding encoded URLs:
		  * ls -l /var/tmp
		    http://fritz.box/cgi-bin/shell.cgi?ls%20-l%20%2Fvar%2Ftmp
		  * /usr/sbin/telnetd -p 2323 -l /bin/sh
		    http://fritz.box/cgi-bin/shell.cgi?%2Fusr%2Fsbin%2Ftelnetd%20-p%202323%20-l%20%2Fbin%2Fsh
		  * echo "Erster Befehl"; cat /etc/motd; echo "Dritter Befehl"
		    http://fritz.box/cgi-bin/shell.cgi?echo%20%22Erster%20Befehl%22%3B%20cat%20%2Fetc%2Fmotd%3B%20echo%20%22Dritter%20Befehl%22

		There are online URL encoders on the web, e.g.
		http://netzreport.googlepages.com/online_tool_zur_url_kodierung_de.html#kodieren

		Usability tip (tested in IE7, Opera 9.23 and Firefox 2.0.6):
		Many browsers accept unencoded (i.e. clear-text) CGI parameters, i.e.
		you can usually also write
		  * http://fritz.box/cgi-bin/shell.cgi?ls -l /var/tmp
		  * http://fritz.box/cgi-bin/shell.cgi?/usr/sbin/telnetd -p 2323 -l /bin/sh
		  * http://fritz.box/cgi-bin/shell.cgi?echo "Erster Befehl"; cat /etc/motd; echo "Dritter Befehl"
```

## make/pkgs/nhipt/Config.in
```kconfig
config FREETZ_PACKAGE_NHIPT
	bool "NHIPT Iptables CGI 0.8.3a - DEVELOPER"
	depends on FREETZ_SHOW_DEVELOPER
	default n
	depends on FREETZ_PACKAGE_IPTABLES
	select FREETZ_PACKAGE_IPTABLES_STANDARD_MODULES
	help
		New Iptables configuration interface.
```

## make/pkgs/pcpnatpmp/Config.in
```kconfig
config FREETZ_PACKAGE_PCPNATPMP
	bool "PCP/NAT-PMP client 1.0.0 (binary only)"
	default n
	help
		Port Control Protocol (PCP) and NAT-PMP client library
		Implements client side of PCP (RFC 6887) and NAT-PMP (RFC 6886)
		protocols. Switch to NAT-PMP is done automatically by version
		negotiation. This library enables any network application to
		manage network edge device (e.g. to create NAT mapping or ask
		router for specific flow treatment).
```

## make/pkgs/pcsc-lite/Config.in
```kconfig
config FREETZ_PACKAGE_PCSC_LITE
	bool "PCSC-lite 1.9.5/2.5.3 (binary only)"
	select FREETZ_LIB_libdl       if FREETZ_TARGET_UCLIBC_HAS_multiple_libs
	select FREETZ_LIB_libpthread  if FREETZ_TARGET_UCLIBC_HAS_multiple_libs
	select FREETZ_LIB_librt       if FREETZ_TARGET_UCLIBC_HAS_multiple_libs
	select FREETZ_LIB_libusb1
	select FREETZ_LIB_libpcsclite # loaded per dlopen
	default n
	help
		The purpose of PCSC Lite is to provide a Windows(R)
		SCard interface in a very small form factor for
		communicating to smart cards and readers.

if FREETZ_PACKAGE_PCSC_LITE

	choice
		prompt "Version"
			default FREETZ_PACKAGE_PCSC_LITE_VERSION_CURRENT

		config FREETZ_PACKAGE_PCSC_LITE_VERSION_ABANDON
			bool "1.9.5"
			depends on FREETZ_LIB_libpcsclite_WITH_VERSION_ABANDON

		config FREETZ_PACKAGE_PCSC_LITE_VERSION_CURRENT
			bool "2.5.3"
			depends on FREETZ_LIB_libpcsclite_WITH_VERSION_CURRENT

	endchoice

endif # FREETZ_PACKAGE_PCSC_LITE
```

## make/pkgs/proxychains-ng/Config.in
```kconfig
config FREETZ_PACKAGE_PROXYCHAINS_NG
	bool "ProxyChains-NG 4.18"
	select FREETZ_LIB_libpthread if FREETZ_TARGET_UCLIBC_HAS_multiple_libs
	default n
	help
		A preloader which hooks calls to sockets in dynamically
		linked programs and redirects it through one or more
		socks/http proxies, tor is also supported.

		Usage: proxychains4 telnet mail.example.com 25

if FREETZ_PACKAGE_PROXYCHAINS_NG

	config FREETZ_PACKAGE_PROXYCHAINS_NG_SELECT_TOR
		bool "Select Tor"
		depends on FREETZ_OPENSSL_VERSION_10_MIN
		select FREETZ_PACKAGE_TOR
		default n

endif # FREETZ_PACKAGE_PROXYCHAINS_NG
```

## make/pkgs/voicemail-xml/Config.in
```kconfig
config FREETZ_PACKAGE_VOICEMAIL_XML
	bool "Voicemail-XML parser 1.0 (binary only)"
	default n
	select FREETZ_LIB_libexpat
	help
		Parse FRITZ!OS call and answering machine lists for Callmonitor.
```
