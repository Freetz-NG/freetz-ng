## make/pkgs/rrdstats/Config.in
```kconfig
config FREETZ_PACKAGE_RRDSTATS
	bool "RRDstats for RRDtool"
	select FREETZ_PACKAGE_RRDTOOL
	select FREETZ_BUSYBOX_NICE
	select FREETZ_BUSYBOX_START_STOP_DAEMON
	default n
	help
		Lets you view graphically various stats of your Freetz Box.
		Selects BusyBox's 'nice' to save spare resources.

if FREETZ_PACKAGE_RRDSTATS

	config FREETZ_PACKAGE_RRDSTATS_CABLEMODEM
		bool "Support for cable modem logging"
		default n
		select FREETZ_WGET
		help
			Enables the options in the Webif and
			selects (BusyBox or GNU) wget.
			Logging of frequencies, signal strength
			and SNR for these cable modems:
			 * Thomson THG (520 and 540)
			 * Cisco EPC 3212 (09.06.2010 and 25.02.2012)
			 * Arris Touchstone TM

		config FREETZ_PACKAGE_RRDSTATS_CABLEMODEM_WGET
			bool "Use GNU wget"
			depends on FREETZ_PACKAGE_RRDSTATS_CABLEMODEM
			default y
			select FREETZ_PACKAGE_WGET
			help
				Selects GNU wget instead of BusyBox's.
				This is recommended since it prevents stalling
				of whole RRDstats if the modem is not reachable.

	config FREETZ_PACKAGE_RRDSTATS_SEGMENTLOAD
		bool "Support for cable segment load"
		default n
		select FREETZ_PACKAGE_DVBSNOOP
		select FREETZ_PACKAGE_DVBTUNE
		help
			Enables the options in the Webif and
			selects dvbtune & dvbsnoop.
			This is for logging the load of your
			whole cable internet segment.

		config FREETZ_PACKAGE_RRDSTATS_SEGMENTLOAD_SUNDTEK
			bool "Sundtek DVB driver"
			depends on FREETZ_PACKAGE_RRDSTATS_SEGMENTLOAD
			depends on FREETZ_KERNEL_VERSION_2_6_19_MIN
			depends on !FREETZ_TARGET_ARCH_X86
			default n
			select FREETZ_PACKAGE_SUNDTEK
			help
				Selects Sundtek DVB driver.

	config FREETZ_PACKAGE_RRDSTATS_STORAGE
		bool "Support for storage devices"
		default y
		help
			Enables the options in the Webif.
			Logging of devices (eg 'sda') or
			partitions (eg 'sda1') is possible.

	config FREETZ_PACKAGE_RRDSTATS_NETWORK
		bool "Support for network interfaces"
		default y
		help
			Enables the options in the Webif.
			Logging of real devices (eg 'eth0')
			or virtual (eg 'lan') is possible.

	config FREETZ_PACKAGE_RRDSTATS_TEMPERATURE_SENSOR
		bool "Support for temperature sensor"
		depends on FREETZ_AVM_HAS_TEMPERATURE_SENSOR
		default y
		help
			Enables the options in the Webif.
			Logging of the box's internal
			temperature sensor is possible.

	config FREETZ_PACKAGE_RRDSTATS_DIGITEMP
		bool "Support for DigiTemp"
		default n
		select FREETZ_PACKAGE_DIGITEMP
		select FREETZ_BUSYBOX_UNIQ
		help
			Enables the options in the Webif and
			selects DigiTemp.
			Logging of 1-wire temperature sensors with DigiTemp.

	config FREETZ_PACKAGE_RRDSTATS_SMARTHOME
		bool "Support for SmartHome"
		default n
		select FREETZ_WGET
		help
			Enables logging of AVM Home Automation (AHA).
			It will record voltage, energy, power factor,
			current and temperature.
			This enables the options in the Webif.

endif # FREETZ_PACKAGE_RRDSTATS
```

## make/pkgs/socat/Config.in
```kconfig
config FREETZ_PACKAGE_SOCAT
	bool "socat 1.8.1.0 (binary only)"
	depends on !FREETZ_TARGET_UCLIBC_0_9_28
	select FREETZ_REMOVE_SOCAT if FREETZ_AVM_HAS_SOCAT
	select FREETZ_LIB_libcrypto_WITH_EC
	select FREETZ_LIB_libcrypto
	select FREETZ_LIB_libssl
	select FREETZ_LIB_libutil if FREETZ_TARGET_UCLIBC_HAS_multiple_libs
	select FREETZ_LIB_libz
	default n
	help
		socat is an extended netcat-like utility

config FREETZ_PACKAGE_SOCAT_WITHTERMIOS
	bool "enable termios in socat"
	depends on FREETZ_PACKAGE_SOCAT
	default n
	help
		Enable socat to use tty devices with termios
```

## make/pkgs/sqlite/Config.in
```kconfig
config FREETZ_PACKAGE_SQLITE
	bool "SQLite 3.50.4 (binary only)"
	select FREETZ_LIB_libsqlite3
	default n
	help
		SQLite is a small C library that implements a self-contained, embeddable,
		zero-configuration SQL database engine.

if FREETZ_PACKAGE_SQLITE

	choice
		prompt "Version"
			default FREETZ_PACKAGE_SQLITE_VERSION_CURRENT

		config FREETZ_PACKAGE_SQLITE_VERSION_ABANDON
			bool "3.40.1"
			depends on FREETZ_LIB_libsqlite3_WITH_VERSION_ABANDON

		config FREETZ_PACKAGE_SQLITE_VERSION_CURRENT
			bool "3.50.4"
			depends on FREETZ_LIB_libsqlite3_WITH_VERSION_CURRENT

	endchoice

	config FREETZ_PACKAGE_SQLITE_WITH_READLINE
		bool "build with readline support"
		select FREETZ_LIB_libreadline
		select FREETZ_LIB_libncurses
		default n
		help
			This option causes command line client to be built with readline and history support.

endif # FREETZ_PACKAGE_SQLITE
```

## make/pkgs/strace/Config.in
```kconfig
config FREETZ_PACKAGE_STRACE
	bool "strace 4.9/5.0/6.17 - System call tracer"
	default n
	help
		strace - trace system calls and signals

		strace is a system call tracer, i.e. a debugging tool which prints out
		a trace of all the system calls made by another process/program.
		
		Perfect for:
		- Debugging application behavior
		- Finding missing libraries or files
		- Analyzing system call performance
		- Troubleshooting permission issues
		- Understanding program execution flow
		
		Size: ~1.3 MB (can be externalized to save flash memory)
		
		Example usage:
		  strace ./myprogram
		  strace -p <pid>
		  strace -e open,read,write ./myprogram

if FREETZ_PACKAGE_STRACE

	choice
		prompt "Version"

		config FREETZ_PACKAGE_STRACE_VERSION_4
			bool "4.9"
			depends on  (                                FREETZ_KERNEL_VERSION_2_6_13)

		config FREETZ_PACKAGE_STRACE_VERSION_5
			bool "5.0"
			depends on  (FREETZ_KERNEL_VERSION_2_MAX && !FREETZ_KERNEL_VERSION_2_6_13)

		config FREETZ_PACKAGE_STRACE_VERSION_6
			bool "6.17"
			depends on !(FREETZ_KERNEL_VERSION_2_MAX                                 )

	endchoice

endif # FREETZ_PACKAGE_STRACE
```

## make/pkgs/stunnel/Config.in
```kconfig
config FREETZ_PACKAGE_STUNNEL
	bool "Stunnel 5.75"
	select FREETZ_LIB_libcrypto  if !FREETZ_PACKAGE_STUNNEL_STATIC
	select FREETZ_LIB_libssl     if !FREETZ_PACKAGE_STUNNEL_STATIC
	select FREETZ_LIB_libpthread if !FREETZ_PACKAGE_STUNNEL_STATIC && FREETZ_TARGET_UCLIBC_HAS_multiple_libs
	select FREETZ_LIB_libutil    if !FREETZ_PACKAGE_STUNNEL_STATIC && FREETZ_TARGET_UCLIBC_HAS_multiple_libs
	default n
	help
		Stunnel universal SSL proxy

if FREETZ_PACKAGE_STUNNEL

	config FREETZ_PACKAGE_STUNNEL_BOXCERT
		bool "build with support for FRITZ!OS certificate"
		depends on FREETZ_BOX_CERTIFICATE_SUPPORT_AVAILABLE
		select FREETZ_PACKAGE_PRIVATEKEYPASSWORD
		default n
		help
			Building stunnel with FRITZ!OS support enables reuse
			of existing key and certificate from /var/flash

	config FREETZ_PACKAGE_STUNNEL_STATIC
		bool "Link statically"
		default n
		help
			Build stunnel binary with statically linked libraries.

endif # FREETZ_PACKAGE_STUNNEL
```

## make/pkgs/sudo/Config.in
```kconfig
config FREETZ_PACKAGE_SUDO
	bool "Sudo 1.9.13p3 (binary only)"
	select FREETZ_LIB_libdl       if FREETZ_TARGET_UCLIBC_HAS_multiple_libs
	select FREETZ_LIB_libpthread  if FREETZ_TARGET_UCLIBC_HAS_multiple_libs
	select FREETZ_LIB_libutil     if FREETZ_TARGET_UCLIBC_HAS_multiple_libs
	default n
	help
		Sudo (su "do") allows a system administrator to delegate authority to
		give certain users (or groups of users) the ability to run some (or
		all) commands as root or another user while providing an audit trail of
		the commands and their arguments.
		WWW: http://www.courtesan.com/sudo/
```

## make/pkgs/tcpdump/Config.in
```kconfig
config FREETZ_PACKAGE_TCPDUMP
	bool "tcpdump 4.1.1/4.99.6 (binary only)"
	select FREETZ_LIB_libpcap
	default n
	help
		Network monitoring and data acquisition tool

if FREETZ_PACKAGE_TCPDUMP

	choice
		prompt "Version"
			default FREETZ_PACKAGE_TCPDUMP_VERSION_CURRENT

		config FREETZ_PACKAGE_TCPDUMP_VERSION_ABANDON
			bool "4.1.1"
			depends on  (FREETZ_TARGET_GCC_4_MAX || FREETZ_KERNEL_VERSION_2_MAX)

		config FREETZ_PACKAGE_TCPDUMP_VERSION_CURRENT
			bool "4.99.6"
			depends on !(FREETZ_TARGET_GCC_4_MAX || FREETZ_KERNEL_VERSION_2_MAX)

	endchoice

	config FREETZ_PACKAGE_TCPDUMP_MINI
		bool "build minimal version"
		depends on FREETZ_PACKAGE_TCPDUMP_VERSION_ABANDON
		default n
		help
			By enabling this option tcpdump will be built without
			runtime recognition and parsing capabilities for a whole
			lot of protocols and services. It will save 98KB of
			compressed squashfs.

endif # FREETZ_PACKAGE_TCPDUMP
```
