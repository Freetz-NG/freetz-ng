## make/pkgs/procps-ng/Config.in
```kconfig
menuconfig FREETZ_PACKAGE_PROCPS_NG
	bool "procps-ng 4.0.5 (binaries only)"
	depends on FREETZ_KERNEL_VERSION_3_MIN && !FREETZ_KERNEL_VERSION_3_10_12 && !FREETZ_KERNEL_VERSION_3_10_73
	default n
	select FREETZ_PACKAGE_PROCPS_NG_W \
		if !FREETZ_PACKAGE_PROCPS_NG_FREE \
		&& !FREETZ_PACKAGE_PROCPS_NG_KILL \
		&& !FREETZ_PACKAGE_PROCPS_NG_PGREP \
		&& !FREETZ_PACKAGE_PROCPS_NG_PIDOF \
		&& !FREETZ_PACKAGE_PROCPS_NG_PKILL \
		&& !FREETZ_PACKAGE_PROCPS_NG_PMAP \
		&& !FREETZ_PACKAGE_PROCPS_NG_PS \
		&& !FREETZ_PACKAGE_PROCPS_NG_PWDX \
		&& !FREETZ_PACKAGE_PROCPS_NG_SKILL \
		&& !FREETZ_PACKAGE_PROCPS_NG_SLABTOP \
		&& !FREETZ_PACKAGE_PROCPS_NG_SNICE \
		&& !FREETZ_PACKAGE_PROCPS_NG_SYSCTL \
		&& !FREETZ_PACKAGE_PROCPS_NG_TLOAD \
		&& !FREETZ_PACKAGE_PROCPS_NG_TOP \
		&& !FREETZ_PACKAGE_PROCPS_NG_UPTIME \
		&& !FREETZ_PACKAGE_PROCPS_NG_VMSTAT \
		&& !FREETZ_PACKAGE_PROCPS_NG_WATCH
	help
		procps-ng - /proc filesystem utilities
		
		This package provides the full versions of procps utilities with
		the suffix "-ng" to avoid conflicts with BusyBox versions.

if FREETZ_PACKAGE_PROCPS_NG

	choice
		prompt "Widget library"
		default FREETZ_PACKAGE_PROCPS_NG_WITH_NONE

		config FREETZ_PACKAGE_PROCPS_NG_WITH_NONE
		bool "None"

		config FREETZ_PACKAGE_PROCPS_NG_WITH_NCURSES
		bool "Ncurses"
		select FREETZ_LIB_libncurses

		config FREETZ_PACKAGE_PROCPS_NG_WITH_NCURSESW
		bool "Ncursesw"
		select FREETZ_LIB_libncursesw
	endchoice

	config FREETZ_PACKAGE_PROCPS_NG_FREE
		bool "free - display memory usage"
		default y
		help
			Display amount of free and used memory in the system.

	config FREETZ_PACKAGE_PROCPS_NG_KILL
		bool "kill - terminate process"
		default n
		help
			Terminate a process by PID.

	config FREETZ_PACKAGE_PROCPS_NG_PGREP
		bool "pgrep - lookup processes by name"
		default n
		help
			Look up processes based on name and other attributes.

	config FREETZ_PACKAGE_PROCPS_NG_PIDOF
		bool "pidof - find process ID"
		default n
		help
			Find the process ID of a running program.

	config FREETZ_PACKAGE_PROCPS_NG_PKILL
		bool "pkill - signal processes by name"
		default n
		help
			Signal processes based on name and other attributes.

	config FREETZ_PACKAGE_PROCPS_NG_PMAP
		bool "pmap - process memory map"
		default n
		help
			Report memory map of a process.

	config FREETZ_PACKAGE_PROCPS_NG_PS
		bool "ps - process status"
		default y
		help
			Report a snapshot of the current processes.

	config FREETZ_PACKAGE_PROCPS_NG_PWDX
		bool "pwdx - current directory of process"
		default n
		help
			Report current working directory of a process.

	config FREETZ_PACKAGE_PROCPS_NG_SKILL
		bool "skill - send signal to processes"
		default n
		help
			Send a signal or report process status.

	config FREETZ_PACKAGE_PROCPS_NG_SLABTOP
		bool "slabtop - kernel slab cache info"
		depends on !FREETZ_PACKAGE_PROCPS_NG_WITH_NONE
		default n
		help
			Display kernel slab cache information in real time.

	config FREETZ_PACKAGE_PROCPS_NG_SNICE
		bool "snice - renice processes"
		default n
		help
			Renice a process.

	config FREETZ_PACKAGE_PROCPS_NG_SYSCTL
		bool "sysctl - kernel parameters"
		default n
		help
			Configure kernel parameters at runtime.

	config FREETZ_PACKAGE_PROCPS_NG_TLOAD
		bool "tload - graphical load average"
		default n
		help
			Graphic representation of system load average.

	config FREETZ_PACKAGE_PROCPS_NG_TOP
		bool "top - display Linux processes"
		depends on !FREETZ_PACKAGE_PROCPS_NG_WITH_NONE
		default n
		help
			Display Linux processes in real-time.

	config FREETZ_PACKAGE_PROCPS_NG_UPTIME
		bool "uptime - system uptime"
		default y
		help
			Tell how long the system has been running.

	config FREETZ_PACKAGE_PROCPS_NG_VMSTAT
		bool "vmstat - virtual memory statistics"
		default y
		help
			Report virtual memory statistics.

	config FREETZ_PACKAGE_PROCPS_NG_WATCH
		bool "watch - execute program periodically"
		depends on !FREETZ_PACKAGE_PROCPS_NG_WITH_NONE
		default n
		help
			Execute a program periodically, showing output fullscreen.

	config FREETZ_PACKAGE_PROCPS_NG_W
		bool "w - show who is logged on"
		default y
		help
			Show who is logged on and what they are doing.

endif # FREETZ_PACKAGE_PROCPS_NG
```

## make/pkgs/pyload/Config.in
```kconfig
config FREETZ_PACKAGE_PYLOAD
	bool "pyLoad 0.4.x - DEPRECATED"
	select FREETZ_BUSYBOX_START_STOP_DAEMON
	select FREETZ_PACKAGE_PYTHON
	select FREETZ_PACKAGE_PYTHON_MOD_CTYPES
	select FREETZ_PACKAGE_PYTHON_MOD_GRP
	select FREETZ_PACKAGE_PYTHON_MOD_JSON
	select FREETZ_PACKAGE_PYTHON_MOD_MULTIPROCESSING
	select FREETZ_PACKAGE_PYTHON_MOD_SQLITE
	select FREETZ_PACKAGE_PYTHON_MOD_UNICODEDATA
	select FREETZ_PACKAGE_PYTHON_MOD_WSGIREF
	select FREETZ_PACKAGE_PYTHON_IMAGING_LIBRARY
	select FREETZ_PACKAGE_PYTHON_PYCRYPTODOME
	select FREETZ_PACKAGE_PYTHON_PYCURL
	select FREETZ_PACKAGE_PYTHON_PYOPENSSL if FREETZ_OPENSSL_VERSION_10_MAX
	select FREETZ_LIB_libcurl_WITH_SSL
	select FREETZ_PACKAGE_JS
	default n
	help
		pyLoad is a fast, lightweight and full featured download manager
		for many One-Click-Hoster, container formats like DLC, video sites
		or just plain http/ftp links.

if FREETZ_PACKAGE_PYLOAD

	config FREETZ_PACKAGE_PYLOAD_EXTRACT
		bool "With unrar and unzip for file unpacking"
		select FREETZ_PACKAGE_UNRAR
		select FREETZ_BUSYBOX_UNZIP
		help
			This selects unrar and unzip packages for file unpacking.

	config FREETZ_PACKAGE_PYLOAD_WITH_TESSERACT
		bool "With Tesseract OCR for captcha recognition"
		select FREETZ_PACKAGE_TESSERACT
		default n
		help
			Causes Tesseract OCR to be added to the image
			for captcha recognition support in pyLoad.

			Note:
			 - Tesseract OCR is a huge package.
			 - pyLoad support for captcha recognition
			   is very limited even with Tesseract OCR.

			You most probably want to say 'no' here.

	config FREETZ_PACKAGE_PYLOAD_WITH_LIGHTWEIGHT_WSGI_SERVER
		bool "With support for lightweight WSGI server"
		select FREETZ_PACKAGE_PYTHON_BJOERN
		default n
		help
			This selects python-bjoern module - a module providing
			an alternative WSGI server implementation for Python
			pretending to be fast and ultra-lightweight.
			Activating this option allows you to say 'lightweight'
			while configuring pyLoad and answering the question
			for the web-server backend.

endif # FREETZ_PACKAGE_PYLOAD
```

## make/pkgs/python-cffi/Config.in
```kconfig
config FREETZ_PACKAGE_PYTHON_CFFI
    bool "Cffi"
    depends on FREETZ_PACKAGE_PYTHON
    default n
    help
		A Foreign Function Interface package for calling C libraries from Python.
		http://cffi.readthedocs.io/
```

## make/pkgs/python-mysql-connector/Config.in
```kconfig
config FREETZ_PACKAGE_PYTHON_MYSQL_CONNECTOR
	bool "mysql-connector 8.0.21"
	depends on FREETZ_PACKAGE_PYTHON
	default n
	help
		Python MySQL Connector.
```

## make/pkgs/python-pycryptodome/Config.in
```kconfig
config FREETZ_PACKAGE_PYTHON_PYCRYPTODOME
    bool "PyCryptodome"
    depends on FREETZ_PACKAGE_PYTHON
    default n
    help
		PyCryptodome is a self-contained Python package of low-level 
		cryptographic primitives.
		It's a fork of PyCrypto that has been enhanced for modern systems.
```

## make/pkgs/python3-cffi/Config.in
```kconfig
config FREETZ_PACKAGE_PYTHON3_CFFI
	bool "cffi 1.17.1"
	depends on FREETZ_PACKAGE_PYTHON3
	select FREETZ_LIB_libffi
	default n
	help
		CFFI (C Foreign Function Interface) for Python 3.
		
		Interact with almost any C code from Python, based on C-like
		declarations that you can often copy-paste from header files
		or documentation.
		
		Required by many modern Python packages including:
		- cryptography
		- PyNaCl
		- bcrypt
		- argon2-cffi
		
		Website: https://cffi.readthedocs.io/
		GitHub: https://github.com/python-cffi/cffi
```

## make/pkgs/python3-cryptography/Config.in
```kconfig
config FREETZ_PACKAGE_PYTHON3_CRYPTOGRAPHY
	bool "cryptography 3.3.2 (last version without Rust)"
	depends on FREETZ_PACKAGE_PYTHON3
	select FREETZ_PACKAGE_PYTHON3_CFFI
	select FREETZ_LIB_libcrypto if !FREETZ_PACKAGE_OPENSSL
	select FREETZ_LIB_libssl if !FREETZ_PACKAGE_OPENSSL
	default n
	help
		cryptography 3.3.2 - Last version compatible with embedded targets
		
		This is the last version of cryptography (3.3.2, released 2020)
		that doesn't require Rust compiler.
		
		For newer cryptographic features, consider using
		python3-pycryptodome as an alternative.
		

		See PYTHON3_CRYPTOGRAPHY_UNSUPPORTED.md for migration guide.
		
		---
		
		cryptography is a package which provides cryptographic recipes and
		primitives to Python developers.
		
		Features:
		  - SSL/TLS support
		  - X.509 certificate handling
		  - Symmetric encryption (AES, ChaCha20, etc.)
		  - Asymmetric encryption (RSA, ECDSA, etc.)
		  - Message digests and signatures
		  - Key derivation functions
		
		Dependencies:
		  - Python 3.x
		  - cffi (Python C Foreign Function Interface)
		  - OpenSSL >= 1.1.1 (for cryptographic operations)
		
		Build: Uses setuptools (no Rust required for 3.3.2)
		
		Size: ~2-3 MB installed
		
		WWW: https://cryptography.io/
```

## make/pkgs/python3-lxml/Config.in
```kconfig
config FREETZ_PACKAGE_PYTHON3_LXML
	bool "lxml 5.3.0"
	depends on FREETZ_PACKAGE_PYTHON3
	select FREETZ_LIB_libxml2
	select FREETZ_LIB_libxml2_WITH_RELAXNG if !FREETZ_PACKAGE_PYTHON3_LXML_STATIC
	select FREETZ_LIB_libxslt
	default n
	help
		lxml is a powerful XML and HTML processing library.
		
		Provides:
		- Pythonic binding for libxml2 and libxslt
		- ElementTree API for XML parsing and generation
		- Fast and memory-efficient XML/HTML processing
		- XPath and XSLT support (requires libxslt, not available)
		- HTML cleaning and repair
		
		Common uses:
		- Web scraping (BeautifulSoup backend)
		- XML parsing and generation
		- Configuration file processing
		- Data extraction from HTML/XML
		
		Note: This build uses only libxml2 (without libxslt).
		XSLT transformations will not be available.
		
		Website: https://lxml.de/
		Docs: https://lxml.de/tutorial.html
```

## make/pkgs/python3-markupsafe/Config.in
```kconfig
config FREETZ_PACKAGE_PYTHON3_MARKUPSAFE
	bool "markupsafe 3.0.2"
	depends on FREETZ_PACKAGE_PYTHON3
	default n
	help
		MarkupSafe implements a text object that escapes characters
		for safe use in HTML and XML.
		
		Provides:
		- Fast C implementation of text escaping
		- Safe string handling for web templates
		- HTML/XML entity encoding
		- Integration with Jinja2 and other template engines
		
		Common uses:
		- Template rendering (Jinja2, Mako)
		- Web frameworks (Flask, Django)
		- HTML/XML generation
		- XSS attack prevention
		
		This is a core dependency for many web frameworks.
		
		Website: https://palletsprojects.com/p/markupsafe/
		Docs: https://markupsafe.palletsprojects.com/
```

## make/pkgs/python3-numpy/Config.in
```kconfig
comment "NumPy requires external storage  (Enable 'External processing' in the main menu)"
	depends on FREETZ_PACKAGE_PYTHON3 && !EXTERNAL_ENABLED && FREETZ_SHOW_DEVELOPER

config FREETZ_PACKAGE_PYTHON3_NUMPY
	bool "NumPy 2.3.3 (for Python 3) - DEVELOPER ONLY"
	depends on FREETZ_PACKAGE_PYTHON3
	depends on EXTERNAL_ENABLED
	depends on FREETZ_SHOW_DEVELOPER
	default n
	help
		NumPy is the fundamental package for scientific computing in Python.
		
		NEW: NumPy 2.3.3 with Meson build system (compatible with Python 3.14).
		Cross-compilation tested but may have edge cases.
		
		Provides:
		- Powerful N-dimensional array object (ndarray)
		- Sophisticated broadcasting functions
		- Linear algebra, Fourier transform, random number capabilities
		- Tools for integrating C/C++ and Fortran code
		
		Common uses:
		- Data analysis and machine learning
		- Scientific and engineering computations
		- Image and signal processing
		- Statistical operations
		
		WARNING: NumPy is large (~15-20 MB) and MUST be externalized.
		Ensure sufficient USB storage is available.
		
		This build uses reference BLAS (slower but no extra dependencies).
		For performance-critical applications, consider optimized libraries.
		
		Website: https://numpy.org/
		Docs: https://numpy.org/doc/stable/
```

## make/pkgs/python3-pandas/Config.in
```kconfig
comment "pandas requires external storage  (Enable 'External processing' in the main menu)"
	depends on FREETZ_PACKAGE_PYTHON3 && !EXTERNAL_ENABLED && FREETZ_DL_TOOL_developer

config FREETZ_PACKAGE_PYTHON3_PANDAS
	bool "pandas 2.2.3 (for Python 3) - DEVELOPER ONLY"
	depends on FREETZ_PACKAGE_PYTHON3
	depends on FREETZ_PACKAGE_PYTHON3_NUMPY
	depends on EXTERNAL_ENABLED
	depends on FREETZ_DL_TOOL_developer
	default n
	help
		pandas is a powerful data analysis and manipulation library.
		
		WARNING: Requires NumPy (currently developer-only).
		
		Provides:
		- DataFrame and Series data structures
		- Data alignment and integrated handling of missing data
		- Reshaping and pivoting of data sets
		- Label-based slicing, indexing, and subsetting
		- Time series functionality
		- Data I/O (CSV, Excel, SQL, HDF5, JSON, Parquet)
		
		Common uses:
		- Data cleaning and preparation
		- Statistical analysis
		- Time series analysis
		- Data visualization (with matplotlib)
		
		WARNING: pandas is large (~10-15 MB) and REQUIRES NumPy.
		Both MUST be externalized to USB storage.
		
		Website: https://pandas.pydata.org/
		Docs: https://pandas.pydata.org/docs/
```

## make/pkgs/python3-pillow/Config.in
```kconfig
config FREETZ_PACKAGE_PYTHON3_PILLOW
	bool "Pillow 11.0.0 (for Python 3) - DEVELOPER ONLY"
	depends on FREETZ_PACKAGE_PYTHON3
	depends on FREETZ_DL_TOOL_developer
	select FREETZ_LIB_libjpeg
	select FREETZ_LIB_libpng
	select FREETZ_LIB_libz
	default n
	help
		Pillow is the friendly PIL (Python Imaging Library) fork for Python 3.
		
		WARNING: Cross-compilation issues with host include paths.
		Provides extensive file format support, efficient internal
		representation, and powerful image processing capabilities.
		
		Supported formats: PNG, JPEG, GIF, TIFF, BMP, WebP, and many more.
		
		Common uses:
		- Image manipulation and processing
		- Thumbnail generation
		- Image format conversion
		- Computer vision preprocessing
		
		Website: https://python-pillow.org/
		GitHub: https://github.com/python-pillow/Pillow
```

## make/pkgs/python3-pip/Config.in
```kconfig
config FREETZ_PACKAGE_PYTHON3_PIP
	bool "pip 24.3.1"
	depends on FREETZ_PACKAGE_PYTHON3
	select FREETZ_PACKAGE_PYTHON3_SETUPTOOLS
	default n
	help
		pip is the package installer for Python 3.
		
		Allows you to install and manage additional Python packages
		from PyPI (Python Package Index) and other sources.
		
		Common uses:
		- Install pure-Python packages on the router
		- Manage Python package dependencies
		- Install packages from PyPI, git, local files
		- Upgrade and uninstall packages
		
		Usage examples:
		  pip3 install requests
		  pip3 install flask
		  pip3 list
		  pip3 uninstall package-name
		
		Note: For packages with C extensions, it's better to
		use pre-compiled modules from the "3rd-party modules" menu.
		Pip works best for pure-Python packages.
		
		Website: https://pip.pypa.io/
		Docs: https://pip.pypa.io/en/stable/
```

## make/pkgs/python3-pycryptodome/Config.in
```kconfig
config FREETZ_PACKAGE_PYTHON3_PYCRYPTODOME
	bool "pycryptodome 3.23.0"
	depends on FREETZ_PACKAGE_PYTHON3
	default n
	help
		PyCryptodome is a self-contained Python 3 package of low-level
		cryptographic primitives.
		
		It's a fork of PyCrypto that has been enhanced for modern systems
		and Python 3 compatibility.
		
		Features:
		- AES, DES, 3DES, ARC2, ARC4, Blowfish, CAST, Salsa20, ChaCha20
		- RSA, DSA, ECC (NIST P-curves and Curve25519)
		- SHA-1, SHA-2, SHA-3, BLAKE2, HMAC, CMAC, PBKDF2
		- And many more cryptographic primitives
		
		Website: https://www.pycryptodome.org/
		GitHub: https://github.com/Legrandin/pycryptodome
```
