## make/libs/libpcap/Config.in
```kconfig
menuconfig FREETZ_LIB_libpcap
	bool "libpcap (libpcap.so)"
	default n
	help
		libpcap is a system-independent interface for user-level packet capture.
		libpcap provides a portable framework for low-level network monitoring.
		Applications include network statistics collection, security monitoring,
		network debugging, etc.

if FREETZ_LIB_libpcap

	choice
		prompt "Version"
			default FREETZ_LIB_libpcap_VERSION_CURRENT

		config FREETZ_LIB_libpcap_VERSION_ABANDON
			bool "1.1.1"
			depends on FREETZ_TARGET_GCC_4_MAX

		config FREETZ_LIB_libpcap_VERSION_CURRENT
			bool "1.10.6"
			depends on FREETZ_TARGET_GCC_5_MIN

	endchoice

endif # FREETZ_LIB_libpcap
```

## make/libs/libuv/Config.in
```kconfig
config FREETZ_LIB_libuv
	bool "libuv (libuv.so)"
	depends on !FREETZ_AVM_UCLIBC_0_9_28 && !FREETZ_AVM_UCLIBC_0_9_29 && !FREETZ_AVM_UCLIBC_0_9_32
	select FREETZ_LIB_libm if FREETZ_TARGET_UCLIBC_HAS_multiple_libs
	default n
	help
		libuv is a async IO library for various programs
```

## make/libs/libzen/Config.in
```kconfig
config FREETZ_LIB_libzen
	bool "libzen (libzen.so)"
	default n
	help
		ZenLib is a C++ library that supplements the standard library.
		It is used by MediaInfo as a dependency.
```

## make/libs/mbedtls/Config.in
```kconfig
config FREETZ_LIB_libmbedcrypto
	bool "mbedCrypto (libmbedcrypto.so)"
	default n

	config FREETZ_LIB_libmbedcrypto_WITH_BLOWFISH
		bool "With Blowfish cipher" if FREETZ_LIB_libmbedcrypto
		default n
		help
			Enables support for the Blowfish block cipher.

	config FREETZ_LIB_libmbedcrypto_WITH_GENRSA
		bool "With RSA prime-number generation" if FREETZ_LIB_libmbedcrypto
		default n
		help
			Enables the RSA prime-number generation code.

config FREETZ_LIB_libmbedtls
	bool "mbedTLS (libmbedtls.so)"
	default n

config FREETZ_LIB_libmbedx509
	bool "mbedX.509 (libmbedx509.so)"
	default n

choice
	prompt "mbedTLS version"
#	default FREETZ_MBEDTLS_VERSION_306
	default FREETZ_MBEDTLS_VERSION_228
	default FREETZ_MBEDTLS_VERSION_207

	config FREETZ_MBEDTLS_VERSION_207
		bool "2.7 - DEPRECATED"
		depends on  FREETZ_TARGET_GCC_4_MAX && !FREETZ_SYSTEM_TYPE_PUMA6

	config FREETZ_MBEDTLS_VERSION_228
		bool "2.28 - DEPRECATED"
		depends on !FREETZ_TARGET_GCC_4_MAX ||  FREETZ_SYSTEM_TYPE_PUMA6

	config FREETZ_MBEDTLS_VERSION_306
		bool "3.6 - DEVELOPER"
		depends on FREETZ_SHOW_DEVELOPER
		depends on !FREETZ_TARGET_GCC_4_MAX

endchoice # "mbedTLS version"
```

## make/libs/pcre2/Config.in
```kconfig
config FREETZ_LIB_libpcre2
	bool "libpcre2 (libpcre2-8.so)"
	default n
	help
		A Perl Compatible Regular Expression library

if FREETZ_LIB_libpcre2

config FREETZ_LIB_libpcre2_WITH_JIT
	bool "Enable JIT compilation support"
	default n
	help
		Enable Just-In-Time (JIT) compilation support for faster regex execution.
		
		JIT compiles regular expressions to native machine code for better performance,
		which is beneficial for applications like PHP that use regex extensively.
		
		Size impact: Adds approximately 100-150 KB to libpcre2-8.so
		
		Note: Automatically enabled by PHP if 'Enable PCRE2 JIT compilation' is selected.
		Disabling may cause runtime warnings in PHP 8.x.

endif # FREETZ_LIB_libpcre2

config FREETZ_LIB_libpcre2_posix
	bool "libpcre2-posix (libpcre2-posix.so)"
	select FREETZ_LIB_libpcre2
	default n
	help
		A POSIX wrapper interface to the Perl Compatible Regular Expression
		library
```

## make/libs/readline/Config.in
```kconfig
config FREETZ_LIB_libreadline
	bool "libreadline (libreadline.so)"
	select FREETZ_LIB_libncurses
	default n
	help
		The Readline library provides a set of functions for use by applications
		that allow users to edit command lines as they are typed in. Both Emacs
		and vi editing modes are available. The Readline library includes
		additional functions to maintain a list of previously-entered command
		lines, to recall and perhaps reedit those lines, and perform csh-like
		history expansion on previous commands.

config FREETZ_LIB_libhistory
	bool "libhistory (libhistory.so)"
	default n
	select FREETZ_LIB_libreadline
	help
		The Readline library provides a set of functions for use by applications
		that allow users to edit command lines as they are typed in. Both Emacs
		and vi editing modes are available. The Readline library includes
		additional functions to maintain a list of previously-entered command
		lines, to recall and perhaps reedit those lines, and perform csh-like
		history expansion on previous commands.

if FREETZ_LIB_libreadline

	choice
		prompt "Version"
			default FREETZ_LIB_libreadline_VERSION_CURRENT

		config FREETZ_LIB_libreadline_VERSION_ABANDON
			bool "6.3"
			depends on FREETZ_KERNEL_VERSION_2_MAX

		config FREETZ_LIB_libreadline_VERSION_CURRENT
			bool "8.3"
			depends on !FREETZ_KERNEL_VERSION_2_MAX

	endchoice

endif # FREETZ_LIB_libreadline
```

## make/libs/udns/Config.in
```kconfig
config FREETZ_LIB_libudns
	bool "libudns (libudns.so)"
	default n
	help
		UDNS is a stub DNS resolver library with ability to perform both syncronous
		and asyncronous DNS queries.
```

## make/libs/xmlrpc/Config.in
```kconfig
config FREETZ_LIB_libxmlrpc
	bool "libxmlrpc.so"
	default n
	help
		xmlrpc-c core library

config FREETZ_LIB_libxmlrpc_server
	bool "libxmlrpc_server.so"
	default n
	select FREETZ_LIB_libxmlrpc
	help
		xmlrpc-c server library

config FREETZ_LIB_libxmlrpc_server_abyss
	bool "libxmlrpc_server_abyss.so"
	default n
	select FREETZ_LIB_libxmlrpc_server
	select FREETZ_LIB_libxmlrpc_abyss
	help
		xmlrpc-c Abyss server library

config FREETZ_LIB_libxmlrpc_server_cgi
	bool "libxmlrpc_server_cgi.so"
	default n
	select FREETZ_LIB_libxmlrpc_server
	help
		xmlrpc-c CGI server library

config FREETZ_LIB_libxmlrpc_client
	bool "libxmlrpc_client.so"
	default n
	select FREETZ_LIB_libxmlrpc
	select FREETZ_LIB_libxmlrpc_util
	help
		xmlrpc-c client library

config FREETZ_LIB_libxmlrpc_abyss
	bool "libxmlrpc_abyss.so"
	default n
	select FREETZ_LIB_libxmlrpc_util
	help
		xmlrpc-c Abyss HTTP server library

config FREETZ_LIB_libxmlrpc_util
	bool "libxmlrpc_util.so"
	default n
	help
		xmlrpc-c utility library

config FREETZ_LIB_libxmlrpc_xmlparse
	bool "libxmlrpc_xmlparse.so"
	default n
	help
		xmlrpc-c XML parser library

config FREETZ_LIB_libxmlrpc_xmltok
	bool "libxmlrpc_xmltok.so"
	default n
	help
		xmlrpc-c XML tokenizer library
```

## make/mosquitto/Config.in
```kconfig
config FREETZ_PACKAGE_MOSQUITTO
	bool "Mosquitto 1.6.15"
	default n
	select FREETZ_PACKAGE_MOSQUITTO_BROKER if (!FREETZ_PACKAGE_MOSQUITTO_CLIENT_PUB && !FREETZ_PACKAGE_MOSQUITTO_CLIENT_SUB && !FREETZ_PACKAGE_MOSQUITTO_PASSWD)
	help
		Eclipse Mosquitto™ is an open source (EPL/EDL licensed) message broker that implements
		the MQTT protocol versions 5.0, 3.1.1 and 3.1. MQTT provides a lightweight method of
		carrying out messaging using a publish/subscribe model. This makes it suitable
		for "Internet of Things" messaging such as with low power sensors or mobile devices
		such as phones, embedded computers or microcontrollers like the Arduino.

if FREETZ_PACKAGE_MOSQUITTO

	config FREETZ_PACKAGE_MOSQUITTO_BROKER
		bool "include broker server"
		select FREETZ_LIB_libdl  if FREETZ_TARGET_UCLIBC_HAS_multiple_libs
		select FREETZ_LIB_libm   if FREETZ_TARGET_UCLIBC_HAS_multiple_libs
		select FREETZ_LIB_librt  if FREETZ_TARGET_UCLIBC_HAS_multiple_libs
		default y
		help
			Adds the mosquitto broker to the image

	config FREETZ_PACKAGE_MOSQUITTO_CLIENTS
		bool # "libmosquitto"
		select FREETZ_LIB_librt       if FREETZ_TARGET_UCLIBC_HAS_multiple_libs
		select FREETZ_LIB_libpthread  if FREETZ_TARGET_UCLIBC_HAS_multiple_libs
		depends on FREETZ_PACKAGE_MOSQUITTO_CLIENT_PUB || FREETZ_PACKAGE_MOSQUITTO_CLIENT_SUB
		default y

	config FREETZ_PACKAGE_MOSQUITTO_CLIENT_PUB
		bool "include publish client"
		default n
		help
			Adds the mosquitto publish client to the image

	config FREETZ_PACKAGE_MOSQUITTO_CLIENT_SUB
		bool "include subscribe client"
		default n
		help
			Adds the mosquitto subscribe client to the image

	comment "passwd binary not available, needs OpenSSL 1.0 or newer"
		depends on !FREETZ_OPENSSL_VERSION_1_MIN

	config FREETZ_PACKAGE_MOSQUITTO_PASSWD
		bool "include passwd binary"
		depends on FREETZ_OPENSSL_VERSION_1_MIN
		select FREETZ_PACKAGE_MOSQUITTO_WITH_SSL
		default n
		help
			Adds the mosquitto_passwd utility to the image

	config FREETZ_PACKAGE_MOSQUITTO_WITH_UUID
		bool "enable uuid support in mosquitto"
		depends on FREETZ_PACKAGE_MOSQUITTO_CLIENTS
		select FREETZ_LIB_libuuid
		default y
		help
			Build using libuuid for clientid generation.

	comment "SSL support not available, needs OpenSSL 1.0 or newer"
		depends on !FREETZ_OPENSSL_VERSION_1_MIN

	config FREETZ_PACKAGE_MOSQUITTO_WITH_SSL
		bool "build with SSL support"
		depends on FREETZ_OPENSSL_VERSION_1_MIN
		select FREETZ_LIB_libcrypto
		select FREETZ_LIB_libcrypto_WITH_EC
		select FREETZ_LIB_libssl
		default n
		help
			This option enables SSL support for mosquitto.

endif # FREETZ_PACKAGE_MOSQUITTO
```

## make/nfs-utils/Config.in
```kconfig
comment "nfs-utils (not available, needs kernel modules)"
	depends on !(FREETZ_AVM_HAS_NFSD_BUILTIN || FREETZ_REPLACE_MODULE_AVAILABLE)

config FREETZ_PACKAGE_NFS_UTILS
	bool "nfs-utils 1.3.4 (binary only)"
	default n
	depends on FREETZ_AVM_HAS_NFSD_BUILTIN || FREETZ_REPLACE_MODULE_AVAILABLE
	select FREETZ_LIB_libtirpc if !FREETZ_TARGET_UCLIBC_SUPPORTS_rpc
	select FREETZ_ADD_ETCSERVICES
	select FREETZ_PACKAGE_TCP_WRAPPERS
	select FREETZ_MODULE_nfsd if !FREETZ_AVM_HAS_NFSD_BUILTIN
	help
		Linux NFS utility package
		Select nfsd-cgi if you want a configuration web interface.
		If this does not work, enable replace-kernel!

config FREETZ_PACKAGE_NFSD_V4
	bool "v4 support for NFS server (EXPERIMENTAL)"
	depends on FREETZ_PACKAGE_NFS_UTILS && !FREETZ_AVM_HAS_NFSD_BUILTIN
	select FREETZ_MODULE_NFSD_V4
	select FREETZ_LIB_libblkid
	select FREETZ_LIB_libdevmapper
	select FREETZ_LIB_libevent
	select FREETZ_LIB_libsqlite3
	select FREETZ_LIB_libnfsidmap
	default n
	help
		Provides v4 support and utilities for nfsd. Kerberos support is missing.
		Note:
		1. NFSv4 has to be enabled with "make kernel-menuconfig".
		2. The kernel modules auth_rpcgss and oid_registry must be selected manually (in the field
		"Own kernel modules").
		3. The mapper daemon idmapd is built but is disabled by default since it needs kerberos for
		full functionality.
		4. If you wish to use idmapd anyway then dnotify needs to be enabled using
		"make kernel-menuconfig". If dnotify does not work (check whether
		/proc/sys/fs/dir-notify-enabled exists) then try "replace kernel".
		
```

## make/nfsd-cgi/Config.in
```kconfig
comment "NFSD CGI (not available, needs kernel modules)"
	depends on !(FREETZ_AVM_HAS_NFSD_BUILTIN || FREETZ_REPLACE_MODULE_AVAILABLE)

config FREETZ_PACKAGE_NFSD_CGI
	bool "NFSD CGI 0.2"
	depends on FREETZ_AVM_HAS_NFSD_BUILTIN || FREETZ_REPLACE_MODULE_AVAILABLE
	select FREETZ_PACKAGE_NFS_UTILS
	select FREETZ_PACKAGE_PORTMAP if FREETZ_TARGET_UCLIBC_SUPPORTS_rpc
	select FREETZ_PACKAGE_RPCBIND if !FREETZ_TARGET_UCLIBC_SUPPORTS_rpc
	default n
	help
		Configuration frontend to NFS-server. Covers also NFSv4-support
		if enabled for nfs-utils. In case of problems try replacing the kernel.
		
```

## make/openssl/Config.in
```kconfig
config FREETZ_PACKAGE_OPENSSL
	bool "OpenSSL 0.9.8zh/1.0.2u/1.1.1n/3.0.2 (binary only)"
	default n
	select FREETZ_LIB_libatomic          if FREETZ_OPENSSL_VERSION_3_MIN
	select FREETZ_LIB_libdl              if !FREETZ_PACKAGE_OPENSSL_STATIC && FREETZ_TARGET_UCLIBC_HAS_multiple_libs
	select FREETZ_LIB_libpthread         if !FREETZ_PACKAGE_OPENSSL_STATIC && FREETZ_TARGET_UCLIBC_HAS_multiple_libs && FREETZ_OPENSSL_VERSION_2_MIN
	select FREETZ_LIB_libcrypto          if !FREETZ_PACKAGE_OPENSSL_STATIC
	select FREETZ_LIB_libssl             if !FREETZ_PACKAGE_OPENSSL_STATIC
	help
		This package contains the OpenSSL command-line utility.

if FREETZ_PACKAGE_OPENSSL

	config FREETZ_PACKAGE_OPENSSL_TRACE
		bool "With trace output support"
		depends on FREETZ_OPENSSL_VERSION_1_MIN
		default n
		help
			Build OpenSSL binary with SSL trace support.

	config FREETZ_PACKAGE_OPENSSL_STATIC
		bool "Link statically"
		default n
		help
			Causes all libraries OpenSSL binary depends on to be linked in statically.

endif # FREETZ_PACKAGE_OPENSSL
```

## make/pcsc-lite/Config.in
```kconfig
config FREETZ_PACKAGE_PCSC_LITE
	bool "PCSC-lite 1.9.5 (binary only)"
	select FREETZ_LIB_libdl       if FREETZ_TARGET_UCLIBC_HAS_multiple_libs
	select FREETZ_LIB_libpthread  if FREETZ_TARGET_UCLIBC_HAS_multiple_libs
	select FREETZ_LIB_librt       if FREETZ_TARGET_UCLIBC_HAS_multiple_libs
	select FREETZ_LIB_libusb_1
	select FREETZ_LIB_libpcsclite # loaded per dlopen
	default n
	help
		The purpose of PCSC Lite is to provide a Windows(R)
		SCard interface in a very small form factor for
		communicating to smart cards and readers.
```

## make/pkgs/acme/Config.in
```kconfig
config FREETZ_PACKAGE_ACME
	bool "ACME.sh 3.1.2"
	depends on !FREETZ_PATCH_FREETZMOUNT && !FREETZ_PACKAGE_OPENVPN_CGI && !FREETZ_PACKAGE_GW6
	select FREETZ_BUSYBOX_DESKTOP
	select FREETZ_PACKAGE_OPENSSL
	select FREETZ_PACKAGE_CA_BUNDLE
	select FREETZ_PACKAGE_WGET           if !FREETZ_PACKAGE_CURL
	select FREETZ_PACKAGE_WGET_WITH_SSL  if !FREETZ_PACKAGE_CURL
	default n
	help
		A pure Unix shell script implementing ACME client protocol.

if FREETZ_PACKAGE_ACME

	config FREETZ_PACKAGE_ACME_deploy
		bool "deploy"
		default y

	config FREETZ_PACKAGE_ACME_dnsapi
		bool "dnsapi"
		default y

	config FREETZ_PACKAGE_ACME_notify
		bool "notify"
		default y

	config FREETZ_PACKAGE_ACME_SOCAT
		bool "Select socat"
		select FREETZ_PACKAGE_SOCAT
		default n
		help
			Needed only for standalone mode.

endif # FREETZ_PACKAGE_ACME
```
