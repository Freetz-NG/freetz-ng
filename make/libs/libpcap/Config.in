## make/pkgs/cpulimit/Config.in
```kconfig
config FREETZ_PACKAGE_CPULIMIT
	bool "cpulimit 0.2"
	select FREETZ_LIB_libpthread if !FREETZ_PACKAGE_CPULIMIT_STATIC && FREETZ_TARGET_UCLIBC_HAS_multiple_libs
	default n
	help
		cpulimit is a tool which limits the CPU usage of a process (expressed 
		in percentage, not in CPU time). It is useful to control batch jobs, 
		when you don't want them to eat too many CPU cycles. The goal is to 
		prevent a process from running for more than a specified time ratio.
		
		It does not change the nice value or other scheduling priority settings, 
		but the real CPU usage. Also, it is able to adapt itself to the overall 
		system load, dynamically and quickly.
		
		The control of the used CPU amount is done sending SIGSTOP and SIGCONT 
		POSIX signals to processes. All the children processes and threads of 
		the specified process will share the same percentage of CPU.
		
		Usage examples:
		  Limit process by PID:
		    cpulimit -p 1234 -l 50
		  
		  Launch and limit command:
		    cpulimit -l 25 -- /mod/usr/bin/rtorrent
		  
		  Limit by process name:
		    cpulimit -e rtorrent -l 30
		
		WWW: https://github.com/opsengine/cpulimit

config FREETZ_PACKAGE_CPULIMIT_STATIC
	bool "Link statically"
	depends on FREETZ_PACKAGE_CPULIMIT
	default n
	help
		Link cpulimit statically (no external libraries required).
```

## make/pkgs/dnsmasq/Config.in
```kconfig
config FREETZ_PACKAGE_DNSMASQ
	bool "Dnsmasq 2.80/2.88"
	default n
	help
		Combined DHCP, DNS and TFTP server.

if FREETZ_PACKAGE_DNSMASQ

	choice
		prompt "Version"
			default FREETZ_PACKAGE_DNSMASQ_VERSION_CURRENT

		config FREETZ_PACKAGE_DNSMASQ_VERSION_ABANDON
			bool "2.80"
			depends on !FREETZ_TARGET_IPV6_SUPPORT
			help
				Version 2.80 is the last with IPv4-only support. If
				you want to use a newer version, enable IPv6 support.

		config FREETZ_PACKAGE_DNSMASQ_VERSION_CURRENT
			bool "2.87"
			depends on FREETZ_TARGET_IPV6_SUPPORT

	endchoice

	config FREETZ_PACKAGE_DNSMASQ_WITH_DNSSEC
		bool "Enable DNSSEC support"
		default n
		help
			Build with DNSSEC support enabled.

	config FREETZ_PACKAGE_DNSMASQ_ADDHOLE
		bool "Select Addhole"
		select FREETZ_PACKAGE_ADDHOLE
		default n
		help
			Selects Addhole package.

	comment "HINT: Don't forget to enable a dns/dhcp server."
		depends on FREETZ_AVMDAEMON_DISABLE_DNS || FREETZ_AVMDAEMON_DISABLE_DHCP

	config FREETZ_PACKAGE_DNSMASQ_DISABLE_DNS
		bool "Disable multid's DNS"
		depends on FREETZ_AVM_HAS_AVMMULTID_PRELOAD
		select FREETZ_AVMDAEMON_DISABLE_MULTIDPORTS
		select FREETZ_AVMDAEMON_DISABLE_DNS
		select FREETZ_AVMDAEMON_DISABLE_LLMNR
		default y
		help
			This selects the remapping of multid's DNS (and LLMNR) ports.

	config FREETZ_PACKAGE_DNSMASQ_DISABLE_DHCP
		bool "Disable multid's DHCP"
		depends on FREETZ_AVM_HAS_AVMMULTID_PRELOAD
		select FREETZ_AVMDAEMON_DISABLE_MULTIDPORTS
		select FREETZ_AVMDAEMON_DISABLE_DHCP
		default y
		help
			This selects the remapping of multid's DHCP port.

endif # FREETZ_PACKAGE_DNSMASQ
```

## make/pkgs/dropbear/Config.in
```kconfig
comment "Dropbear (not available, needs replace kernel for pty-support)"
	depends on !FREETZ_REPLACE_KERNEL && !FREETZ_AVM_HAS_PTY_SUPPORT && !FREETZ_SHOW_EXPERT

config FREETZ_PACKAGE_DROPBEAR
	bool "Dropbear 2024.86"
	depends on FREETZ_REPLACE_KERNEL || FREETZ_AVM_HAS_PTY_SUPPORT || FREETZ_SHOW_EXPERT
	select FREETZ_LIB_libutil if FREETZ_TARGET_UCLIBC_HAS_multiple_libs
	default y
	help
		Dropbear SSH server and client

		Dropbear is a relatively small SSH 2 server and client. It runs on a
		variety of POSIX-based platforms. Dropbear is open source software,
		distributed under a MIT-style license. Dropbear is particularly useful
		for "embedded"-type Linux (or other Unix) systems, such as wireless
		routers.

		Features
		  - A small memory footprint suitable for memory-constrained
		    environments - Dropbear can compile to a 110kB statically linked
		    binary with uClibc on x86 (only minimal options selected)
		  - Dropbear server implements X11 forwarding, and authentication-agent
		    forwarding for OpenSSH clients
		  - Can run from inetd or standalone
		  - Compatible with OpenSSH ~/.ssh/authorized_keys public key
		    authentication
		  - The server, client, keygen, and key converter can be compiled into a
		    single binary (a la busybox)
		  - Features can easily be disabled when compiling to save space
		    TCP forwarding support

if FREETZ_PACKAGE_DROPBEAR

	comment "Hint: Select replace kernel if need pty-support"
		depends on !FREETZ_REPLACE_KERNEL && !FREETZ_AVM_HAS_PTY_SUPPORT && FREETZ_SHOW_EXPERT

	config FREETZ_PACKAGE_DROPBEAR_SFTP_SERVER
		bool "Add SFTP support"
		depends on FREETZ_OPENSSL_VERSION_1_MIN
		select FREETZ_PACKAGE_OPENSSH
		select FREETZ_PACKAGE_OPENSSH_sftp_server
		default n
		help
			This option adds SFTP support to dropbear by using
			OpenSSH's SFTP server.

	config FREETZ_PACKAGE_DROPBEAR_SERVER_ONLY
		bool "Without scp & ssh client"
		default n

	config FREETZ_PACKAGE_DROPBEAR_WITH_ZLIB
		bool "With zlib Compression"
		select FREETZ_LIB_libz
		default n
		help
			ZLIB Compression for SSH Traffic

	config FREETZ_PACKAGE_DROPBEAR_DISABLE_HOST_LOOKUP
		bool "Disable DNS reverse-lookup of the client"
		default y
		help
			With this option, a connection between the client and
			the server is established faster.

			Without this option selected, the ssh server performs a DNS
			reverse lookup of the client's IP address.

	config FREETZ_PACKAGE_DROPBEAR_ENABLE_MOTD
		bool "Enable MOTD"
		default y
		help
			This enables printing of MOTD on login.

	config FREETZ_PACKAGE_DROPBEAR_UTMP
		bool "Enable utmp support"
		select FREETZ_BUSYBOX_FEATURE_UTMP
		select FREETZ_BUSYBOX_WHO
		default n
		help
			With this option enabled, the logins are logged to /var/run/utmp.

	config FREETZ_PACKAGE_DROPBEAR_WTMP
		bool "Enable wtmp support"
		select FREETZ_BUSYBOX_FEATURE_UTMP
		select FREETZ_BUSYBOX_FEATURE_WTMP
		select FREETZ_BUSYBOX_LAST
		default n
		help
			With this option enabled, the logins are logged to /var/log/wtmp.

	config FREETZ_PACKAGE_DROPBEAR_STATIC
		bool "Link statically"
		default n
		help
			With this option enabled, the resulting binary will be independent from libraries.
			Usually used to build a binary for boxes without "freetz".
			Newer firmwares (using uClibc >= 0.9.30) should work with dynamically linked
			binary, if "non-freetz" is selected.

	config FREETZ_PACKAGE_DROPBEAR_AUTHORIZED_KEYS
		bool "Select authorized_keys"
		default y
		select FREETZ_PACKAGE_AUTHORIZED_KEYS
		help
			Selects the "authorized_keys: Frontend for SSH keys" web
			interface package to manage the authorized_keys file for
			key-based authentication.

	config FREETZ_PACKAGE_DROPBEAR_NONFREETZ
		bool "Build for non-freetz box"
		select FREETZ_PACKAGE_DROPBEAR_STATIC if FREETZ_AVM_UCLIBC_0_9_28 || FREETZ_AVM_UCLIBC_0_9_29
		default n
		help
			With this option enabled, the resulting binary should also work
			on non freetz boxes.
			(Fix for missing devfs and changes to default paths)
			Will select "static" on firmwares not supporting dynamically linked freetz binaries.

endif # FREETZ_PACKAGE_DROPBEAR
```
