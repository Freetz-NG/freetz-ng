## make/pkgs/apache2/Config.in
```kconfig
config FREETZ_PACKAGE_APACHE2
	bool "Apache2 2.4.65 (binary only)"
	depends on FREETZ_TARGET_IPV6_SUPPORT
	select FREETZ_LIB_libcrypt        if ! FREETZ_PACKAGE_APACHE2_STATIC && FREETZ_TARGET_UCLIBC_HAS_multiple_libs
	select FREETZ_LIB_libdl           if ! FREETZ_PACKAGE_APACHE2_STATIC && FREETZ_TARGET_UCLIBC_HAS_multiple_libs
	select FREETZ_LIB_libm            if ! FREETZ_PACKAGE_APACHE2_STATIC && FREETZ_TARGET_UCLIBC_HAS_multiple_libs
	select FREETZ_LIB_libapr          if ! FREETZ_PACKAGE_APACHE2_STATIC
	select FREETZ_LIB_libapr_WITH_DSO
	select FREETZ_LIB_libaprutil      if ! FREETZ_PACKAGE_APACHE2_STATIC
	select FREETZ_LIB_libz            if ! FREETZ_PACKAGE_APACHE2_STATIC && FREETZ_PACKAGE_APACHE2_DEFLATE
	select FREETZ_LIB_libcrypto       if ! FREETZ_PACKAGE_APACHE2_STATIC && FREETZ_PACKAGE_APACHE2_SSL
	select FREETZ_LIB_libssl          if ! FREETZ_PACKAGE_APACHE2_STATIC && FREETZ_PACKAGE_APACHE2_SSL
	select FREETZ_LIB_libxml2         if ! FREETZ_PACKAGE_APACHE2_STATIC && FREETZ_PACKAGE_APACHE2_LIBXML
	select FREETZ_LIB_libxml2_WITH_HTML if FREETZ_PACKAGE_APACHE2_LIBXML
	default n
	help
		The Apache httpd server

if FREETZ_PACKAGE_APACHE2

	choice
		prompt "PCRE"
			default FREETZ_PACKAGE_APACHE2_PCRE2

		config FREETZ_PACKAGE_APACHE2_PCRE1
			bool "v1"
			select FREETZ_LIB_libpcre   if !FREETZ_PACKAGE_APACHE2_STATIC

		config FREETZ_PACKAGE_APACHE2_PCRE2
			bool "v2"
			select FREETZ_LIB_libpcre2  if !FREETZ_PACKAGE_APACHE2_STATIC

	endchoice

	config FREETZ_PACKAGE_APACHE2_DEFLATE
		bool "Enable deflate"
		default n
		help
			Enables the deflate compression. Requires libz.

	config FREETZ_PACKAGE_APACHE2_SSL
		bool "Enable SSL"
		default n
		help
			Enables the SSL module. Requires openssl.

	config FREETZ_PACKAGE_APACHE2_LIBXML
		bool "Enable libxml dependent modules"
		default n
		help
			Enables libxml dependent modules. Requires libxml2.

	config FREETZ_PACKAGE_APACHE2_COMPILEINMODS
		bool "Compile modules in instead of building loadable modules"
		default n
		help
			Causes all apache modules to be linked directly into the main binary.

	config FREETZ_PACKAGE_APACHE2_STATIC
		bool "Link statically"
		default n
		help
			Causes all libraries apache depends on to be linked in statically.

endif # FREETZ_PACKAGE_APACHE2
```

## make/pkgs/atop/Config.in
```kconfig
config FREETZ_PACKAGE_ATOP
	bool "Atop 2.12.0 (binary only)"
	depends on FREETZ_KERNEL_VERSION_4_MIN  # PERF_FLAG_FD_CLOEXEC exists since kernel v3.14
	select FREETZ_LIB_libm if FREETZ_TARGET_UCLIBC_HAS_multiple_libs
	select FREETZ_LIB_libglib_2
	select FREETZ_LIB_libncursesw
	select FREETZ_LIB_libz
	default n
	help
		The program atop is an interactive monitor to view the load on a Linux system.
		It shows the occupation of the most critical hardware resources
		(from a performance point of view) on system level, i.e. cpu, memory, disk and network.
```

## make/pkgs/binary-tools/Config.in
```kconfig
menuconfig FREETZ_PACKAGE_BINARY_TOOLS
	bool "binary-tools - Binary analysis and manipulation toolkit"
	default n
	help
		Collection of essential tools for analyzing and manipulating ELF binaries.
		Each tool can be selected individually to minimize flash usage.
		
		Total size when all selected: ~16MB
		Can be externalized to save flash memory.

if FREETZ_PACKAGE_BINARY_TOOLS

config FREETZ_PACKAGE_BINARY_TOOLS_READELF
	bool "readelf - Display information about ELF files"
	default n
	help
		Displays detailed information about ELF (Executable and Linkable Format) files,
		including headers, sections, symbols, and more.

config FREETZ_PACKAGE_BINARY_TOOLS_OBJDUMP
	bool "objdump - Display information from object files"
	default n
	help
		Displays information from object files, including disassembly,
		section headers, and symbol tables.

config FREETZ_PACKAGE_BINARY_TOOLS_OBJCOPY
	bool "objcopy - Copy and translate object files"
	default n
	help
		Copies and translates object files. Can be used to convert between
		different object file formats or modify sections.

config FREETZ_PACKAGE_BINARY_TOOLS_NM
	bool "nm - List symbols from object files"
	default n
	help
		Lists symbols from object files, useful for debugging and understanding
		which symbols are exported or required by a binary.

config FREETZ_PACKAGE_BINARY_TOOLS_STRINGS
	bool "strings - Print printable character strings"
	default n
	help
		Prints sequences of printable characters from files. Very useful for
		analyzing binaries and finding hardcoded strings.

config FREETZ_PACKAGE_BINARY_TOOLS_AR
	bool "ar - Create, modify, and extract from archives"
	default n
	help
		Maintains groups of files as a single archive file. Commonly used
		for creating static libraries (.a files).

config FREETZ_PACKAGE_BINARY_TOOLS_RANLIB
	bool "ranlib - Generate index to archive contents"
	default n
	help
		Generates an index to the contents of an archive and stores it in the archive.
		Used with static libraries created by 'ar'.

config FREETZ_PACKAGE_BINARY_TOOLS_STRIP
	bool "strip - Remove symbols from object files"
	default n
	help
		Removes debugging symbols and other unnecessary information from object files,
		reducing their size. Note: BusyBox already provides a 'strip' command.

config FREETZ_PACKAGE_BINARY_TOOLS_ADDR2LINE
	bool "addr2line - Convert addresses to file names and line numbers"
	default n
	help
		Converts addresses into file names and line numbers. Useful for debugging
		crash dumps and understanding stack traces.

config FREETZ_PACKAGE_BINARY_TOOLS_SIZE
	bool "size - Display section sizes in binary files"
	default n
	help
		Displays the sizes of sections inside binary files. Useful for understanding
		memory usage and optimizing binary size.

config FREETZ_PACKAGE_BINARY_TOOLS_PATCHELF
	bool "patchelf - Modify ELF executables and libraries"
	select FREETZ_STDCXXLIB_FORCE_GNULIBSTDCXX
	select FREETZ_LIB_STDCXXLIB
	default n
	help
		Modifies existing ELF executables and libraries. Can change the interpreter,
		RPATH, and other ELF metadata.
		
		Useful for modifying binaries to use different dynamic linker paths or
		library search paths (RPATH/RUNPATH).
		
		Note: This tool requires GNU libstdc++ (will be automatically installed
		to /usr/lib/freetz/)

endif # FREETZ_PACKAGE_BINARY_TOOLS
```

## make/pkgs/bind/Config.in
```kconfig
config FREETZ_PACKAGE_BIND
	bool "BIND 9.11.37/9.20.11"
	select FREETZ_LIB_libdns             if !FREETZ_PACKAGE_BIND_VERSION_ABANDON
	select FREETZ_LIB_libisc             if !FREETZ_PACKAGE_BIND_VERSION_ABANDON
	select FREETZ_LIB_libisccfg          if !FREETZ_PACKAGE_BIND_VERSION_ABANDON
	select FREETZ_LIB_libpthread         if FREETZ_TARGET_UCLIBC_HAS_multiple_libs
	select FREETZ_LIB_libatomic          if !FREETZ_PACKAGE_BIND_VERSION_ABANDON
	select FREETZ_LIB_liburcu            if !FREETZ_PACKAGE_BIND_VERSION_ABANDON
	select FREETZ_LIB_liburcu_cds        if !FREETZ_PACKAGE_BIND_VERSION_ABANDON
	select FREETZ_LIB_liburcu_common     if !FREETZ_PACKAGE_BIND_VERSION_ABANDON
	default n
	help
		BIND is a suite of software for interacting with the Domain Name System (DNS).
		The name BIND stands for "Berkeley Internet Name Daemon".

if FREETZ_PACKAGE_BIND

	choice
		prompt "Version"
			default FREETZ_PACKAGE_BIND_VERSION_CURRENT
			help
				 - libatomic needs uclibc >0.9.29
				 - libcap needs gcc 5.4+
				 - liburcu needs gcc 4.8+
				 - libuv needs gcc 5+

		config FREETZ_PACKAGE_BIND_VERSION_ABANDON
			bool "9.11.37"
			depends on !(FREETZ_TARGET_GCC_5_4_MIN && !(FREETZ_TARGET_UCLIBC_0_9_28 || FREETZ_TARGET_UCLIBC_0_9_29))

		config FREETZ_PACKAGE_BIND_VERSION_CURRENT
			bool "9.20.11"
			depends on  (FREETZ_TARGET_GCC_5_4_MIN && !(FREETZ_TARGET_UCLIBC_0_9_28 || FREETZ_TARGET_UCLIBC_0_9_29))

	endchoice

	config FREETZ_PACKAGE_BIND_NAMED
		bool "named"
		default y
		select FREETZ_LIB_libisccc           if !FREETZ_PACKAGE_BIND_VERSION_ABANDON
		select FREETZ_LIB_libns              if !FREETZ_PACKAGE_BIND_VERSION_ABANDON
		select FREETZ_LIB_libcap             if !FREETZ_PACKAGE_BIND_VERSION_ABANDON
		select FREETZ_LIB_libcrypto          if !FREETZ_PACKAGE_BIND_VERSION_ABANDON
		select FREETZ_LIB_libcrypto_WITH_EC  if !FREETZ_PACKAGE_BIND_VERSION_ABANDON
		select FREETZ_LIB_libssl             if !FREETZ_PACKAGE_BIND_VERSION_ABANDON
		select FREETZ_LIB_libuv              if !FREETZ_PACKAGE_BIND_VERSION_ABANDON
		help
			named is a DNS server, part of the BIND 9 distribution.
			You have to provide the config and needed zone files yourself.
			This file needs about 3,5 MB uncompressed.

		comment "HINT: Don't forget to enable the DNS server."
		depends on FREETZ_PACKAGE_BIND_NAMED && \
			FREETZ_AVMDAEMON_DISABLE_DNS

		config FREETZ_PACKAGE_BIND_NAMED_DISABLE_DNS
			bool "Disable multid's DNS"
			depends on FREETZ_PACKAGE_BIND_NAMED
			depends on FREETZ_AVM_HAS_AVMMULTID_PRELOAD
			select FREETZ_AVMDAEMON_DISABLE_MULTIDPORTS
			select FREETZ_AVMDAEMON_DISABLE_DNS
			select FREETZ_AVMDAEMON_DISABLE_LLMNR
			default y
			help
				This selects the remapping of multid's DNS (and LLMNR) ports.

	config FREETZ_PACKAGE_BIND_RNDC
		bool "rndc (binary only)"
		select FREETZ_LIB_libisccc           if !FREETZ_PACKAGE_BIND_VERSION_ABANDON
		default n
		help
			rndc allows you to use command line statements to administer the named daemon.
			This file needs about 0,5 MB uncompressed.

	config FREETZ_PACKAGE_BIND_NSUPDATE
		bool "nsupdate (binary only)"
		default n
		help
			nsupdate is used to submit Dynamic DNS Update requests to a name server.
			This file needs about 2,8 MB uncompressed.

	config FREETZ_PACKAGE_BIND_DIG
		bool "dig (binary only)"
		default n
		help
			dig is a flexible tool for interrogating DNS name servers.
			This file needs about 2,8 MB uncompressed.

	config FREETZ_PACKAGE_BIND_HOST
		bool "host (binary only)"
		default n
		help
			host is a simple utility for performing DNS lookups.
			This file needs about 2,8 MB uncompressed.

	config FREETZ_PACKAGE_BIND_NSLOOKUP
		bool "nslookup (binary only)"
		default n
		help
			nslookup is a program to query Internet domain name servers.
			This file needs about 2,8 MB uncompressed.

endif # FREETZ_PACKAGE_BIND
```

## make/pkgs/binutils-tools/Config.in
```kconfig
menuconfig FREETZ_PACKAGE_BINUTILS_TOOLS
	bool "Binutils 2.45.1 (binary only)"
	depends on !(FREETZ_AVM_PROP_ARCH_ARM && FREETZ_AVM_PROP_ARCH_BE)  # doesnt walk, dont know why
	default n
	select FREETZ_LIB_libsframe
	select FREETZ_PACKAGE_BINUTILS_TOOLS_READELF if \
		!FREETZ_PACKAGE_BINUTILS_TOOLS_ADDR2LINE && \
		!FREETZ_PACKAGE_BINUTILS_TOOLS_AR && \
		!FREETZ_PACKAGE_BINUTILS_TOOLS_NM && \
		!FREETZ_PACKAGE_BINUTILS_TOOLS_OBJCOPY && \
		!FREETZ_PACKAGE_BINUTILS_TOOLS_OBJDUMP && \
		!FREETZ_PACKAGE_BINUTILS_TOOLS_RANLIB && \
		!FREETZ_PACKAGE_BINUTILS_TOOLS_SIZE && \
		!FREETZ_PACKAGE_BINUTILS_TOOLS_STRINGS && \
		!FREETZ_PACKAGE_BINUTILS_TOOLS_STRIP
	help
		Collection of essential tools for analyzing and
		manipulating ELF binaries.
		Size of all binaries and libraries: ~1.5MB (uncompressed: ~4.5MB)

if FREETZ_PACKAGE_BINUTILS_TOOLS

	config FREETZ_PACKAGE_BINUTILS_TOOLS_ADDR2LINE
		bool "addr2line - Convert addresses to file names and line numbers"
		select FREETZ_LIB_libbfd
		default y
		help
			Converts addresses into file names and line numbers. Useful for debugging
			crash dumps and understanding stack traces.

	config FREETZ_PACKAGE_BINUTILS_TOOLS_AR
		bool "ar - Create, modify, and extract from archives"
		select FREETZ_LIB_libbfd
		default y
		help
			Maintains groups of files as a single archive file. Commonly used
			for creating static libraries (.a files).

	config FREETZ_PACKAGE_BINUTILS_TOOLS_NM
		bool "nm - List symbols from object files"
		select FREETZ_LIB_libbfd
		default y
		help
			Lists symbols from object files, useful for debugging and understanding
			which symbols are exported or required by a binary.

	config FREETZ_PACKAGE_BINUTILS_TOOLS_OBJCOPY
		bool "objcopy - Copy and translate object files"
		select FREETZ_LIB_libbfd
		default y
		help
			Copies and translates object files. Can be used to convert between
			different object file formats or modify sections.

	config FREETZ_PACKAGE_BINUTILS_TOOLS_OBJDUMP
		bool "objdump - Display information from object files"
		select FREETZ_LIB_libbfd
		select FREETZ_LIB_libopcodes
		select FREETZ_LIB_libctf
		default n
		help
			Displays information from object files, including disassembly,
			section headers, and symbol tables.

	config FREETZ_PACKAGE_BINUTILS_TOOLS_RANLIB
		bool "ranlib - Generate index to archive contents"
		select FREETZ_LIB_libbfd
		default y
		help
			Generates an index to the contents of an archive and stores it in the archive.
			Used with static libraries created by 'ar'.

	config FREETZ_PACKAGE_BINUTILS_TOOLS_READELF
		bool "readelf - Display information about ELF files"
		select FREETZ_LIB_libctf_nobfd
		default n
		help
			Displays detailed information about ELF (Executable and Linkable Format) files,
			including headers, sections, symbols, and more.

	config FREETZ_PACKAGE_BINUTILS_TOOLS_SIZE
		bool "size - Display section sizes in binary files"
		select FREETZ_LIB_libbfd
		default y
		help
			Displays the sizes of sections inside binary files. Useful for understanding
			memory usage and optimizing binary size.

	config FREETZ_PACKAGE_BINUTILS_TOOLS_STRINGS
		bool "strings - Print printable character strings"
		select FREETZ_LIB_libbfd
		default y
		help
			Prints sequences of printable characters from files. Very useful for
			analyzing binaries and finding hardcoded strings.

	config FREETZ_PACKAGE_BINUTILS_TOOLS_STRIP
		bool "strip - Remove symbols from object files"
		select FREETZ_LIB_libbfd
		default y
		help
			Removes debugging symbols and other unnecessary information from object files,
			reducing their size. Note: BusyBox already provides a 'strip' command.

endif # FREETZ_PACKAGE_BINUTILS_TOOLS
```

## make/pkgs/bzip2/Config.in
```kconfig
config FREETZ_PACKAGE_BZIP2
	bool "Bzip2 (binary only) Xu"
	select FREETZ_LIB_libbz2 if !FREETZ_PACKAGE_BZIP2_STATIC
	default n
	help
		bzip2 is a freely available, patent free, high-quality data compressor.
		It typically compresses files to within 10% to 15% of the best available
		techniques (the PPM family of statistical compressors), whilst being around
		twice as fast at compression and six times faster at decompression.

if FREETZ_PACKAGE_BZIP2

	config FREETZ_PACKAGE_BZIP2_STATIC
		bool "Link statically"
		default n
		help
			Causes libbz2 to be linked in statically

endif # FREETZ_PACKAGE_BZIP2
```

## make/pkgs/choparp/Config.in
```kconfig
config FREETZ_PACKAGE_CHOPARP
	bool "Choparp 20150613 - DEPRECATED"
	default n
	help
		Choparp is an easy-to-use proxy arp daemon. It watches arp request
		packets visible on the interface specified by the argument if_name
		and sends proxy arp reply to the sender if the arp request queries
		the MAC address (ethernet hardware address) for the network speci-
		fied by net_addr and net_mask.
```

## make/pkgs/classpath/Config.in
```kconfig
config FREETZ_PACKAGE_CLASSPATH
	bool "classpath GNU 0.99 (binary only)"
	default n
	select FREETZ_LIB_libiconv if FREETZ_TARGET_UCLIBC_0_9_28
	help
		GNU Classpath, Essential Libraries for Java, is a GNU project to create
		free core class libraries for use with virtual machines and compilers
		for the java programming language.

config FREETZ_PACKAGE_CLASSPATH_MINI
	bool "use mini classlist"
	depends on FREETZ_PACKAGE_CLASSPATH
	default n
	help
		Use minimalistic (400 KB) instead of full featured classlist (9.6 MB).
		Warning: this option doesn't work now, list of classes needs to be updated
```
