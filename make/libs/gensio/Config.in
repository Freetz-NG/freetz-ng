## make/pkgs/nmap/Config.in
```kconfig
menuconfig FREETZ_PACKAGE_NMAP
	bool "Nmap 4.76/5.51/7.991 (binary only)"
	select FREETZ_LIB_STDCXXLIB          if !FREETZ_PACKAGE_NMAP_STATIC
	select FREETZ_LIB_libm               if !FREETZ_PACKAGE_NMAP_STATIC && FREETZ_TARGET_UCLIBC_HAS_multiple_libs
	select FREETZ_LIB_libdl              if !FREETZ_PACKAGE_NMAP_STATIC && FREETZ_TARGET_UCLIBC_HAS_multiple_libs
	select FREETZ_PACKAGE_NMAP_services  if !FREETZ_ADD_ETCSERVICES && !FREETZ_AVM_HAS_ETCSERVICES
	select FREETZ_PACKAGE_NMAP_payloads  if  FREETZ_PACKAGE_NMAP_VERSION_5
	default n
	help
		Nmap ("Network Mapper") is a free and open source (license) utility for network
		exploration or security auditing. Many systems and network administrators also
		find it useful for tasks such as network inventory, managing service upgrade
		schedules, and monitoring host or service uptime. Nmap uses raw IP packets in
		novel ways to determine what hosts are available on the network, what services
		(application name and version) those hosts are offering, what operating systems
		(and OS versions) they are running, what type of packet filters/firewalls are in
		use, and dozens of other characteristics. It was designed to rapidly scan large
		networks, but works fine against single hosts. Nmap runs on all major computer
		operating systems, and both console and graphical versions are available.

if FREETZ_PACKAGE_NMAP

	choice
		prompt "Version"
		default FREETZ_PACKAGE_NMAP_VERSION_4

		config FREETZ_PACKAGE_NMAP_VERSION_4
			bool "4.76"

		config FREETZ_PACKAGE_NMAP_VERSION_5
			bool "5.51"
			depends on FREETZ_TARGET_GCC_9_MAX
			select FREETZ_STDCXXLIB_FORCE_GNULIBSTDCXX

		config FREETZ_PACKAGE_NMAP_VERSION_7
			bool "7.991"
			depends on !FREETZ_TARGET_GCC_9_MAX
			select FREETZ_STDCXXLIB_FORCE_GNULIBSTDCXX
			select FREETZ_PACKAGE_NMAP_WITH_SHARED_OPENSSL

	endchoice


	config FREETZ_PACKAGE_NMAP_ncat
		bool "Include ncat"
		depends on !FREETZ_PACKAGE_NMAP_VERSION_4
		default n
		help
			Include ncat (a much-improved reimplementation of Netcat)

	config FREETZ_PACKAGE_NMAP_nping
		bool "Include nping"
		depends on !FREETZ_PACKAGE_NMAP_VERSION_4
		default n
		help
			Include nping (a network packet generation tool / ping utility)


	config FREETZ_PACKAGE_NMAP_WITH_SHARED_DNET
		bool "Use system libdnet"
		select FREETZ_LIB_libdnet if !FREETZ_PACKAGE_NMAP_STATIC
		depends on !FREETZ_PACKAGE_NMAP_VERSION_7
		default y
		help
			Causes system (dynamic) libdnet to be used instead of the internal one.

	config FREETZ_PACKAGE_NMAP_WITH_SHARED_LUA
		bool "Use system liblua"
		select FREETZ_LIB_liblua if !FREETZ_PACKAGE_NMAP_STATIC
		depends on !FREETZ_PACKAGE_NMAP_VERSION_7
		depends on FREETZ_TARGET_GCC_9_MAX
		default n
		help
			Causes system (dynamic) liblua to be used instead of the internal one.

	config FREETZ_PACKAGE_NMAP_WITH_SHARED_PCAP
		bool "Use system libcpap"
		select FREETZ_LIB_libpcap if !FREETZ_PACKAGE_NMAP_STATIC
		default y
		help
			Causes system (dynamic) libpcap to be used instead of the internal one.

	config FREETZ_PACKAGE_NMAP_WITH_SHARED_PCRE
		bool "Use system libpcre"
		depends on !FREETZ_PACKAGE_NMAP_VERSION_7
		select FREETZ_LIB_libpcre if !FREETZ_PACKAGE_NMAP_STATIC
		default y
		help
			Causes system (dynamic) libpcre to be used instead of the internal one.

	config FREETZ_PACKAGE_NMAP_WITH_SHARED_PCRE2
		bool "Use system libpcre2"
		depends on FREETZ_PACKAGE_NMAP_VERSION_7
		select FREETZ_LIB_libpcre2 if !FREETZ_PACKAGE_NMAP_STATIC
		default y
		help
			Causes system (dynamic) libpcre2 to be used instead of the internal one.


	config FREETZ_PACKAGE_NMAP_WITH_SHARED_OPENSSL
		bool "Add system openssl"
		select FREETZ_LIB_libcrypto  if !FREETZ_PACKAGE_NMAP_STATIC
		select FREETZ_LIB_libssl     if !FREETZ_PACKAGE_NMAP_STATIC
		depends on FREETZ_PACKAGE_NMAP_VERSION_7
		default y
		help
			Causes system (dynamic) openssl to be used instead of disabled features.

	config FREETZ_PACKAGE_NMAP_WITH_SHARED_Z
		bool "Add system libz"
		select FREETZ_LIB_libz if !FREETZ_PACKAGE_NMAP_STATIC
		depends on FREETZ_PACKAGE_NMAP_VERSION_7
		default n
		help
			Causes system (dynamic) libz to be used instead of disabled features.


	config FREETZ_PACKAGE_NMAP_STATIC
		bool "Link statically"
		depends on !FREETZ_PACKAGE_NMAP_VERSION_7
		default n
		help
			Causes all libraries to be linked in statically.

	comment " Databases:"

	config FREETZ_PACKAGE_NMAP_mac_prefixes
		bool "MAC-address to manufacturer mapping"
		default n
		help
			1 MB uncompressed

	config FREETZ_PACKAGE_NMAP_os_db
		bool "OS fingerprinting DB"
		default n
		help
			5 MB uncompressed

	config FREETZ_PACKAGE_NMAP_payloads
		depends on FREETZ_PACKAGE_NMAP_VERSION_5
		bool "Payload DB"
		default y

	config FREETZ_PACKAGE_NMAP_protocols
		bool "Protocol list"
		default y
		help
			7 kB uncompressed

	config FREETZ_PACKAGE_NMAP_rpc
		bool "RPC grinding DB"
		default n
		help
			40 kB uncompressed

	config FREETZ_PACKAGE_NMAP_service_probes
		bool "Service detection probe list"
		default y
		help
			2,5 MB uncompressed, compressed 500 kB
			Used instead Payload DB in v7

	config FREETZ_PACKAGE_NMAP_services
		bool "Service list"
		default y
		help
			1 MB uncompressed

endif # FREETZ_PACKAGE_NMAP
```

## make/pkgs/patchelf/Config.in
```kconfig
config FREETZ_PACKAGE_PATCHELF
	bool "PatchELF 0.19.2 (binary only)"
	depends on FREETZ_TARGET_GCC_13_MIN  # in fact min gcc11 for C++17
	depends on FREETZ_TARGET_ARCH_LE  # BE is broken
	select FREETZ_STDCXXLIB_FORCE_GNULIBSTDCXX
	select FREETZ_LIB_STDCXXLIB
	default n
	help
		Modifies existing ELF executables and libraries. Can change the interpreter,
		RPATH, and other ELF metadata.
```

## make/pkgs/php/Config.in
```kconfig
menuconfig FREETZ_PACKAGE_PHP
	bool "PHP 5.6.40/8.2.33/8.3.33/8.4.25/8.5.10 (binary only)"
	select FREETZ_PACKAGE_PHP_cgi if !( FREETZ_PACKAGE_PHP_cli || FREETZ_PACKAGE_PHP_apxs2 )
	select FREETZ_LIB_libdl if ! FREETZ_PACKAGE_PHP_STATIC && FREETZ_TARGET_UCLIBC_HAS_multiple_libs
	default n
	help
		PHP: Hypertext Preprocessor

		PHP is a widely-used general-purpose scripting language that is especially
		suited for Web development and can be embedded into HTML. Much of its syntax
		is borrowed from C, Java and Perl with a couple of unique PHP-specific features
		thrown in. The goal of the language is to allow web developers to write
		dynamically generated pages quickly.

if FREETZ_PACKAGE_PHP


	choice
		prompt "Version"
			default FREETZ_PACKAGE_PHP_VERSION_85
			default FREETZ_PACKAGE_PHP_VERSION_84
			default FREETZ_PACKAGE_PHP_VERSION_83
			default FREETZ_PACKAGE_PHP_VERSION_82
			default FREETZ_PACKAGE_PHP_VERSION_56

		config FREETZ_PACKAGE_PHP_VERSION_56
			bool "5.6.40 - DEPRECATED"
			depends on FREETZ_TARGET_BITS_32
			select FREETZ_PACKAGE_PHP_WITH_PCRE

		config FREETZ_PACKAGE_PHP_VERSION_82
			bool "8.2.33"
			depends on FREETZ_TARGET_GCC_5_MIN
			depends on FREETZ_TARGET_GCC_8_MIN if FREETZ_TARGET_ARCH_X86
			select FREETZ_LIB_libonig if ! FREETZ_PACKAGE_PHP_STATIC
			select FREETZ_PACKAGE_PHP_WITH_PCRE2

		config FREETZ_PACKAGE_PHP_VERSION_83
			bool "8.3.33"
			depends on FREETZ_TARGET_GCC_5_MIN
			depends on FREETZ_TARGET_GCC_8_MIN if FREETZ_TARGET_ARCH_X86
			select FREETZ_LIB_libonig if ! FREETZ_PACKAGE_PHP_STATIC
			select FREETZ_PACKAGE_PHP_WITH_PCRE2

		config FREETZ_PACKAGE_PHP_VERSION_84
			bool "8.4.25"
			depends on FREETZ_TARGET_GCC_5_MIN
			depends on FREETZ_TARGET_GCC_8_MIN if FREETZ_TARGET_ARCH_X86
			select FREETZ_LIB_libonig if ! FREETZ_PACKAGE_PHP_STATIC
			select FREETZ_PACKAGE_PHP_WITH_PCRE2

		config FREETZ_PACKAGE_PHP_VERSION_85
			bool "8.5.10"
			depends on FREETZ_TARGET_GCC_5_MIN
			depends on FREETZ_TARGET_GCC_8_MIN if FREETZ_TARGET_ARCH_X86
			select FREETZ_LIB_libonig if ! FREETZ_PACKAGE_PHP_STATIC
			select FREETZ_PACKAGE_PHP_WITH_PCRE2

	endchoice


	comment "Binaries"

	config FREETZ_PACKAGE_PHP_cgi
		bool "PHP CGI"
		default y

	config FREETZ_PACKAGE_PHP_cli
		bool "PHP CLI"
		default n

	config FREETZ_PACKAGE_PHP_apxs2
		bool "Apache2 module"
		default n
		select FREETZ_LIB_libapr_WITH_DSO
		select FREETZ_BUSYBOX_STRINGS


	comment "Features"

	config FREETZ_PACKAGE_PHP_WITH_FILEINFO
		bool "With FILEINFO support"
		default n
		help
			This option enables the FILEINFO support for PHP

	config FREETZ_PACKAGE_PHP_WITH_FTP
		bool "With FTP support"
		default n
		help
			This option enables the FTP support for PHP

	config FREETZ_PACKAGE_PHP_WITH_ICONV
		bool "With ICONV support"
		select FREETZ_PACKAGE_PHP_WITH_LIBICONV if FREETZ_TARGET_UCLIBC_0_9_28
		default n
		help
			This option enables the ICONV support for PHP

	config FREETZ_PACKAGE_PHP_WITH_JSON
		bool "With JSON support"
		depends on FREETZ_PACKAGE_PHP_VERSION_56
		default n
		help
			This option enables the JSON support for PHP

	config FREETZ_PACKAGE_PHP_WITH_MHASH
		bool "With MHASH support"
		depends on FREETZ_PACKAGE_PHP_VERSION_56
		default n
		help
			This option enables the MHASH support for PHP

	config FREETZ_PACKAGE_PHP_WITH_MYSQL
		bool "With MySQL support"
		depends on !FREETZ_PACKAGE_PHP_VERSION_56
		default n
		help
			This option enables the MYSQL support for PHP
			For SSL-encrypted connections, enable SSL support.

	config FREETZ_PACKAGE_PHP_WITH_PCNTL
		bool "With PCNTL support"
		default n
		help
			This option enables the PCNTL support for PHP

	config FREETZ_PACKAGE_PHP_WITH_SESSION
		bool "With SESSION support"
		default n
		help
			This option enables the SESSION support for PHP

	config FREETZ_PACKAGE_PHP_WITH_SOCKETS
		bool "With SOCKETS support"
		default n
		help
			This option enables the SOCKETS support for PHP

	config FREETZ_PACKAGE_PHP_WITH_SYSVIPC
		bool "With SYSVIPC support"
		default n
		help
			This option enables the SYSVIPC support for PHP


	comment "Libraries"

	config FREETZ_PACKAGE_PHP_WITH_CURL
		bool "Build with CURL"
		depends on !FREETZ_PACKAGE_PHP_VERSION_56
		select FREETZ_LIB_libcurl if ! FREETZ_PACKAGE_PHP_STATIC
		default n
		help
			This option enables the CURL support for PHP
			Not available for php5 as current libcurl version is incompatible

	config FREETZ_PACKAGE_PHP_WITH_FFI
		bool "Build with FFI"
		depends on !FREETZ_PACKAGE_PHP_VERSION_56
		select FREETZ_LIB_libffi if ! FREETZ_PACKAGE_PHP_STATIC
		default n
		help
			This option enables the Foreign Function Interface (FFI) support for PHP
			Not available for php5 as libffi is incompatible

	config FREETZ_PACKAGE_PHP_WITH_GD
		bool "Build with GD"
		depends on !FREETZ_PACKAGE_PHP_VERSION_56
		select FREETZ_LIB_libgd if ! FREETZ_PACKAGE_PHP_STATIC
		default n
		help
			This option enables the GD support for PHP
			Not available for php5 as current libgd version is incompatible

	config FREETZ_PACKAGE_PHP_WITH_GETTEXT
		bool "Build with gettext"
		depends on !FREETZ_TARGET_UCLIBC_0_9_28
		select FREETZ_LIB_libintl if ! FREETZ_PACKAGE_PHP_STATIC
		default n
		help
			This option enables the gettext support for PHP
			Not available with uClibc 0.9.28 as current gettext version is incompatible

	config FREETZ_PACKAGE_PHP_WITH_LIBICONV
		bool "Build with ICONV"
		depends on FREETZ_PACKAGE_PHP_WITH_ICONV
		depends on FREETZ_TARGET_UCLIBC_0_9_28
		select FREETZ_LIB_libiconv if ! FREETZ_PACKAGE_PHP_STATIC
		default n
		help
			This option causes PHP to use libiconv implementation of iconv function
			instead of the libc one. Select this option if you need more charsets
			than supported by libc (ISO-8859-1 and UTF-8 only) or your application
			relies on libiconv specific features like TRANSLIT, IGNORE, etc.

	config FREETZ_PACKAGE_PHP_WITH_PCRE
		bool "Build with PCRE"
		depends on FREETZ_PACKAGE_PHP_VERSION_56
		select FREETZ_LIB_libpcre if ! FREETZ_PACKAGE_PHP_STATIC
		default n
		help
			This option enables the PCRE support for PHP

	config FREETZ_PACKAGE_PHP_WITH_PCRE2
		bool "Build with PCRE2"
		depends on !FREETZ_PACKAGE_PHP_VERSION_56
		select FREETZ_LIB_libpcre2 if ! FREETZ_PACKAGE_PHP_STATIC
		default n
		help
			This option enables the PCRE2 support for PHP

		config FREETZ_PACKAGE_PHP_WITH_PCRE2_JIT
			bool "With PCRE2 Jit support"
			depends on FREETZ_PACKAGE_PHP_WITH_PCRE2
			select FREETZ_LIB_libpcre2_WITH_JIT
			default n
			help
				This option enables the PCRE2 Jit support for PHP

	config FREETZ_PACKAGE_PHP_WITH_SQLITE3
		bool "Build with SQLite (v3)"
		select FREETZ_LIB_libsqlite3 if ! FREETZ_PACKAGE_PHP_STATIC
		default n
		help
			This option enables the SQLite (v3) support for PHP

	comment "SSL support needs OpenSSL 1.0 or older"
		depends on FREETZ_PACKAGE_PHP_VERSION_56
		depends on !FREETZ_OPENSSL_VERSION_10_MAX

	comment "SSL support needs OpenSSL 1.1 or newer"
		depends on !FREETZ_PACKAGE_PHP_VERSION_56
		depends on !FREETZ_OPENSSL_VERSION_11_MIN

	config FREETZ_PACKAGE_PHP_WITH_SSL
		bool "Build with (Open)SSL"
		depends on \
			( FREETZ_PACKAGE_PHP_VERSION_56 && FREETZ_OPENSSL_VERSION_10_MAX) || \
			(!FREETZ_PACKAGE_PHP_VERSION_56 && FREETZ_OPENSSL_VERSION_11_MIN)
		select FREETZ_LIB_libcrypto if !FREETZ_PACKAGE_PHP_STATIC
		select FREETZ_LIB_libssl    if !FREETZ_PACKAGE_PHP_STATIC
		default n
		help
			This option enables the SSL support for PHP

	config FREETZ_PACKAGE_PHP_WITH_LIBXML
		bool "Build with XML"
		depends on !FREETZ_PACKAGE_PHP_VERSION_56
		select FREETZ_LIB_libxml2 if ! FREETZ_PACKAGE_PHP_STATIC
		default n
		help
			This option enables the XML support for PHP
			Not available for php5 as current libxml version is incompatible

		config FREETZ_PACKAGE_PHP_WITH_LIBXML_HTML
			bool "With XML HTML support"
			depends on !FREETZ_PACKAGE_PHP_VERSION_56
			depends on FREETZ_PACKAGE_PHP_WITH_LIBXML
			select FREETZ_LIB_libxml2_WITH_HTML
			default n
			help
				This option enables the XML support with HTML for PHP

		config FREETZ_PACKAGE_PHP_WITH_LIBXML_RELAXNG
			bool "With XML RELAXNG support"
			depends on !FREETZ_PACKAGE_PHP_VERSION_56
			depends on FREETZ_PACKAGE_PHP_WITH_LIBXML
			select FREETZ_LIB_libxml2_WITH_RELAXNG
			default n
			help
				This option enables the XML support with RELAXNG for PHP

	config FREETZ_PACKAGE_PHP_WITH_ZIP
		bool "Build with ZIP"
		select FREETZ_LIB_libzip             if ! FREETZ_PACKAGE_PHP_STATIC && !FREETZ_PACKAGE_PHP_VERSION_56
		select FREETZ_LIB_libz               if ! FREETZ_PACKAGE_PHP_STATIC &&  FREETZ_PACKAGE_PHP_VERSION_56
		default n
		help
			This option enables the ZIP support for PHP

	config FREETZ_PACKAGE_PHP_WITH_ZLIB
		bool "Build with ZLIB"
		select FREETZ_LIB_libz if ! FREETZ_PACKAGE_PHP_STATIC
		default n
		help
			This option enables the ZLIB support for PHP


	comment "Advanced"

	config FREETZ_PACKAGE_PHP_STATIC
		bool "Link statically"
		default n
		help
			Causes all libraries PHP depends on to be linked in statically.


endif # FREETZ_PACKAGE_PHP
```

## make/pkgs/rpcbind/Config.in
```kconfig
config FREETZ_PACKAGE_RPCBIND
	bool "RPCBind 1.3.1 (binary only)"
	depends on !FREETZ_TARGET_UCLIBC_SUPPORTS_rpc
	default n
	select FREETZ_PACKAGE_TCP_WRAPPERS
	select FREETZ_LIB_libtirpc
	select FREETZ_ADD_ETCNETCONFIG
	help
		The rpcbind utility is a server that converts
		RPC program numbers into universal addresses.

if FREETZ_PACKAGE_RPCBIND

	comment "WARNING: This replaces avm's binaries"
		depends on FREETZ_AVM_HAS_RPCBIND

	config FREETZ_PACKAGE_RPCBIND_RPCINFO
		bool "RPCInfo"
		default n
		help
			The rpcinfo utility makes an RPC call to an
			RPC server and reports what it finds. 

endif # FREETZ_PACKAGE_RPCBIND
```
