## make/pkgs/rsync/Config.in
```kconfig
config FREETZ_PACKAGE_RSYNC
	bool "rsync 3.4.1/3.5.2"
	select FREETZ_LIB_libpopt
	select FREETZ_LIB_libz
	default n
	help
		rsync is an open source utility that provides fast incremental
		file transfer.

if FREETZ_PACKAGE_RSYNC

	choice
		prompt "Version"
			default FREETZ_PACKAGE_RSYNC_VERSION_CURRENT

		config FREETZ_PACKAGE_RSYNC_VERSION_ABANDON
			bool "3.4.1 (AI free)"
#			depends on  (FREETZ_TARGET_UCLIBC_0_9_28 || FREETZ_TARGET_UCLIBC_0_9_29)

		config FREETZ_PACKAGE_RSYNC_VERSION_CURRENT
			bool "3.5.2 (AI slop)"
			depends on !(FREETZ_TARGET_UCLIBC_0_9_28 || FREETZ_TARGET_UCLIBC_0_9_29)

	endchoice

	config FREETZ_PACKAGE_RSYNC_REMOVE_WEBIF
		bool "remove webinterface"
		default n
		help
			This option removes the webinterface

endif # FREETZ_PACKAGE_RSYNC
```

## make/pkgs/ser2net/Config.in
```kconfig
config FREETZ_PACKAGE_SER2NET
	bool "ser2net 4.6.8"
	default n
	select FREETZ_LIB_libgensio
	select FREETZ_LIB_libgensioosh
	select FREETZ_LIB_libgensiomdns
	select FREETZ_LIB_libyaml
	select FREETZ_LIB_libpthread if FREETZ_TARGET_UCLIBC_HAS_multiple_libs
	help
		Ser2net is a program for allowing network connections to serial
		ports. It supports RFC 2217 (remote control of serial port
		parameters), but you must have a compliant client.
		Configuration uses YAML format (ser2net.yaml).
```

## make/pkgs/sispmctl/Config.in
```kconfig
config FREETZ_PACKAGE_SISPMCTL
	bool "sispmctl 4.12 - DEPRECATED"
	depends on ! FREETZ_AVM_HAS_USB_HOST_AHCI
	select FREETZ_LIB_libusb0
	default n
	help
		sispmctl is an application enabling the use of the GEMBIRD
		SiS-PM (sispm) USB-controlled power-outlet device under Linux.
		Note that the device is also sold under different names, i.e. as
		"IntelliPlug" in Germany.

if FREETZ_PACKAGE_SISPMCTL

	config FREETZ_SISPMCTL_CGI
		bool "freetz specific cgi, rc script and parameter configuration"
		default n
		help
			This option integrates freetz specific cgi for configuration
			of sispmctl and definition of start parameters for
			integrated web server. Also freetz adapted rc script with all
			required configuration files is integrated into image.
			If this option is deactivated, only sispmctl binary without
			freetz specific adaptation will be integrated into image.
			In this case user must start and handle the binary manually.

	config FREETZ_SISPMCTL_WEB
		bool "enable internal web server"
		default n
		help
			This option enables sispmctl's internal web server and
			installs the standard skin.

	config FREETZ_SISPMCTL_SKIN2
		bool "install alternative SMARTPHONE skin for web interface"
		depends on FREETZ_SISPMCTL_WEB
		default n
		help
			This option installs the third alternative skin
			(SMARTPHONE) for internal web interface
			additionaly to standard skin.

endif # FREETZ_PACKAGE_SISPMCTL
```

## make/pkgs/tor/Config.in
```kconfig
comment "Tor (not available, needs OpenSSL 1.0 or newer)"
	depends on !FREETZ_OPENSSL_VERSION_10_MIN

config FREETZ_PACKAGE_TOR
	bool "Tor 0.4.8.25/0.4.9.12"
	depends on FREETZ_OPENSSL_VERSION_10_MIN
	select FREETZ_LIB_libm               if !FREETZ_PACKAGE_TOR_STATIC && FREETZ_TARGET_UCLIBC_HAS_multiple_libs
	select FREETZ_LIB_libevent           if !FREETZ_PACKAGE_TOR_STATIC
	select FREETZ_LIB_libcrypto          if !FREETZ_PACKAGE_TOR_STATIC
	select FREETZ_LIB_libcrypto_WITH_EC
	select FREETZ_LIB_libssl             if !FREETZ_PACKAGE_TOR_STATIC
	select FREETZ_LIB_libz               if !FREETZ_PACKAGE_TOR_STATIC
	select FREETZ_BUSYBOX_NICE
	select FREETZ_BUSYBOX_SOFTLIMIT
	default n
	help
		The Onion Router
		Anonymous Internet communication system.

if FREETZ_PACKAGE_TOR

	choice
		prompt "Version"
			default FREETZ_PACKAGE_TOR_VERSION_CURRENT

		config FREETZ_PACKAGE_TOR_VERSION_ABANDON
			bool "0.4.8.25 - DEPRECATED"
			depends on !FREETZ_OPENSSL_VERSION_11_MIN

		config FREETZ_PACKAGE_TOR_VERSION_CURRENT
			bool "0.4.9.12"
			depends on FREETZ_OPENSSL_VERSION_11_MIN

	endchoice

	config FREETZ_PACKAGE_TOR_GEOIP_V4
		bool "With GeoIP database for IPv4"
		default n
		help
			This includes the GeoIP database for IPv4.
			Needs about 850KB (compressed).

	config FREETZ_PACKAGE_TOR_GEOIP_V6
		bool "With GeoIP database for IPv6"
		default n
		help
			This includes the GeoIP database for IPv6.
			Needs about 180 KB (compressed).

	config FREETZ_PACKAGE_TOR_RELAY
		bool "With Relay module"
		default n
		help
			Build tor binary with module relay and module dirauth.

	config FREETZ_PACKAGE_TOR_STATIC
		bool "Link statically"
		depends on FREETZ_OPENSSL_VERSION_10
		default n
		help
			Build tor binary with statically linked libraries.

endif # FREETZ_PACKAGE_TOR
```

## make/pkgs/vim/Config.in
```kconfig
config FREETZ_PACKAGE_VIM
	bool "Vim 9.2.1169 (binary only)"
	select FREETZ_LIB_libdl  if FREETZ_TARGET_UCLIBC_HAS_multiple_libs
	select FREETZ_LIB_libm   if FREETZ_TARGET_UCLIBC_HAS_multiple_libs
	select FREETZ_LIB_libncurses
	default n
	help
		An improved version of VI

choice
	prompt "vim executable feature set"
		default FREETZ_PACKAGE_VIM_TINY
		depends on FREETZ_PACKAGE_VIM
		help
			Select your vim flavour here.

			tiny = simple (v) improved editing functionality.
			normal = simple (v) improved editing functionality + colors + folding
			huge = simple (v) improved editing functionality + colors + folding + scripts + plugins

			This option only makes the executable larger,
			it does not copy the runtime files. Those would not fit on your box either.
			It's up to you to get it to /usr/share/vim, eg. bind mounts.

		config FREETZ_PACKAGE_VIM_TINY
			bool "tiny"

		config FREETZ_PACKAGE_VIM_NORMAL
			depends on FREETZ_SHOW_EXPERT
			bool "normal - EXPERIMENTAL"

		config FREETZ_PACKAGE_VIM_HUGE
			depends on FREETZ_SHOW_EXPERT
			bool "huge - EXPERIMENTAL"

endchoice
```

## make/pkgs/vnstat-cgi/Config.in
```kconfig
config FREETZ_PACKAGE_VNSTAT_CGI
	bool "vnStat Webinterface"
	depends on !(FREETZ_TARGET_UCLIBC_0_9_28 || FREETZ_TARGET_UCLIBC_0_9_29)
	select FREETZ_PACKAGE_VNSTAT
	select FREETZ_PACKAGE_VNSTAT_CLI
	select FREETZ_PACKAGE_VNSTAT_DAEMON
	select FREETZ_PACKAGE_VNSTAT_IMAGE
	default n
	help
		Lets you view graphically the output of vnStat.
```

## make/pkgs/vnstat/Config.in
```kconfig
config FREETZ_PACKAGE_VNSTAT
	bool "vnStat 1.18/2.14 (binary only)"
	default n
	depends on !(FREETZ_TARGET_UCLIBC_0_9_28 || FREETZ_TARGET_UCLIBC_0_9_29)
	select FREETZ_PACKAGE_VNSTAT_CLI if !FREETZ_PACKAGE_VNSTAT_DAEMON && !FREETZ_PACKAGE_VNSTAT_IMAGE
	select FREETZ_LIB_libm if FREETZ_TARGET_UCLIBC_HAS_multiple_libs
	help
		vnStat is a console-based network traffic monitor. It keeps a log of
		hourly, daily and monthly network traffic for the selected interface(s).
		However, it isn't a packet sniffer. The traffic information is analyzed
		from the proc(5) filesystem. That way vnStat can be used even
		without root permissions.

if FREETZ_PACKAGE_VNSTAT

	choice
		prompt "Version"
			default FREETZ_PACKAGE_VNSTAT_VERSION_CURRENT

		config FREETZ_PACKAGE_VNSTAT_VERSION_ABANDON
			bool "1.18 - DEPRECATED"
			help
				This version uses a separate database file for each network interface.

		config FREETZ_PACKAGE_VNSTAT_VERSION_CURRENT
			bool "2.14"
			select FREETZ_LIB_libsqlite3
			help
				This version uses a shared sqlite database for all network interfaces.

	endchoice

	config FREETZ_PACKAGE_VNSTAT_CLI
		bool "vnstat cli"
		default y
		help
			This is a command line tool for:
			 - managing monitored interfaces
			 - displaying traffic statistics

	config FREETZ_PACKAGE_VNSTAT_DAEMON
		bool "vnstat daemon"
		default n
		help
			This is a daemon for collecting data

	config FREETZ_PACKAGE_VNSTAT_IMAGE
		bool "vnstat image"
		default n
		select FREETZ_LIB_libgd
		help
			This component is for creating images

endif # FREETZ_PACKAGE_VNSTAT
```
