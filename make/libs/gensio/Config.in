## make/libs/gensio/Config.in
```kconfig
config FREETZ_LIB_libgensio
	bool "libgensio (libgensio.so)"
	depends on !(FREETZ_TARGET_UCLIBC_0_9_28 || FREETZ_TARGET_UCLIBC_0_9_29)
	select FREETZ_LIB_libgensioosh
	select FREETZ_LIB_libgensiomdns
	select FREETZ_LIB_libpthread if FREETZ_TARGET_UCLIBC_HAS_multiple_libs
	default n
	help
		Gensio - a library for abstracting stream I/O. Provides network
		and serial I/O with support for TCP, UDP, serial devices, telnet,
		SSL/TLS, and more.

config FREETZ_LIB_libgensioosh
	bool "libgensioosh (libgensioosh.so)"
	depends on !(FREETZ_TARGET_UCLIBC_0_9_28 || FREETZ_TARGET_UCLIBC_0_9_29)
	select FREETZ_LIB_libpthread if FREETZ_TARGET_UCLIBC_HAS_multiple_libs
	default n
	help
		Gensio OS helper library - provides OS abstraction functions.

config FREETZ_LIB_libgensiomdns
	bool "libgensiomdns (libgensiomdns.so)"
	depends on !(FREETZ_TARGET_UCLIBC_0_9_28 || FREETZ_TARGET_UCLIBC_0_9_29)
	select FREETZ_LIB_libgensioosh
	default n
	help
		Gensio mDNS library - provides mDNS service discovery support.
```

## make/libs/glib2/Config.in
```kconfig
config FREETZ_LIB_libglib_2
	bool "libglib (libglib-2.0.so)"
	select FREETZ_LIB_libiconv  if FREETZ_LIB_libglib_2_WITH_VERSION_ABANDON && FREETZ_TARGET_UCLIBC_0_9_28
	select FREETZ_LIB_libpcre   if FREETZ_LIB_libglib_2_WITH_VERSION_ABANDON
	select FREETZ_LIB_libpcre2  if FREETZ_LIB_libglib_2_WITH_VERSION_CURRENT
	select FREETZ_LIB_libintl   if FREETZ_LIB_libglib_2_WITH_VERSION_CURRENT
	select FREETZ_LIB_libpthread if FREETZ_TARGET_UCLIBC_HAS_multiple_libs
	default n
	help
		GLib is a library containing many useful C routines for things such as
		trees, hashes, and lists.

config FREETZ_LIB_libgio_2
	bool "libgio (libgio-2.0.so)"
	select FREETZ_LIB_libglib_2
	select FREETZ_LIB_libgmodule_2
	select FREETZ_LIB_libgobject_2
	select FREETZ_LIB_libgthread_2  if FREETZ_LIB_libglib_2_WITH_VERSION_ABANDON
	select FREETZ_LIB_libintl       if FREETZ_LIB_libglib_2_WITH_VERSION_CURRENT
	select FREETZ_LIB_libz
	default n
	help
		Input, output and streaming API of GLib.

config FREETZ_LIB_libgobject_2
	bool "libgobject (libgobject-2.0.so)"
	select FREETZ_LIB_libglib_2
	select FREETZ_LIB_libffi
	default n
	help
		If your application uses Glib2 GObjects, select this library.

config FREETZ_LIB_libgmodule_2
	bool "libgmodule (libgmodule-2.0.so)"
	select FREETZ_LIB_libglib_2
	select FREETZ_LIB_libdl if FREETZ_TARGET_UCLIBC_HAS_multiple_libs
	default n
	help
		If your application uses Glib2 modules (plug-ins), select this library.

config FREETZ_LIB_libgthread_2
	bool "libgthread (libgthread-2.0.so)"
	select FREETZ_LIB_libglib_2
	default n
	help
		If your application uses Glib2 threads, select this library.

config FREETZ_LIB_libgirepository_2
	bool "libgirepository (libgirepository-2.0.so)"
	depends on FREETZ_LIB_libglib_2_WITH_VERSION_CURRENT
	select FREETZ_LIB_libglib_2
	select FREETZ_LIB_libgmodule_2
	select FREETZ_LIB_libgobject_2
	select FREETZ_LIB_libffi
	default n
	help
		If your application uses Glib2 repository, select this library.

choice
	prompt "Version" if FALSE
		default FREETZ_LIB_libglib_2_WITH_VERSION_CURRENT

	config FREETZ_LIB_libglib_2_WITH_VERSION_ABANDON
		bool "2.32.4"
		depends on !FREETZ_SEPARATE_AVM_UCLIBC

	config FREETZ_LIB_libglib_2_WITH_VERSION_CURRENT
		bool "2.88.3"
		depends on FREETZ_SEPARATE_AVM_UCLIBC

endchoice
```

## make/libs/harfbuzz/Config.in
```kconfig
config FREETZ_LIB_libharfbuzz
	bool "HarfBuzz (libharfbuzz.so)"
	depends on FREETZ_TARGET_GCC_5_MIN
	select FREETZ_STDCXXLIB_FORCE_GNULIBSTDCXX
	select FREETZ_LIB_STDCXXLIB
	select FREETZ_LIB_libfreetype
	default n
	help
		HarfBuzz is a text shaping engine. It primarily supports
		OpenType, but also Apple Advanced Typography.
```

## make/libs/libgcrypt/Config.in
```kconfig
config FREETZ_LIB_libgcrypt
	bool "GnuPG crypto library (libgcrypt.so)"
	select FREETZ_LIB_libgpg_error
	select FREETZ_LIB_libgcrypt_WITH_DIGEST_blake2
	select FREETZ_LIB_libgcrypt_WITH_DIGEST_md5
	select FREETZ_LIB_libgcrypt_WITH_DIGEST_rmd160
	select FREETZ_LIB_libgcrypt_WITH_DIGEST_sha1
	select FREETZ_LIB_libgcrypt_WITH_DIGEST_sha3
	select FREETZ_LIB_libgcrypt_WITH_DIGEST_sha512
	select FREETZ_LIB_libgcrypt_WITH_SYMMETRIC_CIPHER_aes
	select FREETZ_LIB_libgcrypt_WITH_SYMMETRIC_CIPHER_chacha20
	select FREETZ_LIB_libgcrypt_WITH_ASYMMETRIC_CIPHER_ecc
	select FREETZ_LIB_libgcrypt_WITH_ASYMMETRIC_CIPHER_rsa
	default n
	help
		Libgcrypt is a general-purpose cryptographic library based on the code
		from GnuPG. It provides functions for all cryptographic building blocks:
		symmetric ciphers (AES, DES, Blowfish, CAST5, Twofish, and Arcfour),
		hash algorithms (MD4, MD5, RIPE-MD160, SHA-1, and TIGER-192), MACs
		(HMAC for all hash algorithms), public key algorithms (RSA, ElGamal,
		and DSA), large integer functions, random numbers, and a lot of
		supporting functions.

menu "Configuration"
	depends on FREETZ_LIB_libgcrypt

	comment "Digests ---"
	config FREETZ_LIB_libgcrypt_WITH_DIGEST_blake2
		bool "BLAKE2"
	config FREETZ_LIB_libgcrypt_WITH_DIGEST_crc
		bool "CRC"
	config FREETZ_LIB_libgcrypt_WITH_DIGEST_gostr3411_94
		bool "GOST R 34.11-94"
		select FREETZ_LIB_libgcrypt_WITH_SYMMETRIC_CIPHER_gost28147
#	config FREETZ_LIB_libgcrypt_WITH_DIGEST_md2
#		bool "MD2"
	config FREETZ_LIB_libgcrypt_WITH_DIGEST_md4
		bool "MD4"
	config FREETZ_LIB_libgcrypt_WITH_DIGEST_md5
		bool "MD5"
	config FREETZ_LIB_libgcrypt_WITH_DIGEST_rmd160
		bool "RMD160"
	config FREETZ_LIB_libgcrypt_WITH_DIGEST_sha1
		bool "SHA1"
	config FREETZ_LIB_libgcrypt_WITH_DIGEST_sha3
		bool "SHA3"
	config FREETZ_LIB_libgcrypt_WITH_DIGEST_sha256
		bool "SHA256"
	config FREETZ_LIB_libgcrypt_WITH_DIGEST_sha512
		bool "SHA512"
	config FREETZ_LIB_libgcrypt_WITH_DIGEST_sm3
		bool "SM3"
	config FREETZ_LIB_libgcrypt_WITH_DIGEST_stribog
		bool "Stribog"
	config FREETZ_LIB_libgcrypt_WITH_DIGEST_tiger
		bool "TIGER"
	config FREETZ_LIB_libgcrypt_WITH_DIGEST_whirlpool
		bool "Whirlpool"

	comment "Symmetric ciphers ---"
	config FREETZ_LIB_libgcrypt_WITH_SYMMETRIC_CIPHER_aes
		bool "AES"
	config FREETZ_LIB_libgcrypt_WITH_SYMMETRIC_CIPHER_arcfour
		bool "Arcfour"
	config FREETZ_LIB_libgcrypt_WITH_SYMMETRIC_CIPHER_blowfish
		bool "Blowfish"
	config FREETZ_LIB_libgcrypt_WITH_SYMMETRIC_CIPHER_camellia
		bool "Camellia"
	config FREETZ_LIB_libgcrypt_WITH_SYMMETRIC_CIPHER_cast5
		bool "CAST5"
	config FREETZ_LIB_libgcrypt_WITH_SYMMETRIC_CIPHER_chacha20
		bool "ChaCha20"
	config FREETZ_LIB_libgcrypt_WITH_SYMMETRIC_CIPHER_des
		bool "DES"
	config FREETZ_LIB_libgcrypt_WITH_SYMMETRIC_CIPHER_gost28147
		bool "GOST 28147-89"
	config FREETZ_LIB_libgcrypt_WITH_SYMMETRIC_CIPHER_idea
		bool "IDEA"
	config FREETZ_LIB_libgcrypt_WITH_SYMMETRIC_CIPHER_rfc2268
		bool "RFC2268"
	config FREETZ_LIB_libgcrypt_WITH_SYMMETRIC_CIPHER_salsa20
		bool "Salsa20"
	config FREETZ_LIB_libgcrypt_WITH_SYMMETRIC_CIPHER_seed
		bool "SEED"
	config FREETZ_LIB_libgcrypt_WITH_SYMMETRIC_CIPHER_serpent
		bool "Serpent"
	config FREETZ_LIB_libgcrypt_WITH_SYMMETRIC_CIPHER_sm4
		bool "SM4"
	config FREETZ_LIB_libgcrypt_WITH_SYMMETRIC_CIPHER_twofish
		bool "Twofish"

	comment "Asymmetric ciphers ---"
	config FREETZ_LIB_libgcrypt_WITH_ASYMMETRIC_CIPHER_dsa
		bool "DSA"
	config FREETZ_LIB_libgcrypt_WITH_ASYMMETRIC_CIPHER_ecc
		bool "ECC"
	config FREETZ_LIB_libgcrypt_WITH_ASYMMETRIC_CIPHER_elgamal
		bool "Elgamal"
	config FREETZ_LIB_libgcrypt_WITH_ASYMMETRIC_CIPHER_rsa
		bool "RSA"

endmenu
```

## make/pkgs/axtlswrap/Config.in
```kconfig
config FREETZ_PACKAGE_AXTLSWRAP
	depends on FREETZ_REAL_DEVELOPER_ONLY
	bool "axTLS wrapper 2.1.5 (binary only) - DEPRECATED"
	default n
```

## make/pkgs/bftpd/Config.in
```kconfig
config FREETZ_PACKAGE_BFTPD
	bool "Bftpd 6.7"
	default n
	help
		Small FTP Server

if FREETZ_PACKAGE_BFTPD

	config FREETZ_PACKAGE_BFTPD_WITH_ZLIB
		bool "With on-the-fly compression"
		select FREETZ_LIB_libz
		default n

endif # FREETZ_PACKAGE_BFTPD
```

## make/pkgs/bridge-utils/Config.in
```kconfig
config FREETZ_PACKAGE_BRIDGE_UTILS
	bool "bridge-utils 1.5 (binary only) - DEPRECATED"
	default n
	help
		This package contains utilities for configuring the Linux ethernet
		bridge. The Linux ethernet bridge can be used for connecting multiple
		ethernet devices together. The connection is fully transparent: hosts
		connected to one ethernet device see hosts connected to the other
		ethernet devices directly.

		Authors: Lennert Buytenhek <buytenh@gnu.org>
```

## make/pkgs/ca-bundle/Config.in
```kconfig
config FREETZ_PACKAGE_CA_BUNDLE
	bool "CA-bundle 2026-11-05"
	default n
	help
		The Mozilla CA certificate store in PEM format,
		see https://www.curl.se/docs/caextract.html
		Size of uncompressed file is about 250 KB.
```

## make/pkgs/empty/Config.in
```kconfig
config FREETZ_PACKAGE_EMPTY
	bool "Empty 0.6.23d (binary only) - DEPRECATED"
	select FREETZ_LIB_libutil if FREETZ_TARGET_UCLIBC_HAS_multiple_libs
	default n
	help
		empty is an utility that provides an interface to execute and/or
		interact with processes under pseudo-terminal sessions (PTYs).
		This tool is definitely useful in programming of shell scripts
		designed to communicate with interactive programs like telnet,
		ssh, ftp, etc. In some cases, empty can be the simplest
		replacement for TCL/expect or other similar programming tools.
```

## make/pkgs/gnutls/Config.in
```kconfig
config FREETZ_PACKAGE_GNUTLS
	bool "GnuTLS 3.7.8/3.8.13 (binary only)"
	select FREETZ_LIB_libgnutls
	default n
	help
		GnuTLS is a project that aims to develop a library which provides a
		secure layer, over a reliable transport layer. Currently the GnuTLS
		library implements TLS 1.3, 1.2, 1.1, 1.0 protocols and SSL 3.0.

if FREETZ_PACKAGE_GNUTLS

	choice
		prompt "Version"
			default FREETZ_PACKAGE_GNUTLS_VERSION_CURRENT

		config FREETZ_PACKAGE_GNUTLS_VERSION_ABANDON
			bool "3.7.8"
			depends on !(FREETZ_TARGET_GCC_5_MIN && !FREETZ_TARGET_UCLIBC_1_0_14)

		config FREETZ_PACKAGE_GNUTLS_VERSION_CURRENT
			bool "3.8.13"
			depends on  (FREETZ_TARGET_GCC_5_MIN && !FREETZ_TARGET_UCLIBC_1_0_14)

	endchoice

	config FREETZ_PACKAGE_GNUTLS_CERTTOOL
		bool "certtool"
		default n
		help
			Provides GnuTLS certtool utility.

	config FREETZ_PACKAGE_GNUTLS_UTILS
		bool "utils"
		default n
		help
			Provides gnutls-cli, gnutls-serv, psktool and srptool utilities.

endif # FREETZ_PACKAGE_GNUTLS
```

## make/pkgs/mini-snmpd/Config.in
```kconfig
config FREETZ_PACKAGE_MINI_SNMPD
	bool "mini-snmpd 1.7/2.1 (binary only)"
	depends on !(FREETZ_TARGET_UCLIBC_0_9_28 || FREETZ_TARGET_UCLIBC_0_9_29)
	default n
	help
		This program is an SNMP server for "embedded systems".
		The advantage in comparison to other products is the
		low usage of system resources.

if FREETZ_PACKAGE_MINI_SNMPD

	choice
		prompt "Version"
			default FREETZ_PACKAGE_MINI_SNMPD_VERSION_CURRENT

		config FREETZ_PACKAGE_MINI_SNMPD_VERSION_ABANDON
			bool "1.7"
			depends on FREETZ_KERNEL_VERSION_2

		config FREETZ_PACKAGE_MINI_SNMPD_VERSION_CURRENT
			bool "2.1"
			depends on !FREETZ_KERNEL_VERSION_2
			select FREETZ_LIB_libconfuse

	endchoice

endif # FREETZ_PACKAGE_MINI_SNMPD
```
